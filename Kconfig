## zephyr/Kconfig.body_detection
```kconfig
# Copyright 2022 The ChromiumOS Authors
# Use of this source code is governed by a BSD-style license that can be
# found in the LICENSE file.

menuconfig PLATFORM_EC_BODY_DETECTION
	bool "Sensor body detection"
	help
	  Enable the body detection function.

	  The Power Reduction Algorithm is based on the Motion Detector
	  output of In Motion (on body) state or Stationary (off body) state.
	  The input of the Motion Detector is the X and Y axis signal
	  from an accelerometer.

if PLATFORM_EC_BODY_DETECTION

config PLATFORM_EC_BODY_DETECTION_MAX_WINDOW_SIZE
	int "Maximal sensor data rate"
	default 250
	help
	  Sets the maximum sensor data rate, in Hz. Note that larger data rate
	  values consume more memory and computing resource.

config PLATFORM_EC_BODY_DETECTION_VAR_THRESHOLD
	int "The threshold of acceleration variance for confidence calculation"
	default 550
	help
	  The unit is (mm/s^2)^2

	  The motion confidence is calculated if the variance is within
	  variance_threshold +/- confidence_delta. Otherwise, if variance is
	  too high/low, confidence will be 100%/0%

config PLATFORM_EC_BODY_DETECTION_CONFIDENCE_DELTA
	int "The delta of acceleration variance for confidence calculation"
	default 525
	help
	  The unit is (mm/s^2)^2

	  The motion confidence is calculated if the variance is within
	  variance_threshold +/- confidence_delta. Otherwise, if variance is
	  too high/low, confidence will be 100%/0%

config PLATFORM_EC_BODY_DETECTION_VAR_NOISE_FACTOR
	int "How much noise affects the threshold of variance"
	default 120
	help
	  The unit is percentage

	  This is used for mitigate the effect of the noise from the sensor.
	  If set to 100%, the average noise is canceled out. This is set to
	  120% by default because the noise might get larger than average
	  sometimes.

config PLATFORM_EC_BODY_DETECTION_ON_BODY_CON
	int "The confidence limit of on_body"
	default 50
	help
	  The unit is percentage

	  Higher the value, more diffcult to enter the on-body from off-body

config PLATFORM_EC_BODY_DETECTION_OFF_BODY_CON
	int "The confidence limit of off body"
	default 10
	help
	  The unit is percentage

	  Lower the value, more diffcult to enter the off-body from on-body.
	  Should be set less than the PLATFORM_EC_BODY_DETECTION_ON_BODY_CON

config PLATFORM_EC_BODY_DETECTION_STATIONARY_DURATION
	int "The threshold duration to change to off_body"
	default 15
	help
	  The unit is seconds

	  How long should we stay in on-body state before entering to off-body
	  state when the motion confidence is less than
	  PLATFORM_EC_BODY_DETECTION_OFF_BODY_CON

config PLATFORM_EC_BODY_DETECTION_NOTIFY_MODE_CHANGE
	bool "Notify host with a specific host event when body status is changed"
	default n
	help
	  Notify the host via SCI events EC_HOST_EVENT_BODY_DETECT_CHANGE when body
	  status is changed, in addition to adding an event in the motion sensor
	  FIFO queue.

config PLATFORM_EC_BODY_DETECTION_ALWAYS_ENABLE_IN_S0
	bool "Always enable body detection function in S0"
	default n
	help
	  Always enable the body detection function in S0
	  w/o the host command

endif # PLATFORM_EC_BODY_DETECTION
```

## zephyr/Kconfig.cbi
```kconfig
# Copyright 2022 The ChromiumOS Authors
# Use of this source code is governed by a BSD-style license that can be
# found in the LICENSE file.

config PLATFORM_EC_BYPASS_CBI_EEPROM_WP_CHECK
	bool "Bypass CBI EEPROM Write Protect"
	depends on PLATFORM_EC_CBI_EEPROM
	help
	  Bypass the CBI EEPROM write protect checks. This should ONLY be
	  defined during bringup, and should never be defined on a shipping or
	  release platform.

	  When defined, ectool can be used to reprogram all CBI fields,
	  regardless of the state of the hardware write protect.

config PLATFORM_EC_EEPROM_CBI_WP
	bool "EC can independently set the CBI EEPROM WP signal"
	depends on PLATFORM_EC_CBI_EEPROM
	help
	   Define this if the EC can independently set the CBI EEPROM WP
	   signal. The accompanying hardware must ensure that the CBI WP gets
	   latched and is only reset when EC_RST_ODL is asserted.

config PLATFORM_EC_CBI
	bool "CBI support"
	default y
	help
	  CBI is a means for accessing board information, typically set
	  during the factory process. This allows selection of the physical
	  storage of CBI source.

	  See here for detailed information on CBI:

	  https://chromium.googlesource.com/chromiumos/docs/+/HEAD/design_docs/cros_board_info.md

if PLATFORM_EC_CBI

config PLATFORM_EC_CBI_EEPROM
	bool "CBI EEPROM support"
	default y
	depends on EEPROM
	depends on $(dt_nodelabel_enabled,cbi_eeprom)
	help
	  Enables full Chromium OS Board Info (CBI) support, with CBI data
	  stored in an on-board EEPROM.

config PLATFORM_EC_CBI_FLASH
	bool "CBI flash support"
	default y
	depends on $(dt_nodelabel_enabled,cbi_flash)
	help
	  Enables full Chromium OS Board Info (CBI) support, with CBI data
	  stored in an on-board flash.

config PLATFORM_EC_CBI_TRANSFER_EEPROM_FLASH
	bool "Transfer CBI from EEPROM to flash CBI section"
	depends on PLATFORM_EC_CBI_EEPROM
	depends on PLATFORM_EC_CBI_FLASH
	help
	  Copy CBI from EEPROM to flash automatically if CBI on flash is
	  not valid and EEPROM has valid CBI

choice PLATFORM_EC_CBI_STORAGE_TYPE
	prompt "CBI storage type"
	default PLATFORM_EC_CBI_EEPROM_OR_FLASH if PLATFORM_EC_CBI_EEPROM || PLATFORM_EC_CBI_FLASH
	help
	  Select the backing storage type for CBI data.

config PLATFORM_EC_CBI_EEPROM_OR_FLASH
	bool "CBI EEPROM or EC flash support"
	depends on PLATFORM_EC_CBI_EEPROM || PLATFORM_EC_CBI_FLASH
	help
	  Enables full Chromium OS Board Info (CBI) support, with CBI data
	  stored in an on-board EEPROM or EC Flash.

config PLATFORM_EC_CBI_GPIO
	bool "CBI GPIO support"
	help
	  Enables Chromium OS Board Info (CBI) from strapping pins. EC reads
	  the BOARD ID and SKU ID from GPIOs and then substantiate in-memory
	  CBI for AP to query.
endchoice

config PLATFORM_EC_CONSOLE_CMD_CBI
	bool "Console command: cbi"
	default y
	help
	  Enable the 'cbi' console command. This command is used to display or
	  change the CBI information in the persistent storage.

endif # PLATFORM_EC_CBI
```

## zephyr/Kconfig.cec
```kconfig
# Copyright 2023 The ChromiumOS Authors
# Use of this source code is governed by a BSD-style license that can be
# found in the LICENSE file.

config PLATFORM_EC_CEC
	bool "EC CEC support"
	select HAS_TASK_CEC
	help
	  Enable support for HDMI CEC (Consumer Electronics Control).

if PLATFORM_EC_CEC

config PLATFORM_EC_CEC_DEBUG
	bool "CEC debug logs"
	help
	  Enable CEC debug logs.

config PLATFORM_EC_CEC_BITBANG
	bool "CEC bitbang driver"
	help
	  Enable the CEC bitbang driver. This driver uses GPIOs and a hardware
	  timer to send and receive CEC messages. It can be used on ECs without
	  a CEC peripheral, or in addition to a CEC peripheral to enable more
	  CEC ports.

config PLATFORM_EC_CEC_IT83XX
	bool "IT83XX CEC driver"
	help
	  Enable a driver for CEC peripheral on the ITE IT83XX EC. This
	  peripheral supports a single CEC port.

endif # PLATFORM_EC_CEC
```
