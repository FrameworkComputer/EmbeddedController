## zephyr/Kconfig.accelgyro_bmi
```kconfig
# Copyright 2021 The Chromium OS Authors. All rights reserved.
# Use of this source code is governed by a BSD-style license that can be
# found in the LICENSE file.


if PLATFORM_EC_ACCELGYRO_BMI
menu "BMI Sensor Common"

choice PLATFORM_EC_ACCELGYRO_BMI_COMM
	prompt "Accelgyro BMI's communication mode"
	help
	  When using the BMI drivers, there's the option to communicate with the
	  chip via several methods. This choice helps improve code size by only
	  compiling the needed communication channels.

config PLATFORM_EC_ACCELGYRO_BMI_COMM_SPI
	bool "Use SPI communication"
	help
	  The BMI chip is using SPI communication. This config value is used to
	  save on code size as only the SPI communication code will be included
	  for the BMI chip.

config PLATFORM_EC_ACCELGYRO_BMI_COMM_I2C
	bool "Use I2C communication"
	help
	  The BMI chip is using I2C communication. This config value is used to
	  save on code size as only the I2C communication code will be included
	  for the BMI chip.

endchoice

endmenu # BMI Sensor
endif # PLATFORM_EC_ACCELGYRO_BMI
```

## zephyr/Kconfig.accelgyro_icm
```kconfig
# Copyright 2021 The Chromium OS Authors. All rights reserved.
# Use of this source code is governed by a BSD-style license that can be
# found in the LICENSE file.


if PLATFORM_EC_ACCELGYRO_ICM
menu "ICM Sensor Common"

choice PLATFORM_EC_ACCELGYRO_ICM_COMM
	prompt "Accelgyro ICM's communication mode"
	help
	  When using the ICM drivers, there's the option to communicate with the
	  chip via several methods. This choice helps improve code size by only
	  compiling the needed communication channels.

config PLATFORM_EC_ACCELGYRO_ICM_COMM_SPI
	bool "Use SPI communication"
	help
	  The ICM chip is using SPI communication. This config value is used to
	  save on code size as only the SPI communication code will be included
	  for the ICM chip.

config PLATFORM_EC_ACCELGYRO_ICM_COMM_I2C
	bool "Use I2C communication"
	help
	  The ICM chip is using I2C communication. This config value is used to
	  save on code size as only the I2C communication code will be included
	  for the ICM chip.

endchoice

endmenu # ICM Sensor
endif # PLATFORM_EC_ACCELGYRO_ICM
```

## zephyr/Kconfig.adc
```kconfig
# Copyright 2021 The Chromium OS Authors. All rights reserved.
# Use of this source code is governed by a BSD-style license that can be
# found in the LICENSE file.

menuconfig PLATFORM_EC_ADC
	bool "ADC shim"
	default n if ARCH_POSIX
	default y
	imply ADC
	help
	  Enable compilation of the EC ADC module. Once enabled, it is
	  possible to call platform/ec adc_read_channel() function.

if PLATFORM_EC_ADC

# Chromium EC provides it's own "adc" command.  Disable the Zephyr
# built-in ADC shell command.
# TODO(b:188434233) Investigate moving to zephyr adc shell
config ADC_SHELL
	default n

config PLATFORM_EC_ADC_CMD
	bool "ADC host/console command"
	default y
	help
	  Enables support for printing ADC channels state with the "adc"
	  console command and reading a state of ADC channel with the
	  EC_CMD_ADC_READ host command. Replaces generic Zephyr "adc"
	  command.

config PLATFORM_EC_ADC_RESOLUTION
	int "ADC resolution"
	default 10
	help
	  The resolution, in bits, to use for the ADC conversion. Determines
	  the sample values range: 0 .. 2^resolution -1. The supported
	  resolution values depend on specific hardware.

config PLATFORM_EC_ADC_OVERSAMPLING
	int "ADC oversampling"
	default 0
	help
	  ADC oversampling to use for the ADC conversion. Each sample is
	  averaged from 2^oversampling conversion results. Oversampling can
	  help in providing more stable readings. The supported oversampling
	  values depend on specific hardware.

config PLATFORM_EC_ADC_CHANNELS_RUNTIME_CONFIG
	bool "ADC runtime config"
	default n
	help
	  Allows the configuration of the ADC channels to be set up at
	  runtime. This makes the adc_channels[] array writable,
	  i.e. not const. It should be declared as such in the board
	  config.

	  This is useful when the board has runtime information that
	  changes the configuration, such as board revision information.
	  Without this, multiple EC images would need to be installed
	  depending on the board.

endif # PLATFORM_EC_ADC
```

## zephyr/Kconfig.ap_hang_detect
```kconfig
# Copyright 2023 The ChromiumOS Authors
# Use of this source code is governed by a BSD-style license that can be
# found in the LICENSE file.

config PLATFORM_EC_AP_HANG_DETECT
	bool "AP hang detect support"
	default n
	help
	  Enable EC based watchdog that will reset AP when the AP hangs.
```

## zephyr/Kconfig.ap_power
```kconfig
# Copyright 2022 The ChromiumOS Authors
# Use of this source code is governed by a BSD-style license that can be
# found in the LICENSE file.

config AP_POWER_CONTROL
    bool
    default y if PLATFORM_EC_POWERSEQ || (AP_PWRSEQ && !EMUL_AP_PWRSEQ_DRIVER)
    help
      Whether the EC has control over AP power states.

      This is automatically enabled if an implementation of AP power
      sequencing is enabled.

menuconfig PLATFORM_EC_BOOT_AP_POWER_REQUIREMENTS
	bool "Power requirements to boot AP"
	default y
	help
	  Power thresholds for AP boot.
	  If one of the following conditions is met, EC boots AP:
	   1. Battery charge >= CONFIG_CHARGER_MIN_BAT_PCT_FOR_POWER_ON.
	   2. AC power >= CONFIG_CHARGER_MIN_POWER_MW_FOR_POWER_ON.
	   3. Battery charge >= CONFIG_CHARGER_MIN_BAT_PCT_FOR_POWER_ON_WITH_AC
	    and
	    AC power >= CONFIG_CHARGER_MIN_POWER_MW_FOR_POWER_ON_WITH_BATT.

if PLATFORM_EC_BOOT_AP_POWER_REQUIREMENTS

config PLATFORM_EC_POWER_BUTTON_INIT_TIMEOUT
	int "Timeout before power button task gives up starting system"
	depends on HAS_TASK_POWERBTN
	default 1
	help
	  Sets the maximum time, in seconds, before the power button
	  task stops waiting for conditions to be OK to start
	  the system. If the timeout is reached, the AP is
	  not started, and the power task's state is set to idle.

config PLATFORM_EC_CHARGER_MIN_BAT_PCT_FOR_POWER_ON
	int "Minimal battery level to boot AP without AC"
	depends on PLATFORM_EC_BATTERY
	default 3
	help
	  Sets the minimum battery capacity, as a percentage, needed to boot
	  the AP when AC power is not supplied.

config PLATFORM_EC_CHARGER_MIN_BAT_PCT_FOR_POWER_ON_WITH_AC
	int "Minimal battery level to boot AP with AC"
	depends on PLATFORM_EC_BATTERY && PLATFORM_EC_CHARGE_MANAGER
	default 1
	help
	  Sets the minimum battery capacity, as a percentage, needed to boot
	  the AP when AC power is supplied. The AC power supplied must also
	  be greater than CONFIG_CHARGER_MIN_POWER_MW_FOR_POWER_ON_WITH_BATT.

config PLATFORM_EC_CHARGER_MIN_POWER_MW_FOR_POWER_ON_WITH_BATT
	int "Minimal AC power to boot AP with battery"
	depends on PLATFORM_EC_BATTERY && PLATFORM_EC_CHARGE_MANAGER
	default 15000
	help
	  Sets the minimum power, in milliwatts, supplied by an external
	  charger required to boot the AP when the battery capacity is also
	  above CONFIG_CHARGER_MIN_BAT_PCT_FOR_POWER_ON_WITH_AC.

config PLATFORM_EC_CHARGER_MIN_POWER_MW_FOR_POWER_ON
	int "Minimal AC power to boot AP without battery"
	depends on PLATFORM_EC_CHARGE_MANAGER
	default 15000
	help
	  Sets the minimum power, in milliwatts, supplied by an external
	  charger requires to boot the AP when no battery is present or
	  under dead battery conditions. If the AP requires greater than
	  15W to boot, check the
	  CONFIG_PLATFORM_EC_CHARGER_LIMIT_POWER_THRESH_CHG_MW setting.

endif # PLATFORM_EC_BOOT_AP_POWER_REQUIREMENTS
```
