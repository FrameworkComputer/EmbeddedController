## Kconfig
```kconfig
# Copyright 2022 The ChromiumOS Authors
# Use of this source code is governed by a BSD-style license that can be
# found in the LICENSE file.

rsource "zephyr/Kconfig"
rsource "common/Kconfig"
rsource "third_party/Kconfig"
orsource "private/fingerprint/Kconfig"
```

## third_party/boringssl/Kconfig
```kconfig
# Copyright 2023 The ChromiumOS Authors
# Use of this source code is governed by a BSD-style license that can be
# found in the LICENSE file.

config BORINGSSL_CRYPTO
	bool "BoringSSL support"
	depends on COMMON_LIBC_MALLOC_ARENA_SIZE >= 2048 || \
		   NEWLIB_LIBC_MIN_REQUIRED_HEAP_SIZE >= 2048
	select REQUIRES_STD_C11
	help
	  This option enables BoringSSL cryptography library.
	  The library is provided as external module.

if BORINGSSL_CRYPTO

config BORINGSSL_HARDWARE_ENTROPY
	bool "Provide entropy from hardware RNG"
	default y
	depends on POSIX_C_LIB_EXT
	help
	  This option enables support for providing entropy to BoringSSL.
	  Entropy comes from hardware RNG selected in DTS.

endif
```

## west.yml
```yaml
manifest:
  self:
    path: modules/ec

  remotes:
    - name: chromium
      url-base: https://chromium.googlesource.com/chromiumos

  projects:
    - name: zephyr
      remote: chromium
      repo-path: third_party/zephyr
      revision: main
      path: zephyr
      west-commands: scripts/west-commands.yml
      clone-depth: 500

    - name: cmsis
      remote: chromium
      repo-path: third_party/zephyr/cmsis
      revision: chromeos-main
      path: modules/cmsis
      clone-depth: 500

    - name: hal_stm32
      remote: chromium
      repo-path: third_party/zephyr/hal_stm32
      revision: chromeos-main
      path: modules/hal_stm32
      clone-depth: 500

    - name: nanopb
      remote: chromium
      repo-path: third_party/zephyr/nanopb
      revision: main
      path: modules/nanopb
      clone-depth: 500

    - name: cryptoc
      remote: chromium
      repo-path: third_party/cryptoc
      revision: main
      path: modules/cryptoc
      clone-depth: 500
```
