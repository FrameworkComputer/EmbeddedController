## zephyr/Kconfig.chargesplash
```kconfig
# Copyright 2022 The Chromium OS Authors. All rights reserved.
# Use of this source code is governed by a BSD-style license that can be
# found in the LICENSE file.

menuconfig PLATFORM_EC_CHARGESPLASH
	bool "Charging splashscreen support"
	depends on PLATFORM_EC_CHARGER
	help
	  Enable visual charging indicator to display on-screen when
	  AC is initially connected.

if PLATFORM_EC_CHARGESPLASH

config PLATFORM_EC_CHARGESPLASH_PERIOD
	int "Seconds for which chargesplash requests are tracked"
	default 900
	help
	  A charger which is connecting and disconnecting frequently
	  can indicate damage to the charger or port.  To prevent
	  excessive power usage on a device plugged in and
	  experiencing frequent AC connects, we monitor the number of
	  AC connects over a period of time.  If the number of AC
	  connects exceeds a defined value during that period of time,
	  we inhibit all chargesplash requests until an entire period
	  passes with no new AC connections.

	  This config option defines the length of the period, in
	  seconds.

config PLATFORM_EC_CHARGESPLASH_MAX_REQUESTS_PER_PERIOD
	int "Number of chargesplash requests per period which triggers lockout"
	default 5
	help
	  A charger which is connecting and disconnecting frequently
	  can indicate damage to the charger or port.  To prevent
	  excessive power usage on a device plugged in and
	  experiencing frequent AC connects, we monitor the number of
	  AC connects over a period of time.  If the number of AC
	  connects exceeds a defined value during that period of time,
	  we inhibit all chargesplash requests until an entire period
	  passes with no new AC connections.

	  This config option defines the number of requests that must
	  happen in one period to trigger the lockout condition.

endif  # PLATFORM_EC_CHARGESPLASH
```

## zephyr/Kconfig.console
```kconfig
# Copyright 2021 The ChromiumOS Authors
# Use of this source code is governed by a BSD-style license that can be
# found in the LICENSE file.

config PLATFORM_EC_CONSOLE_CHANNEL
	bool "Console channels"
	depends on CONSOLE
	default y
	help
	  Make it possible for console to be output to different channels that
	  can be turned on and off. Channels are organized by functional area
	  such as "charger", "motionsense", "usbpd" and others.

	  This is useful as a developer convenience when the console is crowded
	  with messages, to make it easier to use the interactive console.

	  The `chan` console command with no arguments shows all available
	  channels.

	  FAFT and servod also use this feature.

	  Boards may #undef this to reduce image size.

# Adjusted to the account for the build_info[] string (about 160 bytes) plus
# the image type (about 16 bytes).
# printed by the banner.
config SHELL_PRINTF_BUFF_SIZE
	default 180

# Some boards may need to increase the size, depending on the amount of output
config SHELL_BACKEND_SERIAL_TX_RING_BUFFER_SIZE
	default 1024

# For FAFT, need a larger RX ring
config SHELL_BACKEND_SERIAL_RX_RING_BUFFER_SIZE
	default 192

config PLATFORM_EC_ISR_CONSOLE_OUTPUT
	bool "Log in ISRs"
	depends on CONSOLE
	default y
	help
	  If enabled, allowing console output when in interrupt service routines
	  via printk. If disabled, silently drop these messages.

	  Console output via printk is unbuffered, so console output when in ISRs
	  should be avoided if possible - larger amounts of output will prevent
	  the EC from timely interrupt servicing.

menuconfig PLATFORM_EC_HOSTCMD_CONSOLE
	bool "Console Host Command"
	depends on PLATFORM_EC_HOSTCMD
	default y
	help
	  Enable the EC_CMD_CONSOLE_SNAPSHOT and EC_CMD_CONSOLE_READ
	  host commands, used for reading the EC console from the AP.

if PLATFORM_EC_HOSTCMD_CONSOLE

config PLATFORM_EC_HOSTCMD_CONSOLE_BUF_SIZE
	int "Console buffer size"
	default 4096
	help
	  The EC will use a circular buffer to store bytes outputted
	  to the console for the AP to read.  This changes the maximal
	  number of bytes from the console output which can be saved.

	  Choosing a power-of-two for this value is optimal, as
	  modular arithmetic is used.

endif # PLATFORM_EC_HOSTCMD_CONSOLE

menuconfig PLATFORM_EC_CONSOLE_DEBUG
	bool "Console Debug"
	depends on CONSOLE
	default n
	help
	  Write all zephyr_print() messages to printk() also. Not recommended
	  outside of tests.


config PLATFORM_EC_LOG_BACKEND_CONSOLE_BUFFER
	bool "Logging backend for the console buffer"
	depends on PLATFORM_EC_HOSTCMD_CONSOLE
	depends on !LOG_MODE_MINIMAL
	select LOG_OUTPUT
	help
	  Enable the logging backend for the console buffer.

	  This will copy messages sent to the zephyr logging subsystem
	  to the EC console buffer. This allows the AP to access the
	  log messages with the console host command.

config PLATFORM_EC_LOG_BACKEND_CONSOLE_BUFFER_TMP_BUF_SIZE
	int "Size of temporary buffer used by console buffer logging backend"
	default 128 if LOG_MODE_DEFERRED
	default 1
	depends on PLATFORM_EC_LOG_BACKEND_CONSOLE_BUFFER
	help
	  The size of the temporary buffer used by the console buffer backend.
	  The logging subsystem will buffer up to this many bytes before calling
	  the backend in deferred logging mode. Ideally this will be large
	  enough to fit an entire log line.

config PLATFORM_EC_LOG_TOKENIZED
	bool "Use tokenized logging for EC"
	depends on PIGWEED_LOG_TOKENIZED_LIB
	depends on CPP
	depends on STD_CPP17 # coreboot g++ __cplusplus 201703L
	depends on EXTERNAL_MODULE_LIBCPP
	depends on PIGWEED_MINIMAL_CPP_STDLIB
	depends on PICOLIBC
	depends on PICOLIBC_USE_MODULE
	help
	  Enable tokenized logging in EC.  Log format strings are converted to
	  32 bit tokens reducing image size.  A token database for detokenizing
	  is generated in the build directory.

config PLATFORM_EC_LOG_BACKEND_CONSOLE_BUFFER_REDUCED
	bool "Reduce size of the log format"
	depends on PLATFORM_EC_LOG_BACKEND_CONSOLE_BUFFER
	help
	  Skip logging the logging level and the source to the console buffer.
	  It reduces the amount data stored in the console buffer.

config PLATFORM_EC_LOG_CUSTOM_TIMESTAMP
	bool "Use EC format of timestamp"
	select LOG_OUTPUT_FORMAT_CUSTOM_TIMESTAMP
	help
	  Change the default format of the timestamp, to the one EC uses -
	  "[s.us]" at the beginning of a log.

config PLATFORM_EC_PRINTF_LONG_IS_32BITS
	bool "Support %l in 32-bit systems"
	help
	  Allow the use of the "long" printf length modifier ('l') to be in 32-bit
	  systems along with any supported conversion specifiers. Note that this also
	  reenables support for the 'i' printf format. This config will only take
	  effect if sizeof(long) == sizeof(uint32_t).
```

## zephyr/Kconfig.console_cmd_mem
```kconfig
# Copyright 2021 The Chromium OS Authors. All rights reserved.
# Use of this source code is governed by a BSD-style license that can be
# found in the LICENSE file.

if PLATFORM_EC_CONSOLE_CMD_MEM
config PLATFORM_EC_CONSOLE_CMD_MD
	bool "Console command: md"
	default y
	help
	  Enable the "md" command. This dumps memory value from a specified
	  address, optionally specifying the format.

	  Example:
	     md 0x64000000 10

	     64000000: 2a3b4d5e 030054e1 07000000 09297110
	     64000010: 00000010 03db4f00 03db5000 00000100
	     64000020: 00000000 00000000

config PLATFORM_EC_CONSOLE_CMD_RW
	bool "Console command: rw"
	default y
	help
	  Enable the "rw" command. This Read or write in memory optionally
	  specifying the size.

	  Example:
	     rw 0x64000000

	     read 0x64000000 = 0x2a3b4d5e

endif # PLATFORM_EC_CONSOLE_CMD_MEM
```

## zephyr/Kconfig.debug_assert
```kconfig
# Copyright 2021 The ChromiumOS Authors
# Use of this source code is governed by a BSD-style license that can be
# found in the LICENSE file.

if PLATFORM_EC_DEBUG_ASSERT

choice PLATFORM_EC_DEBUG_ASSERT_MODE
	prompt "Select behaviour on assertion failure"
	help
	  This selects the action taken when the board hits an assertion
	  failure in the code. This should not happen in normal operation,
	  but can appear during development when the code is not yet fully
	  tested.

config PLATFORM_EC_DEBUG_ASSERT_REBOOTS
	bool "Reboot"
	help
	  Prints a message and reboot if an assert() macro fails at runtime.
	  If PLATFORM_EC_SOFTWARE_PANIC is enabled then the information is
	  written to the panic log before rebooting.

config PLATFORM_EC_DEBUG_ASSERT_BREAKPOINT
	bool "Generate a breakpoint"
	help
	  Immediately hits a breakpoint instruction (without printing a message)
	  so that a connected JTAG debugger can be used to debug the problem
	  from there. If there is no debugger connected then the breakpoint
	  instruction will cause the board to reboot immediately.

endchoice # PLATFORM_EC_DEBUG_ASSERT_MODE

config PLATFORM_EC_DEBUG_ASSERT_BRIEF
	bool "Use brief assertion-failure messages"
	depends on PLATFORM_EC_DEBUG_ASSERT_REBOOTS
	select ASSERT_NO_COND_INFO
	help
	  Normally the assertion-failure messages include the expression that
	  failed and the function name where the failure occurred. These are
	  both stored as strings and can add a lot to the size of the image,
	  since they are generated for every call to assert(). Use this option
	  to drop them so that only the file and line number are shown.

	  This option is of course not available with
	  PLATFORM_EC_DEBUG_ASSERT_BREAKPOINT, since that does not print a
	  message at all.

	  ASSERT_NO_FILE_INFO and ASSERT_NO_MSG_INFO can also be enabled to
	  further limit image size.

endif # PLATFORM_EC_DEBUG_ASSERT
```

## zephyr/Kconfig.defaults
```kconfig
# Copyright 2021 The ChromiumOS Authors
# Use of this source code is governed by a BSD-style license that can be
# found in the LICENSE file.

# Zephyr Kconfig overrides that applies to all platforms.

# Disable timeslicing, it's compiled in by default and can be enabled at
# runtime but not used in Zephyr EC.
config TIMESLICING
	default n

config LOG
	default y
	imply LOG_DEFAULT_MINIMAL

config GPIO
	default y if ARCH_POSIX

config THREAD_MAX_NAME_LEN
	default 16

config SHELL_PROMPT_UART
	default "ec:~> "

config SHELL_VT100_COLORS
	default n

config SHELL_THREAD_PRIORITY_OVERRIDE
	default y

config SHELL_THREAD_PRIORITY
	default 20

config EXTRA_EXCEPTION_INFO
	default y if ARCH_HAS_EXTRA_EXCEPTION_INFO

config FLASH_PAGE_LAYOUT
	default n

config ESPI_NPCX_PERIPHERAL_DEBUG_PORT_80_MULTI_BYTE
	default y

choice INPUT_MODE
	default INPUT_MODE_SYNCHRONOUS
endchoice

config INPUT_NPCX_KBD
	default n if PLATFORM_EC_KEYBOARD_CROS_EC_RAW_KB

config OUTPUT_DISASSEMBLY
	default y

config SHELL_BACKEND_SERIAL_INIT_PRIORITY
	default 51

config EMUL
	default y if I2C && (BOARD_NATIVE_POSIX || BOARD_NATIVE_SIM)

orsource "Kconfig.defaults-$(ARCH)"
```

## zephyr/Kconfig.defaults-arm
```kconfig
# Copyright 2022 The ChromiumOS Authors
# Use of this source code is governed by a BSD-style license that can be
# found in the LICENSE file.

# ARM specific Kconfig overrides.

config TRAP_UNALIGNED_ACCESS
	default y

choice NULL_POINTER_EXCEPTION_DETECTION
	default NULL_POINTER_EXCEPTION_DETECTION_MPU
endchoice

config CORTEX_M_NULL_POINTER_EXCEPTION_PAGE_SIZE
	# Using 0x20 because NPCX accesses 0x40 for down_from_flash_api.
	# See b/282983670 for other NPCX ROM accesses.
	default "0x20"
```

## zephyr/Kconfig.detachable_base
```kconfig
# Copyright 2023 The ChromiumOS Authors
# Use of this source code is governed by a BSD-style license that can be
# found in the LICENSE file.

config PLATFORM_EC_DETACHABLE_BASE
	bool "Detachable base support"
	help
		Enable base state related helpers.

		If enabled, the board should implement a base_force_state()
		function and board-specific base attach detection algorithm.

		Enable this if the board has a detachable base.

config PLATFORM_EC_BASE_ATTACHED_SWITCH
	bool "Base attached switch"
	depends on PLATFORM_EC_DETACHABLE_BASE
	help
		Add a virtual switch to indicate when detachable device has
		base attached.
```

## zephyr/Kconfig.espi
```kconfig
# Copyright 2021 The Chromium OS Authors. All rights reserved.
# Use of this source code is governed by a BSD-style license that can be
# found in the LICENSE file.

if PLATFORM_EC_HOST_INTERFACE_ESPI

config PLATFORM_EC_ESPI_VW_SLP_S3
	bool "SLP_S3 is an eSPI virtual wire instead of a GPIO"
	help
	  For power sequencing, use an eSPI virtual wire instead of
	  defining GPIO_PCH_SLP_S3 in gpio_map.h.

config PLATFORM_EC_ESPI_VW_SLP_S4
	bool "SLP_S4 is an eSPI virtual wire instead of a GPIO"
	help
	  For power sequencing, use an eSPI virtual wire instead of
	  defining GPIO_PCH_SLP_S4 in gpio_map.h.

config PLATFORM_EC_ESPI_VW_SLP_S5
	bool "SLP_S5 is an eSPI virtual wire instead of an alias for SLP_S4"
	help
	  For power sequencing, use an eSPI virtual wire to read the SLP_S5 line,
	  as opposed to merging it into the same net as SLP_S4.

config PLATFORM_EC_ESPI_RESET_SLP_SX_VW_ON_ESPI_RST
	bool "Reset SLP VW signals on eSPI reset"
	help
	  Enable this config to reset SLP* VW when eSPI_RST is asserted
	  for the Global Reset event case.  Don't enable this config if
	  the platform implements the Deep-Sx entry as EC needs to
	  maintain these pins' states per request. Note that this is
	  currently unimplemented for Zephyr. Please see b/183148073.

config PLATFORM_EC_ESPI_DEFAULT_VW_WIDTH_US
	int "Virtual wire pulse width (microseconds)"
	default 65
	help
	  The minimum pulse width of a eSPI/LPC virtual wire signals to the
	  host. May vary by host chipset.

endif # PLATFORM_EC_HOST_INTERFACE_ESPI
```
