/* -*- mode:c -*-
 *
 * Copyright 2023 The ChromiumOS Authors
 * Use of this source code is governed by a BSD-style license that can be
 * found in the LICENSE file.
 */

/* Declare symbolic names for all the GPIOs that we care about.
 * Note: Those with interrupt handlers must be declared first. */

/* Power State interrupts */
GPIO_INT(SLP_S4_L, PIN(I, 5), GPIO_INT_BOTH, power_signal_interrupt)
GPIO_INT(SLP_S3_L, PIN(H, 3), GPIO_INT_BOTH, baseboard_all_sys_pgood_interrupt)
GPIO_INT(SLP_S0_L, PIN(E, 4), GPIO_INT_BOTH, power_signal_interrupt)
GPIO_INT(SLP_SUS_L, PIN(G, 2), GPIO_INT_BOTH, power_signal_interrupt)
GPIO_INT(VCCIN_AUX_VID0, PIN(D, 0), GPIO_INT_BOTH | GPIO_SEL_1P8V,
	 power_signal_interrupt)
GPIO_INT(VCCIN_AUX_VID1, PIN(K, 1), GPIO_INT_BOTH | GPIO_SEL_1P8V,
	 power_signal_interrupt)
GPIO_INT(RSMRST_PWRGD_L, PIN(E, 1), GPIO_INT_BOTH, power_signal_interrupt)
GPIO_INT(CPU_C10_GATE_L, PIN(G, 1), GPIO_INT_BOTH, power_signal_interrupt)
GPIO_INT(PG_DRAM_OD, PIN(D, 3), GPIO_INT_BOTH,
	 baseboard_all_sys_pgood_interrupt)
GPIO_INT(PG_PP1050_ST_OD, PIN(L, 1), GPIO_INT_BOTH, power_signal_interrupt)
GPIO_INT(EC_VSNS_PP3300_S5, PIN(I, 0), GPIO_INT_BOTH, power_signal_interrupt)
GPIO_INT(PG_VCCIO_EXT_OD, PIN(D, 7), GPIO_INT_BOTH,
	 baseboard_all_sys_pgood_interrupt)
GPIO_INT(ESPI_RESET_L, PIN(D, 2), GPIO_INT_FALLING | GPIO_SEL_1P8V,
	 espi_reset_pin_asserted_interrupt)

GPIO_INT(H1_EC_PWR_BTN_ODL, PIN(E, 2), GPIO_INT_BOTH | GPIO_PULL_UP,
	 power_button_interrupt)
#ifdef CONFIG_LOW_POWER_IDLE
/* Used to wake up the EC from Deep Doze mode when writing to console */
GPIO_INT(UART1_RX, PIN(B, 0), GPIO_INT_BOTH,
	 uart_deepsleep_interrupt) /* UART_DBG_TX_EC_RX
				    */
#endif

/* Other interrupts */
GPIO_INT(EC_WP_OD, PIN(A, 6), GPIO_INT_BOTH, switch_interrupt)
/* Directly connected recovery button */
GPIO_INT(EC_RECOVERY_BTN_OD, PIN(K, 7), GPIO_INT_BOTH, button_interrupt)
/* Recovery button input from H1 */
GPIO_INT(H1_EC_RECOVERY_BTN_ODL, PIN(K, 4), GPIO_INT_BOTH, button_interrupt)
GPIO_INT(BJ_ADP_PRESENT, PIN(A, 7), GPIO_INT_BOTH, adp_connect_interrupt)
GPIO_INT(USB_C0_FAULT_L, PIN(K, 0), GPIO_INT_FALLING, ppc_interrupt)
/* CEC interrupt */
GPIO_INT(HDMI2_CEC_IN, PIN(J, 3), GPIO_INT_BOTH, cec_gpio_interrupt)

/* Power sequence GPIOs */
GPIO(EC_AP_PSYS, PIN(J, 2), GPIO_OUT_LOW)
GPIO(EC_AP_RTCRST, PIN(K, 2), GPIO_OUT_LOW)
GPIO(EC_AP_PWR_BTN_ODL, PIN(B, 6), GPIO_ODR_HIGH)
GPIO(EC_AP_DPWROK, PIN(L, 7), GPIO_OUT_LOW)
GPIO(EC_AP_RSMRST_L, PIN(H, 0), GPIO_OUT_LOW)
GPIO(EC_AP_WAKE_ODL, PIN(D, 5), GPIO_ODR_HIGH)
GPIO(SYS_RST_ODL, PIN(D, 1), GPIO_ODR_HIGH)
GPIO(EC_AP_SYS_PWROK, PIN(F, 2), GPIO_OUT_LOW)
GPIO(PG_PP5000_U_OD, PIN(J, 0), GPIO_INPUT)
GPIO(EN_PP5000_U, PIN(K, 5), GPIO_OUT_HIGH)
GPIO(PG_PP3300_A, PIN(B, 5), GPIO_INPUT)
GPIO(EN_PP3300_A, PIN(C, 5), GPIO_OUT_LOW)
GPIO(EC_AP_PCH_PWROK_OD, PIN(D, 6), GPIO_ODR_LOW)
/* TODO(b:149775160) - Modify if needed if we ever use this signal. */
GPIO(EN_VCCST, PIN(D, 4), GPIO_INPUT)
GPIO(EN_VCCIO_EXT, PIN(B, 2), GPIO_OUT_LOW)
GPIO(EC_PROCHOT_ODL, PIN(I, 1), GPIO_ODR_HIGH | GPIO_SEL_1P8V)
GPIO(EC_AP_VCCST_PWRGD_OD, PIN(E, 5), GPIO_ODR_LOW)
GPIO(ALL_SYS_PWRGD, PIN(B, 7), GPIO_OUT_LOW)
GPIO(EN_PPVAR_BJ_ADP_OD, PIN(E, 3), GPIO_ODR_HIGH)
GPIO(ACK_PPVAR_BJ_ADP_ODL, PIN(A, 0), GPIO_INPUT)

/* Required for icelake chipset code, but implemented through other means for
 * dedede */
UNIMPLEMENTED(AC_PRESENT)
UNIMPLEMENTED(PG_EC_DSW_PWROK)
UNIMPLEMENTED(PG_EC_ALL_SYS_PWRGD)

/* Required for dedede baseboard but not used in taranza */
UNIMPLEMENTED(USB_C0_INT_ODL)
UNIMPLEMENTED(EN_SLP_Z)
UNIMPLEMENTED(EC_BATTERY_PRES_ODL)

/* I2C pins - Alternate function below configures I2C module on these pins */
GPIO(EC_I2C_EEPROM_SCL, PIN(B, 3), GPIO_INPUT)
GPIO(EC_I2C_EEPROM_SDA, PIN(B, 4), GPIO_INPUT)
GPIO(EC_I2C_USB_C0_SCL, PIN(F, 6), GPIO_INPUT)
GPIO(EC_I2C_USB_C0_SDA, PIN(F, 7), GPIO_INPUT)
GPIO(EC_I2C_HDMI1_EDID_SCL, PIN(E, 0), GPIO_INPUT)
GPIO(EC_I2C_HDMI1_EDID_SDA, PIN(E, 7), GPIO_INPUT)
GPIO(EC_I2C_HDMI2_EDID_SCL, PIN(C, 1), GPIO_INPUT)
GPIO(EC_I2C_HDMI2_EDID_SDA, PIN(C, 2), GPIO_INPUT)
GPIO(EC_I2C_HDMI1_SRC_DDC_SCL, PIN(A, 4), GPIO_INPUT)
GPIO(EC_I2C_HDMI1_SRC_DDC_SDA, PIN(A, 5), GPIO_INPUT)
GPIO(EC_I2C_HDMI2_SRC_DDC_SCL, PIN(H, 1), GPIO_INPUT)
GPIO(EC_I2C_HDMI2_SRC_DDC_SDA, PIN(H, 2), GPIO_INPUT)

/* USB pins */
GPIO(EC_AP_USB_C0_HPD, PIN(L, 4), GPIO_OUT_LOW)
GPIO(EN_USB_A0_VBUS, PIN(L, 6), GPIO_OUT_LOW)
GPIO(EN_USB_A1_VBUS, PIN(C, 6), GPIO_OUT_LOW)
GPIO(EN_USB_A2_VBUS, PIN(C, 4), GPIO_OUT_LOW)
GPIO(EN_USB_A3_VBUS, PIN(J, 5), GPIO_OUT_LOW)
GPIO(EN_USB_A4_VBUS, PIN(J, 4), GPIO_OUT_LOW)
GPIO(EC_USB_C0_FRS_EN, PIN(K, 6), GPIO_OUT_LOW)
GPIO(USB_C0_SBU_MUX_FAULT, PIN(I, 7), GPIO_INPUT)

/* MKBP event synchronization */
/* TODO(b/257833880) Check whether this pin is needed */
GPIO(EC_AP_MKBP_INT_L, PIN(L, 5), GPIO_ODR_HIGH)

/* HDMI */
GPIO(HDMI2_CEC, PIN(F, 1), GPIO_ODR_HIGH)
UNIMPLEMENTED(HDMI2_CEC_PULL_UP) /* Pull-up to PP3300_Z1 */
GPIO(HDMI1_SRC_HPD, PIN(F, 3), GPIO_INPUT)
GPIO(HDMI2_SRC_HPD, PIN(KSO_L, 3), GPIO_INPUT)
GPIO(EC_HDMI1_SRC_HPD_OUT, PIN(I, 6), GPIO_OUT_LOW)
GPIO(EC_HDMI2_SRC_HPD_OUT, PIN(KSO_L, 4), GPIO_OUT_LOW)
GPIO(HDMI1_EDID_SEL, PIN(J, 1), GPIO_OUT_LOW)
GPIO(HDMI2_EDID_SEL, PIN(KSO_L, 5), GPIO_OUT_LOW)
GPIO(EDID_BTN_ODL, PIN(C, 3), GPIO_INPUT)
GPIO(EC_EN_PP5000_HDMI1, PIN(KSO_L, 6), GPIO_OUT_LOW)
GPIO(EC_EN_PP5000_HDMI2, PIN(KSO_L, 7), GPIO_OUT_LOW)

/* Misc */
GPIO(EC_ENTERING_RW, PIN(C, 7), GPIO_OUT_LOW)
GPIO(CCD_MODE_ODL, PIN(H, 5), GPIO_ODR_HIGH)
GPIO(ECH1_PACKET_MODE, PIN(C, 0), GPIO_OUT_LOW)
GPIO(EN_RS232_X, PIN(E, 6), GPIO_OUT_LOW)
GPIO(UART0_RX, PIN(B, 1), GPIO_OUT_LOW) /* UART_EC_TX_DBG_RX */

/* LED */
GPIO(LED_W_ODL, PIN(A, 2), GPIO_OUT_HIGH)

/* NC pins, enable internal pull-down to avoid floating state. */
GPIO(GPIOG0_NC, PIN(G, 0), GPIO_INPUT | GPIO_PULL_DOWN)
GPIO(GPIOG3_NC, PIN(G, 3), GPIO_INPUT | GPIO_PULL_DOWN)
GPIO(GPIOG4_NC, PIN(G, 4), GPIO_INPUT | GPIO_PULL_DOWN)
GPIO(GPIOG5_NC, PIN(G, 5), GPIO_INPUT | GPIO_PULL_DOWN)
GPIO(GPIOG6_NC, PIN(G, 6), GPIO_INPUT | GPIO_PULL_DOWN)
GPIO(GPIOG7_NC, PIN(G, 7), GPIO_INPUT | GPIO_PULL_DOWN)
GPIO(GPIOH4_NC, PIN(H, 4), GPIO_INPUT | GPIO_PULL_DOWN)
GPIO(GPIOH6_NC, PIN(H, 6), GPIO_INPUT | GPIO_PULL_DOWN)
GPIO(GPIOI4_NC, PIN(I, 4), GPIO_INPUT | GPIO_PULL_DOWN)
GPIO(GPIOJ6_NC, PIN(J, 6), GPIO_INPUT | GPIO_PULL_DOWN)
GPIO(GPIOK3_NC, PIN(K, 3), GPIO_INPUT | GPIO_PULL_DOWN)
GPIO(GPIOM6_NC, PIN(M, 6), GPIO_INPUT | GPIO_PULL_DOWN)
GPIO(GPIOA1_NC, PIN(A, 1), GPIO_INPUT | GPIO_PULL_DOWN)
GPIO(GPIOA3_NC, PIN(A, 3), GPIO_INPUT | GPIO_PULL_DOWN)

/* Alternate functions GPIO definitions */
/* UART */
ALTERNATE(PIN_MASK(B, BIT(0) | BIT(1)), 0, MODULE_UART, 0) /* UART for debug */

/* I2C */
ALTERNATE(PIN_MASK(B, BIT(3) | BIT(4)), 0, MODULE_I2C, 0) /* I2C0 - EEPROM */
ALTERNATE(PIN_MASK(C, BIT(1) | BIT(2)), 0, MODULE_I2C, 0) /* I2C1 - HDMI2_EDID
							   */
ALTERNATE(PIN_MASK(F, BIT(6) | BIT(7)), 0, MODULE_I2C, 0) /* I2C2 - USB_C0 */
ALTERNATE(PIN_MASK(E, BIT(0) | BIT(7)), 0, MODULE_I2C, 0) /* I2C4 - HDMI1_EDID
							   */
ALTERNATE(PIN_MASK(A, BIT(4) | BIT(5)), 0, MODULE_I2C, 0) /* I2C5 -
							     HDMI1_SRC_DDC */
ALTERNATE(PIN_MASK(H, BIT(1) | BIT(2)), 0, MODULE_I2C, 0) /* I2C3 -
							     HDMI2_SRC_DDC */

/* ADC */
/* ADC2: TEMP_SENSOR_1, ADC3: TEMP_SENSOR_2, ADC4: VBUS */
ALTERNATE(PIN_MASK(I, BIT(2) | BIT(3) | BIT(4)), 0, MODULE_ADC, 0)
/*
 * ADC13: TEMP_SENSOR_3
 * ADC15: ANALOG_PPVAR_PWR_IN_IMON
 * ADC16: SNS_PPVAR_PWR_IN
 */
ALTERNATE(PIN_MASK(L, BIT(0) | BIT(2) | BIT(3)), 0, MODULE_ADC, 0)

/* PWM */
/* LED_W_ODL GPIOA2/PWM2 */
ALTERNATE(PIN_MASK(A, BIT(2)), 0, MODULE_PWM, 0)

/* CEC */
ALTERNATE(PIN_MASK(F, BIT(0)), 0, MODULE_CEC, 0)
