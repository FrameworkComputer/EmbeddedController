## CMakeLists.txt
```
# Copyright 2022 The ChromiumOS Authors
# Use of this source code is governed by a BSD-style license that can be
# found in the LICENSE file.

cmake_minimum_required(VERSION 3.20.0)

# Create the library
if(BOARD STREQUAL "unit_testing" OR BOARD STREQUAL "unit_testing/unit_testing")
  find_package(Zephyr COMPONENTS unittest REQUIRED HINTS $ENV{ZEPHYR_BASE})
  add_library(spi_flash_reg)
else()
  zephyr_library_named(spi_flash_reg)
  target_link_libraries(spi_flash_reg PRIVATE cros_ec_interface)
  # When LTO is enabled, enable only for the "app" library, which compiles
  # and links all Chromium OS sources.
  # TODO: Enable LTO for all sources when Zephyr supports it.
  # See https://github.com/zephyrproject-rtos/zephyr/issues/2112
  if (DEFINED CONFIG_PLATFORM_EC_LTO)
    # The Zephyr toolchain generates linker errors if both CONFIG_LTO and
    # CONFIG_FPU are used. See b/184302085.
    if(("${ZEPHYR_TOOLCHAIN_VARIANT}" STREQUAL "zephyr") AND
     (DEFINED CONFIG_FPU))
      message(STATUS "Zephyr toolchain and CONFIG_FPU detected: disabling LTO")
    else()
      set_property(
        TARGET
          spi_flash_reg
        PROPERTY
          INTERPROCEDURAL_OPTIMIZATION True
      )
    endif()
  endif()
endif()

# Add the sources
target_sources(spi_flash_reg
  PRIVATE
    src/spi_flash_reg.c
  PUBLIC
    public/spi_flash_reg.h
)

# Include the public directory
target_include_directories(spi_flash_reg PUBLIC public)

if(BOARD STREQUAL "unit_testing" OR BOARD STREQUAL "unit_testing/unit_testing")
  project(flash_reg)

  # Set the sources for the test
  target_sources(testbinary PRIVATE src/spi_flash_reg_test.c)

  # Link the library being tested
  target_link_libraries(testbinary PRIVATE spi_flash_reg)

  # Add the private directory used to mock components of the EC
  target_include_directories(testbinary PRIVATE private)
  target_include_directories(spi_flash_reg PRIVATE private)

  # Zephyr's unittest also generates a test_interface which we need in the
  # library (not just in the test binary)
  target_link_libraries(spi_flash_reg PRIVATE test_interface)
  string(TOLOWER "${CMAKE_C_COMPILER_ID}" lowercase_compiler_id)
  if("${lowercase_compiler_id}" STREQUAL "clang")
    target_link_options(testbinary PRIVATE -fprofile-instr-generate)
  endif()

  # W25Q64 has 0x400000 bytes as the first section, setting
  # CONFIG_FLASH_SIZE_BYTES to that allows us to test every branch of
  # spi_flash_reg.c
  add_compile_definitions(spi_flash_reg
    PUBLIC
      CONFIG_SPI_FLASH_W25Q64
      CONFIG_FLASH_SIZE_BYTES=4194304
  )
endif()
```

## prj.conf
```kconfig
# Copyright 2022 The ChromiumOS Authors
# Use of this source code is governed by a BSD-style license that can be
# found in the LICENSE file.

CONFIG_ZTEST=y
```

## src/spi_flash_reg.c
```c
/*
 * Copyright 2015 The ChromiumOS Authors
 * Use of this source code is governed by a BSD-style license that can be
 * found in the LICENSE file.
 *
 * SPI flash protection register translation functions for Chrome OS EC.
 */

#include "common.h"
#include "spi_flash_reg.h"
#include "util.h"

/* Bit state for protect range table */
enum bit_state {
	OFF = 0,
	ON = 1,
	IGN = -1, /* Don't care / Ignore */
};

struct protect_range {
	enum bit_state cmp;
	enum bit_state sec;
	enum bit_state tb;
	enum bit_state bp[3]; /* Ordered {BP2, BP1, BP0} */
	uint32_t protect_start;
	uint32_t protect_len;
};

/* Compare macro for (x =? b) for 'IGN' comparison */
#define COMPARE_BIT(a, b) ((a) != IGN && (a) != !!(b))
/* Assignment macro where 'IGN' = 0 */
#define GET_BIT(a) ((a) == IGN ? 0 : (a))

/*
 * Define flags and protect table for each SPI ROM part. It's not necessary
 * to define all ranges in the datasheet since we'll usually protect only
 * none or half of the ROM. The table is searched sequentially, so ordering
 * according to likely configurations improves performance slightly.
 */
#if defined(CONFIG_SPI_FLASH_W25X40) || defined(CONFIG_SPI_FLASH_GD25Q41B)
static const struct protect_range spi_flash_protect_ranges[] = {
	{ IGN, IGN, IGN, { 0, 0, 0 }, 0, 0 }, /* No protection */
	{ IGN, IGN, 1, { 0, 1, 1 }, 0, 0x40000 }, /* Lower 1/2 */
	{ IGN, IGN, 1, { 0, 1, 0 }, 0, 0x20000 }, /* Lower 1/4 */
};

#elif defined(CONFIG_SPI_FLASH_W25Q40) || defined(CONFIG_SPI_FLASH_GD25LQ40)
/* Verified for W25Q40BV and W25Q40EW */
/* For GD25LQ40, BP3 and BP4 have same meaning as TB and SEC */
static const struct protect_range spi_flash_protect_ranges[] = {
	/* CMP = 0 */
	{ 0, IGN, IGN, { 0, 0, 0 }, 0, 0 }, /* No protection */
	{ 0, 0, 1, { 0, 1, 0 }, 0, 0x20000 }, /* Lower 1/4 */
	{ 0, 0, 1, { 0, 1, 1 }, 0, 0x40000 }, /* Lower 1/2 */
	/* CMP = 1 */
	{ 1, 0, 0, { 0, 1, 1 }, 0, 0x40000 }, /* Lower 1/2 */
	{ 1, 0, IGN, { 1, IGN, IGN }, 0, 0 }, /* None (W25Q40EW only) */
};

#elif defined(CONFIG_SPI_FLASH_W25Q64)
static const struct protect_range spi_flash_protect_ranges[] = {
	{ 0, IGN, IGN, { 0, 0, 0 }, 0, 0 }, /* No protection */
	{ 0, 0, 1, { 1, 1, 0 }, 0, 0x400000 }, /* Lower 1/2 */
	{ 0, 0, 1, { 1, 0, 1 }, 0, 0x200000 }, /* Lower 1/4 */
};

#elif defined(CONFIG_SPI_FLASH_W25Q80)
static const struct protect_range spi_flash_protect_ranges[] = {
	/* CMP = 0 */
	{ 0, IGN, IGN, { 0, 0, 0 }, 0, 0 }, /* No protection */
	{ 0, 0, 1, { 0, 1, 0 }, 0, 0x20000 }, /* Lower 1/8 */
	{ 0, 0, 1, { 0, 1, 1 }, 0, 0x40000 }, /* Lower 1/4 */
	{ 0, 0, 1, { 1, 0, 0 }, 0, 0x80000 }, /* Lower 1/2 */
};
#elif defined(CONFIG_SPI_FLASH_W25Q128)
static const struct protect_range spi_flash_protect_ranges[] = {
	/* CMP = 0 */
	{ 0, IGN, IGN, { 0, 0, 0 }, 0, 0 }, /* No protection */
	{ 0, 0, 1, { 1, 0, 0 }, 0, 0x20000 }, /* Lower 1/8 */
	{ 0, 0, 1, { 1, 0, 1 }, 0, 0x40000 }, /* Lower 1/4 */
	{ 0, 0, 1, { 1, 1, 0 }, 0, 0x80000 }, /* Lower 1/2 */
};
#endif

/**
 * Computes block write protection range from registers
 * Returns start == len == 0 for no protection
 *
 * @param sr1 Status register 1
 * @param sr2 Status register 2
 * @param start Output pointer for protection start offset
 * @param len Output pointer for protection length
 *
 * @return EC_SUCCESS, or non-zero if any error.
 */
int spi_flash_reg_to_protect(uint8_t sr1, uint8_t sr2, unsigned int *start,
			     unsigned int *len)
{
	const struct protect_range *range;
	int i;
	uint8_t cmp;
	uint8_t sec;
	uint8_t tb;
	uint8_t bp;

	/* Determine flags */
	cmp = (sr2 & SPI_FLASH_SR2_CMP) ? 1 : 0;
	sec = (sr1 & SPI_FLASH_SR1_SEC) ? 1 : 0;
	tb = (sr1 & SPI_FLASH_SR1_TB) ? 1 : 0;
	bp = (sr1 &
	      (SPI_FLASH_SR1_BP2 | SPI_FLASH_SR1_BP1 | SPI_FLASH_SR1_BP0)) >>
	     2;

	/* Bad pointers or invalid data */
	if (!start || !len || sr1 == 0xff || sr2 == 0xff)
		return EC_ERROR_INVAL;

	for (i = 0; i < ARRAY_SIZE(spi_flash_protect_ranges); ++i) {
		range = &spi_flash_protect_ranges[i];
		if (COMPARE_BIT(range->cmp, cmp))
			continue;
		if (COMPARE_BIT(range->sec, sec))
			continue;
		if (COMPARE_BIT(range->tb, tb))
			continue;
		if (COMPARE_BIT(range->bp[0], bp & 0x4))
			continue;
		if (COMPARE_BIT(range->bp[1], bp & 0x2))
			continue;
		if (COMPARE_BIT(range->bp[2], bp & 0x1))
			continue;

		*start = range->protect_start;
		*len = range->protect_len;
		return EC_SUCCESS;
	}

	/* Invalid range, or valid range missing from our table */
	return EC_ERROR_INVAL;
}

/**
 * Computes block write protection registers from range
 *
 * @param start Desired protection start offset
 * @param len Desired protection length
 * @param sr1 Output pointer for status register 1
 * @param sr2 Output pointer for status register 2
 *
 * @return EC_SUCCESS, or non-zero if any error.
 */
int spi_flash_protect_to_reg(unsigned int start, unsigned int len, uint8_t *sr1,
			     uint8_t *sr2)
{
	const struct protect_range *range;
	int i;
	char cmp = 0;
	char sec = 0;
	char tb = 0;
	char bp = 0;

	/* Bad pointers */
	if (!sr1 || !sr2)
		return EC_ERROR_INVAL;

	/* Invalid data */
	if ((start && !len) || start + len > CONFIG_FLASH_SIZE_BYTES)
		return EC_ERROR_INVAL;

	for (i = 0; i < ARRAY_SIZE(spi_flash_protect_ranges); ++i) {
		range = &spi_flash_protect_ranges[i];
		if (range->protect_start == start &&
		    range->protect_len == len) {
			cmp = GET_BIT(range->cmp);
			sec = GET_BIT(range->sec);
			tb = GET_BIT(range->tb);
			bp = GET_BIT(range->bp[0]) << 2 |
			     GET_BIT(range->bp[1]) << 1 | GET_BIT(range->bp[2]);

			*sr1 = (sec ? SPI_FLASH_SR1_SEC : 0) |
			       (tb ? SPI_FLASH_SR1_TB : 0) | (bp << 2);
			*sr2 = (cmp ? SPI_FLASH_SR2_CMP : 0);
			return EC_SUCCESS;
		}
	}

	/* Invalid range, or valid range missing from our table */
	return EC_ERROR_INVAL;
}
```

## src/spi_flash_reg_test.c
```c
/* Copyright 2022 The ChromiumOS Authors
 * Use of this source code is governed by a BSD-style license that can be
 * found in the LICENSE file.
 */

#include <zephyr/ztest.h>

#include "common.h"
#include "spi_flash_reg.h"

ZTEST_SUITE(flash_reg_to_protect, NULL, NULL, NULL, NULL, NULL);

ZTEST(flash_reg_to_protect, test_invalid_args)
{
	unsigned int start = 0;
	unsigned int len = 0;

	zassert_equal(EC_ERROR_INVAL,
		      spi_flash_reg_to_protect(0, 0, NULL, &len));
	zassert_equal(EC_ERROR_INVAL,
		      spi_flash_reg_to_protect(0, 0, &start, NULL));
	zassert_equal(EC_ERROR_INVAL,
		      spi_flash_reg_to_protect(0xff, 0, &start, &len));
	zassert_equal(EC_ERROR_INVAL,
		      spi_flash_reg_to_protect(0, 0xff, &start, &len));
}

ZTEST(flash_reg_to_protect, test_no_matching_range)
{
	unsigned int start = 0;
	unsigned int len = 0;

	/* Bad SR1 */
	zassert_equal(EC_ERROR_INVAL,
		      spi_flash_reg_to_protect(SPI_FLASH_SR1_BP0, 0, &start,
					       &len));
	zassert_equal(EC_ERROR_INVAL,
		      spi_flash_reg_to_protect(SPI_FLASH_SR1_BP1, 0, &start,
					       &len));
	zassert_equal(EC_ERROR_INVAL,
		      spi_flash_reg_to_protect(SPI_FLASH_SR1_BP2, 0, &start,
					       &len));

	/* BAD SR2 */
	zassert_equal(EC_ERROR_INVAL, spi_flash_reg_to_protect(
					      SPI_FLASH_SR1_BP0,
					      SPI_FLASH_SR2_CMP, &start, &len));
	zassert_equal(EC_ERROR_INVAL,
		      spi_flash_reg_to_protect(SPI_FLASH_SR1_SEC |
						       SPI_FLASH_SR1_BP0,
					       0, &start, &len));
}

ZTEST(flash_reg_to_protect, test_matching_range)
{
	unsigned int start = 0;
	unsigned int len = 0;

	zassert_equal(EC_SUCCESS, spi_flash_reg_to_protect(0, 0, &start, &len));
	zassert_equal(0, start);
	zassert_equal(0, len);
}

ZTEST_SUITE(flash_protect_to_reg, NULL, NULL, NULL, NULL, NULL);

ZTEST(flash_protect_to_reg, test_invalid_args)
{
	uint8_t sr1;
	uint8_t sr2;

	zassert_equal(EC_ERROR_INVAL,
		      spi_flash_protect_to_reg(0, 0, NULL, &sr2));
	zassert_equal(EC_ERROR_INVAL,
		      spi_flash_protect_to_reg(0, 0, &sr1, NULL));
	zassert_equal(EC_ERROR_INVAL,
		      spi_flash_protect_to_reg(128, 0, &sr1, &sr2));
	zassert_equal(EC_ERROR_INVAL,
		      spi_flash_protect_to_reg(128, CONFIG_FLASH_SIZE_BYTES,
					       &sr1, &sr2));
	zassert_equal(EC_ERROR_INVAL,
		      spi_flash_protect_to_reg(128, 128, &sr1, &sr2));
}

ZTEST(flash_protect_to_reg, test_matching_range)
{
	uint8_t sr1;
	uint8_t sr2;

	zassert_equal(EC_SUCCESS,
		      spi_flash_protect_to_reg(0, 0x400000, &sr1, &sr2));
	zassert_equal(0x38, sr1, "Expected 0x38, but got 0x%02x", sr1);
	zassert_equal(0x00, sr2, "Expected 0x00, but got 0x%02x", sr2);

	zassert_equal(EC_SUCCESS,
		      spi_flash_protect_to_reg(0, 0x200000, &sr1, &sr2));
	zassert_equal(0x34, sr1, "Expected 0x38, but got 0x%02x", sr1);
	zassert_equal(0x00, sr2, "Expected 0x00, but got 0x%02x", sr2);
}
```
