## zephyr/boards/google/it8xxx2/Kconfig.defconfig
```kconfig
# Copyright 2021 The ChromiumOS Authors
# Use of this source code is governed by a BSD-style license that can be
# found in the LICENSE file.

if BOARD_IT8XXX2

config CROS_EC_HOOK_TICK_INTERVAL
	default 500000

config SYS_CLOCK_HW_CYCLES_PER_SEC
	default 32768

config SYS_CLOCK_TICKS_PER_SEC
	default 32768

if ADC
config PLATFORM_EC_ADC_RESOLUTION
	default 10
endif # ADC

if CONSOLE
config UART_CONSOLE
	default y
	depends on SERIAL
endif # CONSOLE

if FLASH
config PLATFORM_EC_CONSOLE_CMD_FLASH
	default y
endif # FLASH

if SERIAL
config UART_INTERRUPT_DRIVEN
	default y
endif # SERIAL

if WATCHDOG
config PLATFORM_EC_WATCHDOG_PERIOD_MS
	default 2500
config WDT_ITE_WARNING_LEADING_TIME_MS
	default 500
config WDT_ITE_REDUCE_WARNING_LEADING_TIME
	default y
endif # WATCHDOG

if PLATFORM_EC_VBOOT_HASH
config SOC_IT8XXX2_SHA256_HW_ACCELERATE
	default y
choice PLATFORM_EC_SHA256_MODE
	default PLATFORM_EC_SHA256_HW_ACCELERATE if SOC_IT8XXX2_SHA256_HW_ACCELERATE
endchoice
endif # PLATFORM_EC_VBOOT_HASH

if SRAM_SIZE >= 128
config LTO
	default n

config SOC_IT8XXX2_SERIAL_IN_RAM
	default y if !LTO

config SOC_IT8XXX2_KERNEL_IN_RAM
	default y if !LTO

config SOC_IT8XXX2_ZEPHYR_IN_RAM
	default y if !LTO
endif # SRAM_SIZE

endif # BOARD_IT8XXX2
```

## zephyr/boards/google/it8xxx2/board.yml
```yaml
board:
  name: it8xxx2
  full_name: IT8xxx2 EC
  vendor: google
  socs:
    - name: it81202bx
    - name: it81202cx
    - name: it81202dx
    - name: it81302bx
    - name: it81302cx
    - name: it81302dx
    - name: it82000bw
    - name: it82002aw
    - name: it82002bw
    - name: it82202ax
      variants:
        - name: "512"
    - name: it82302ax
    - name: it82202bw
    - name: it82302bw
```

## zephyr/boards/google/mec172x/board.yml
```yaml
board:
  name: mec172x
  full_name: MEC172x EC
  vendor: google
  socs:
  - name: mec172x_nsz
    variants:
    - name: mec1723
    - name: mec1727
```

## zephyr/boards/google/npcx7/board.yml
```yaml
board:
  name: npcx7
  full_name: NPCX7 EC
  vendor: google
  socs:
  - name: npcx7m7fc
```

## zephyr/boards/google/npcx9/board.yml
```yaml
board:
  name: npcx9
  full_name: NPCX9 EC
  vendor: google
  socs:
  - name: npcx9m3f
  - name: npcx9m7f
  - name: npcx9m7fb
```

## zephyr/boards/google/realtek/Kconfig.defconfig
```kconfig
# Copyright 2025 The ChromiumOS Authors
# Use of this source code is governed by a BSD-style license that can be
# found in the LICENSE file.

config UART_NS16550_WA_ISR_REENABLE_INTERRUPT
	default y
	depends on UART_NS16550

if REALTEK_RTS5912_RTMR

config PM
	default y

config SYS_CLOCK_HW_CYCLES_PER_SEC
	default 32768

config SYS_CLOCK_TICKS_PER_SEC
	default 32768

endif # REALTEK_RTS5912_RTMR

if WATCHDOG

config PLATFORM_EC_WATCHDOG_HELPER
	default y

config WDT_COUNTER
	default y

endif # WATCHDOG

if ADC

config PLATFORM_EC_ADC_RESOLUTION
	default 12

endif # ADC
```

## zephyr/boards/google/realtek/board.yml
```yaml
board:
  name: realtek
  full_name: Realtek EC
  vendor: google
  socs:
    - name: rts5912
```

## zephyr/boards/google/realtek/realtek_rts5912_defconfig
```kconfig
# Copyright 2025 The ChromiumOS Authors
# Use of this source code is governed by a BSD-style license that can be
# found in the LICENSE file.

# Enable RTS5912 image tool
CONFIG_REALTEK_RTS5912_BOOTROM_HEADER=y
CONFIG_RTS5912_DEBUG_SWJ=n

# Console
CONFIG_CONSOLE=y
CONFIG_UART_CONSOLE=y

# Shell features
CONFIG_SHELL_HISTORY_BUFFER=256
CONFIG_SHELL_BACKEND_SERIAL_INTERRUPT_DRIVEN=y

# GPIO Controller
CONFIG_GPIO=y
CONFIG_GPIO_GET_CONFIG=y

# Clock Controller
CONFIG_CLOCK_CONTROL=y

# Serial Drivers
CONFIG_SERIAL=y

# WATCHDOG configuration
CONFIG_WATCHDOG=y
CONFIG_REBOOT=y

# BBRAM
CONFIG_BBRAM=y

CONFIG_FLASH=y
CONFIG_PLATFORM_EC_CONSOLE_CMD_FLASH=y
CONFIG_FLASH_EX_OP_ENABLED=y
```

## zephyr/boards/nuvoton/npcx_evb/board.yml
```yaml
board:
  name: npcx_evb
  full_name: NPCX EVB
  vendor: nuvoton
  socs:
  - name: npcx7m6fc
  - name: npcx9m6f
```

## zephyr/chip/Kconfig
```kconfig
# Copyright 2026 The ChromiumOS Authors
# Use of this source code is governed by a BSD-style license that can be
# found in the LICENSE file.

config MCHP_SECOND_LOADER_BINARY
	bool "Build Microchip second loader binary"
	default y if SOC_FAMILY_MICROCHIP_MEC
	help
	  This option enables building the second_loader.bin binary used
	  by the Microchip EC UART flashing procedure.

config NPCX_MONITOR_BINARY
	bool "Build Nuvoton monitor binary"
	help
	  This option enables building the npcx_monitor.bin binary used
	  by the Nuvoton EC UART flashing procedure.

config RTK_FLAME_BINARY
	bool "Build Realtek monitor binary"
	help
	  This option enables building the rts5915_flash_upload.bin binary used
	  by the Realtek EC UART flashing procedure.
```
