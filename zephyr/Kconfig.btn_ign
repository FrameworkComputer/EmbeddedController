## zephyr/Kconfig.usbc
```kconfig
# Copyright 2020 The ChromiumOS Authors
# Use of this source code is governed by a BSD-style license that can be
# found in the LICENSE file.

menuconfig PLATFORM_EC_USBC
	bool "USB Type-C"
	default y if PLATFORM_EC_BATTERY && !PLATFORM_EC_BATTERY_CHARGING_OFFLOAD_TO_AP
	depends on PLATFORM_EC_MATH_UTIL
	help
	  Enable this to support various USB Type-C features chosen by the
	  options below. USB-C is widely used on modern Chromebooks and the EC's
	  role is to negotiate power contracts (for sourcing or sinking power
	  over USB). The EC is also responsible for discovering the capabilities
	  of attached USB-C partners and enabling alternate operational modes,
	  including Display Port, Thunderbolt, and USB4.

config TEST_DISABLE_PLATFORM_EC_USBC
	bool "Test disable USB type-C"
	depends on ZTEST && !PLATFORM_EC_USBC
	help
	  Use this config to allow tests for code that doesn't actually rely on
	  USBC.

rsource "Kconfig.retimer"
rsource "Kconfig.pd_meas_vbus"

config PLATFORM_EC_USBC_STUB
	bool
	default y if !PLATFORM_EC_USBC
	help
	  This is a helper symbol that indicates no USB-C stack is configured.
	  The application compiles in a stub USB-C implementation when this
	  symbol is defined.

if PLATFORM_EC_USBC

rsource "Kconfig.pd_int_shared"
rsource "Kconfig.pd_discharge"
rsource "Kconfig.pd_vbus_detection"
rsource "Kconfig.pd_console_cmd"
rsource "Kconfig.pd_host_cmd"
rsource "Kconfig.pd_usbc_device_type"
rsource "Kconfig.pd"
rsource "Kconfig.usb_mux"
rsource "Kconfig.usbc_ss_mux"
rsource "Kconfig.usbc_common_altmode"
rsource "Kconfig.usb_charger"

choice PLATFORM_EC_USBC_STACK
	prompt "USB-C Power Delivery stack type"
	default PLATFORM_EC_USB_PD_TCPMV2
	help
	   This symbol selects the USB-C power delivery stack implemtation used
	   on the ChromiumOS EC.

config PLATFORM_EC_USB_PD_TCPMV2
	bool "USB-C Power Delivery TCPM Version 2"
	help
	  Enable USB-C Power Delivery Type-C Port Manager Version 2. It
	  implements a layered, state-based design which tracks more closely
	  with the USB Type-C and USB PD specifications.

config PLATFORM_EC_USB_PD_CONTROLLER
	bool "USB-C Power Delivery Controller"
	help
	  Enable USB-C Power Delivery Controller. It provides
	  Type-C/PD functionality via a Power Delivery Controller Chip.
endchoice

if PLATFORM_EC_USB_PD_TCPMV2
rsource "Kconfig.ppc"
rsource "Kconfig.tcpm"
rsource "Kconfig.pd_frs"
endif # PLATFORM_EC_USB_PD_TCPMV2

config PLATFORM_EC_TCPC_INTERRUPT
	bool "Enables tcpc driver"
	default y
	help
	  By default, the tcpc driver is automatically enabled and will
	  initialize using the devicetree configs. Disable to stop tcpc
	  interrupt callbacks from being generated and save space on flash if a
	  custom driver is used instead.

config PLATFORM_EC_USBC_OCP
	bool
	help
	  USB-C overcurrent protection: Enable this to detect when a connected
	  USB-C partner draws too much power from the Chromebook and
	  automatically shut off power to the USB-C partner.

	  This should be enabled by drivers which can detect over-current. It
	  cannot be set otherwise, even in prj.conf

config PLATFORM_EC_USB_PID
	hex "USB Product ID"
	default 0
	help
	  Each platform (e.g. baseboard set) should have a single VID/PID
	  combination. If there is a big enough change within a platform,
	  then we can differentiate USB topologies by varying the hardware
	  version field in the Sink and Source Capabilities Extended messages.

	  To reserve a new PID within Google, use go/usb and see
	  http://google3/hardware/standards/usb

config PLATFORM_EC_USB_BCD_DEV
	hex "USB Device ID"
	default 0
	help
	  This specifies the USB device version, reported by board when acting
	  as the upstream facing port (UFP). This is a 16-bit unsigned integer
	  and should be set to a version number relevant to the release version
	  of the product.

config PLATFORM_EC_USB_VID
	hex "USB Vendor ID"
	default 0x18d1
	help
	  This specifies the USB vendor ID used for boards which expose a
	  USB endpoint when the port is in UFP mode. The default value is
	  set to Google's assigned VID and typically would not need to be
	  changed. But, in certain cases this may need to be changed to
	  match an OEM's vendor ID.

config PLATFORM_EC_USB_MAX_CONTROL_PACKET_SIZE
	int "USB control endpoint max transfer size"
	default 64
	help
	  This controls the amount of USB memory dedicated to the control
	  endpoint, by specifying the maximum number of bytes in a packet
	  to/from this endpoint.  Valid values: 8, 16, 32, 64.

config PLATFORM_EC_USB_MS_EXTENDED_COMPAT_ID_DESCRIPTOR
	bool "USB MS Extended Compat ID Feature Descriptor"
	help
	  This enables USB-EP to contain a MS Windows USB string descriptor
	  which is then used by MS Windows to request a Extended Compatible
	  ID Feature descriptor so that Windows will know to load its WINUSB
	  driver.

config PLATFORM_EC_USB_PD_TCPC_LOW_POWER
	bool "Allow Type-C Port Controller to enter low-power mode"
	default y
	help
	  Allows entry to a low power mode when the USB port is idle.
	  When enabled, an enter_low_power_mode member is present in tcpm_drv
	  and should be set to a function that selects that mode, such as
	  tcpci_enter_low_power_mode() for TCPCI-compatible TCPCs.

config PLATFORM_EC_USB_PD_TCPC_LPM_EXIT_DEBOUNCE_US
	int "Debounce delay when exiting low-power mode (uS)"
	depends on PLATFORM_EC_USB_PD_TCPC_LOW_POWER
	default 25000
	help
	  Some TCPCs need additional time following a VBUS change to internally
	  debounce the CC line status and update the CC_STATUS register. This
	  is the delay in microseconds to allow before checking the CC line
	  status in the EC.

config PLATFORM_EC_USB_PD_TCPC_VCONN
	bool "If VCONN is enabled, the TCPC will provide VCONN"
	default y if !PLATFORM_EC_USBC_PPC_SYV682X
	default y if PLATFORM_EC_USB_PD_TCPM_ITE_ON_CHIP
	default y if PLATFORM_EC_USBC_PPC_SYV682X_NO_CC
	help
	  Source USB Type-C connector voltage (VCONN) from the Type-C Port
	  Controller (TCPC), and also the Power Path Controller (PPC) if
	  present. Some TCPC/PPC can't handle 5V on its host-side CC pins, so
          disable this config in those cases.

config PLATFORM_EC_USB_PD_CLEAR_HARD_RESET_STATUS
	bool "Clear PD hard reset status when PD setup completes"
	default y if SOC_SERIES_IT8XXX2
	help
	  Enabling this config will clear the Hard Reset event status
	  after the PD connection is finished initialization,
	  to avoid the AP getting a stale event notification.

	  The detection of a PD Hard Reset sets an status flag that
	  is then read by the AP in order to reset the USB muxes.
	  However by the time this is read, the connection may
	  have been re-initialized and is ready, but the AP may
	  process the hard reset as if it were still current,
	  causing the USB port to be incorrectly disabled.
	  The hard reset of the PD connection can be triggered
	  when the EC is detected as being initially powered on
	  (as opposed to being reset), to force clearing the connection.

	  This config is set by default for the IT8XXX2 EC, which
	  cannot distinguish between a reset and power-on, so a power-on
	  is assumed, which leads to the PD hard reset when the EC
	  undergoes a reset (such as when entering recovery mode).

config PLATFORM_EC_CONSOLE_CMD_PPC_DUMP
	bool "Console command: ppc_dump"
	depends on PLATFORM_EC_USBC_PPC
	default y
	help
	  Allows dumping of the Power Path Controller (PPC) state, which is
	  basically a list of registers and their values. The actual dump
	  function is driver-specific (the reg_dump member of ppc_drv). By
	  reference to the datasheet for the part this can help you figure out
	  what is going on.

config PLATFORM_EC_USBC_PPC_LOGGING
	bool "Enable PPC Related logging"
	depends on PLATFORM_EC_USBC_PPC
	default y
	help
	  PPC drivers use two print functions for logging error messages
	  (ppc_prints and ppc_err_prints). Setting this config adds the
	  CPRINTS call to both of these function which will enable PPC
	  related logging but increase EC image size.

config PLATFORM_EC_USB_PD_PULLUP
	int "Default source Rp value"
	default 1
	help
	  Default pull-up value on the USB-C ports when they are used as source.
	  Valid values are 0 (USB default current), 1 (1.5A), and 2 (3.0A). See
	  enum tcpc_rp_value.

config PLATFORM_EC_USB_PD_ONLY_FIXED_PDOS
	bool "Only support FIXED type PDOs"
	help
	  Ignore all non-fixed PDOs received from a src_caps message. Enable
	  this for boards (like servo_v4) which only support FIXED PDO types.

# Define power related settings here for now to allow projects to overwrite
# them. Ideally they would be defined in the devicetree.
config PLATFORM_EC_USB_PD_OPERATING_POWER_MW
	int "PD operating power in milliwatt"
	default 15000
	help
	  Base configuration for PD power operating power value, which is used
	  in PD negotiation. The final PD parameter used in negotiation is
	  affected by PLATFORM_EC_USB_PD_MAX_POWER_MW,
	  PLATFORM_EC_USB_PD_MAX_CURRENT_MA, and PLATFORM_EC_USB_PD_MAX_VOLTAGE_MV.
	  Increase this value is the system requires more than 15 watts to boot
	  without a battery.

config PLATFORM_EC_USB_PD_MAX_POWER_MW
	int "PD maximum power in milliwatt"
	default 60000
	help
	  The maximum PD negotiated power for the system. The value should match
	  with configured PLATFORM_EC_USB_PD_MAX_CURRENT_MA and
	  PLATFORM_EC_USB_PD_MAX_VOLTAGE_MV.

config PLATFORM_EC_USB_PD_MAX_CURRENT_MA
	int "PD maximum current in milliampere"
	default 3000
	help
	  The maximum PD negotiated current for the system. The value should
	  match with configured PLATFORM_EC_USB_PD_MAX_POWER_MW and
	  PLATFORM_EC_USB_PD_MAX_VOLTAGE_MV.

config PLATFORM_EC_USB_PD_MAX_VOLTAGE_MV
	int "PD maximum voltage in millivolt"
	default 20000
	help
	  The maximum PD negotiated voltage for the system. The value should
	  match with configured PLATFORM_EC_USB_PD_MAX_POWER_MW and
	  PLATFORM_EC_USB_PD_MAX_CURRENT_MA.

choice PLATFORM_EC_USB_PD_VOLTAGE_CHOICE
	prompt "Set the PD selection voltage policy"
	optional
	help
	  This optional choice instructs the DUT to override the default PDO
	  selection algorithm in favor of a lower or higher voltage.

config PLATFORM_EC_USB_PD_PREFER_LOW_VOLTAGE
	bool "Prefer lower voltage PDO"
	help
	  If enabled, if the partner source device offers multiple PDOs at the
	  same wattage, the DUT will select the PDO offering the lowest voltage.

config PLATFORM_EC_USB_PD_PREFER_HIGH_VOLTAGE
	bool "Prefer higher voltage PDO"
	help
	  If enabled, if the partner source device offers multiple PDOs at the
	  same wattage, the DUT will select the PDO offering the highest
	  voltage.

endchoice

config PLATFORM_EC_PD_POWER_SUPPLY_TURN_ON_DELAY
	int "Power supply turn on delay in us"
	default 30000
	help
	  Each platform could have different power sequencing and transition
	  timing for turning on the power on the PD port.

config PLATFORM_EC_PD_POWER_SUPPLY_TURN_OFF_DELAY
	int "Power supply turn off delay in us"
	default 30000
	help
	  Each platform could have different power sequencing and transition
	  timing for turning off the power on the PD port.

config PLATFORM_EC_USBC_RETIMER_FW_UPDATE
	bool "Support firmware update of USB Type-C retimers"
	depends on PLATFORM_EC_USBC_SS_MUX || PLATFORM_EC_USB_PD_CONTROLLER
	help
	   Enable this to support USB Type-C retimer firmware update. Each
	   Type-C retimer indicates its capability of supporting firmware update
	   independently in its usb_mux_driver.

	   During AP boot-up, the AP scans each PD port for retimers but only
	   if there are no Type-C devices attached to the port. The firmware
	   update can only be performed on retimers which show up in the AP
	   thunderbolt device entries.

choice PLATFORM_EC_CONSOLE_CMD_TYPEC_CHOICE
	prompt "Console command typec choices"
	default PLATFORM_EC_CONSOLE_CMD_TYPEC
	help
	   This symbol selects the typec command implemtation used
	   on the ChromiumOS EC.

config PLATFORM_EC_CONSOLE_CMD_TYPEC
	bool "Console command typec for EC managed USB muxes"
	depends on PLATFORM_EC_USBC_SS_MUX || PDC_POWER_MGMT_USB_MUX
	help
	  Enable the 'typec' console command for EC managed USB Type-C
	  connector muxes.

config PLATFORM_EC_CONSOLE_CMD_PDC_TYPEC
	bool "Console command typec for PDC/AP managed USB muxes"
	depends on USB_PDC_POWER_MGMT && !PDC_POWER_MGMT_USB_MUX
	help
	  Enable the 'typec' console command for USB muxes are _not_ managed by
	  EC.  Use this command to override the USB Type-C connector mux
	  configuration on a specified port.

	  Passing in 'debug' instead of a port number turns on additional
	  debug messages whenever the EC application modifies the mux state.
endchoice

endif  # PLATFORM_EC_USBC
```

## zephyr/Kconfig.watchdog
```kconfig
# Copyright 2021 The ChromiumOS Authors
# Use of this source code is governed by a BSD-style license that can be
# found in the LICENSE file.

if WATCHDOG

config PLATFORM_EC_WATCHDOG_PERIOD_MS
	int "Watchdog timeout in ms"
	default 1600
	help
	  Set the timeout of the watchdog timer. The watchdog timer reboots
	  the system if no one reloads the watchdog timer before the timeout.

config PLATFORM_EC_WATCHDOG_WARNING_LEADING_TIME_MS
	int "Leading time of the watchdog warning timer in ms"
	default WDT_NPCX_WARNING_LEADING_TIME_MS if WDT_NPCX
	default WDT_ITE_WARNING_LEADING_TIME_MS if WDT_ITE_IT8XXX2
	default 500
	help
	  Set the leading time of the watchdog warning timer. Chromium EC system
	  uses an auxiliary timer to handle the system warning event. The
	  auxiliary timer period (CONFIG_AUX_TIMER_PERIOD_MS) is set to
	  PLATFORM_EC_WATCHDOG_PERIOD_MS -
	  PLATFORM_EC_WATCHDOG_WARNING_LEADING_TIME_MS.

	  For the NPCX chip, use WDT_NPCX_WARNING_LEADING_TIME_MS to set this
	  option indirectly.
	  For the ITE chip, use CONFIG_WDT_ITE_WARNING_LEADING_TIME_MS to set
	  this option indirectly.

config PLATFORM_EC_WATCHDOG_HELPER
	bool "Use watchdog helper to trigger warning"
	default n
	depends on WDT_COUNTER
	help
	  If enabled, watchdog shim will setup cros-ec,watchdog-helper
	  with CONFIG_WATCHDOG_AUX_TIMER_PERIOD_MS timeout.
	  Watchdog helper is used to trigger warning and gather debugging
	  information before hardware watchdog resets the SoC.

config PLATFORM_EC_WATCHDOG_DUMP_THREADS_CALL_STACK
	bool "Dump thread call stack to log on watchdog"
	depends on ARCH_STACKWALK
	help
	  Dump each thread's current call stack when watchdog is detected.

config PLATFORM_EC_CONSOLE_CMD_WATCHDOG_INFO
	bool "Enable console command for watchdog info"
	default n
	help
	  Enable watchdoginfo console command. Useful for debugging watchdog
	  issues.

config PLATFORM_EC_HOSTCMD_WATCHDOG_INFO
	bool "Enable host command for watchdog info"
	default y
	help
	  Enable host command to query watchdog info.

endif # WATCHDOG
```

## zephyr/Kconfig.wireless_charger
```kconfig
# Copyright 2022 The ChromiumOS Authors
# Use of this source code is governed by a BSD-style license that can be
# found in the LICENSE file.

config PLATFORM_EC_PERIPHERAL_CHARGER
	bool "Enable peripheral charger task"
	help
	  Enable peripheral charger task.

if PLATFORM_EC_PERIPHERAL_CHARGER

config PLATFORM_EC_CPS8100
	bool "Use CPS8100 driver"
	help
	  Use CPS8100 driver. CPS8100 is a Qi wireless power transmitter.

config PLATFORM_EC_CTN730
	bool "Use CTN730 driver"
	help
	  Use CTN730 driver. CTN730 is a nfc wireless power transmitter.

config PLATFORM_EC_WPC_HALL_ENABLE
	bool "Enable WPC HALL control function"
	help
	  Enable support for the WPC HALL controller power on/off function.

config PLATFORM_EC_WPC_HALL_DEBOUNCE_US
	int "WPC Hall debounce delay (microseconds)"
	default 30000
	help
	  Set the Hall delay used to control WPC power.

config PLATFORM_EC_WPC_AC_S5_CHARGE
	bool "Enable WPC AC S5 charge feature"
	help
	  Enable AC S5 charge feature for the WPC.

endif # PLATFORM_EC_PERIPHERAL_CHARGER
```
