## zephyr/Kconfig.btn_ign
```kconfig
# Copyright 2026 The ChromiumOS Authors
# Use of this source code is governed by a BSD-style license that can be
# found in the LICENSE file.

DT_ALIAS_BTN_IGN_IN := gpio-btn-ign-in

config PLATFORM_EC_BTN_IGN_IN
	bool "Enable power button ignore input"
	default y
	depends on $(dt_alias_enabled,$(DT_ALIAS_BTN_IGN_IN))
	help
	  Enables handling power button ignore state read from GPIO.
	  Enabled if the gpio-btn-ign-in alias is defined in the DT.

config PLATFORM_EC_BTN_IGN_IN_DELAY_MS
	int "Power button ignore delay"
	default 4000
	depends on PLATFORM_EC_BTN_IGN_IN
	help
	  Time in milliseconds to ignore power button press if BTN_IGN is high.

DT_ALIAS_BTN_IGN_OUT := gpio-btn-ign-out

config PLATFORM_EC_FINGERPRINT_BTN_IGN_OUT
	bool "Enable power button ignore output"
	default y
	depends on $(dt_alias_enabled,$(DT_ALIAS_BTN_IGN_OUT))
	help
	  Enables setting power button ignore state by GPIO.
	  Enabled if the gpio-btn-ign-out alias is defined in the DT.

config PLATFORM_EC_FINGERPRINT_BTN_IGN_OUT_DELAY_MS
	int "Power button ignore deactivation delay (ms)"
	default 2000
	depends on PLATFORM_EC_FINGERPRINT_BTN_IGN_OUT
	help
	  Delay in milliseconds before deactivating the power button ignore signal.
```

## zephyr/Kconfig.fingerprint
```kconfig
# Copyright 2024 The ChromiumOS Authors
# Use of this source code is governed by a BSD-style license that can be
# found in the LICENSE file.

config PLATFORM_EC_FINGERPRINT
	bool "Support for fingerprint authentication subsystem"
	depends on BORINGSSL_CRYPTO
	depends on FULL_LIBCPP_SUPPORTED
	select HAS_TASK_FPSENSOR
	help
	  This option enables fingerprint authentication subsystem which
	  is a complete Match On Chip solution. Operations (e.g. enroll,
	  match) are exposed to AP using Host Command interface.

if PLATFORM_EC_FINGERPRINT

config FINGERPRINT_SHELL
	bool "Enable fingerprint debugging console commands"
	help
	  This option adds fingerprint console commands that can be used to
	  verify fingerpint functionality.

config PLATFORM_EC_FINGERPRINT_VENDOR_COMMAND
	bool "Enable fingerprint vendor defined host command"
	help
	  Enables support for FP vendor defined host command. The command can
	  be handled only if the system is not locked.

	  If enabled, the fp_vendor_command function has to be defined.

choice PLATFORM_EC_FINGERPRINT_AUTH_METHOD
	prompt "Fingerprint authentication method"
	default PLATFORM_EC_FINGERPRINT_AUTH_METHOD_ASCP if ASCP
	default PLATFORM_EC_FINGERPRINT_AUTH_METHOD_HANDSHAKE
	help
	  This option selects the authentication method for the fingerprint.

config PLATFORM_EC_FINGERPRINT_AUTH_METHOD_HANDSHAKE
	bool "Handshake"
	help
	  The fingerprint is authenticated using handshake.

config PLATFORM_EC_FINGERPRINT_AUTH_METHOD_ASCP
	bool "ASCP"
	help
	  The fingerprint is authenticated using ASCP.

endchoice

endif # PLATFORM_EC_FINGERPRINT

DT_ALIAS_PWM_FP_LED := pwm-fp-led

config PLATFORM_EC_FP_LED
	bool "Enable fingerprint sensor led"
	help
	  Enables controlling of fingerprint led.
	  If enabled, the pwm-fp-led alias has to be defined in DT.
	default y
	depends on $(dt_alias_enabled,$(DT_ALIAS_PWM_FP_LED))

if PLATFORM_EC_FP_LED

config PLATFORM_EC_FP_LED_BRIGHTNESS_ENROLL
	int "Fingerprint LED perceived brightness during enroll session"
	default 70
	range 0 100
	help
	  The perceived brightness of the fingerprint LED during enrollment,
	  in percentage.

config PLATFORM_EC_FP_LED_BRIGHTNESS_MATCH
	int "Fingerprint LED perceived brightness during match session"
	default 70
	range 0 100
	help
	  The perceived brightness of the fingerprint LED during matching,
	  in percentage.

config PLATFORM_EC_FP_LED_BRIGHTNESS_MATCH_OK
	int "Fingerprint LED perceived brightness after successful match"
	default 100
	range 0 100
	help
	  The perceived brightness of the fingerprint LED after a successful
	  match, in percentage.

config PLATFORM_EC_FP_LED_BRIGHTNESS_MATCH_NOK
	int "Fingerprint LED perceived brightness after failed match"
	default 40
	range 0 100
	help
	  The perceived brightness of the fingerprint LED after a failed match,
	  in percentage.

config PLATFORM_EC_FP_LED_DURATION_MATCH_MS
	int "Fingerprint LED duration during match session (ms)"
	default 10000
	help
	  The duration the fingerprint LED stays on during a match session, in
	  milliseconds.

config PLATFORM_EC_FP_LED_DURATION_MATCH_OK_MS
	int "Fingerprint LED duration after successful match (ms)"
	default 2000
	help
	  The duration the fingerprint LED stays on after a successful match, in
	  milliseconds.

config PLATFORM_EC_FP_LED_DURATION_MATCH_NOK_MS
	int "Fingerprint LED duration after failed match (ms)"
	default 1000
	help
	  The duration the fingerprint LED stays on after a failed match, in
	  milliseconds.

endif # PLATFORM_EC_FP_LED
```

## zephyr/Kconfig.panic
```kconfig
# Copyright 2021 The ChromiumOS Authors
# Use of this source code is governed by a BSD-style license that can be
# found in the LICENSE file.

config PLATFORM_EC_PRESERVED_END_OF_RAM_SIZE
	int "Size of preserved ram for panic and jump data"
	default 1024
	help
	  Size of preserved non-initialized memory at end of ram for panic and
	  jump data. The linker will ensure at least this much space is
	  unallocated.

if PLATFORM_EC_PANIC

config PLATFORM_EC_PANIC_PRINT_STACK_ON_ASSERT
	bool "Dump thread call stack on an assertion"
	depends on ARCH_STACKWALK
	default y
	help
	  Print out the current thread's stack following an assert.

config PLATFORM_EC_CONSOLE_CMD_CRASH
	bool "Console command: crash"
	default y
	help
	  For testing purposes it is useful to be able to generation exceptions
	  to check that the panic reporting is working correctly. The enables
	  the 'crash' command which supports generating various exceptions,
	  selected by its parameter:

	     assert              - assertion failure (ASSERT() macro)
	     divzero             - division by zero
	     udivzero            - division of unsigned value by zero
	     stack (if enabled)  - stack overflow
	     unaligned           - unaligned access (e.g. word load from 0x123)
	     watchdog            - watchdog timer fired
	     hang                - infinite loop in the EC code

config PLATFORM_EC_CONSOLE_CMD_CRASH_NESTED
	bool "Enable nesting for the crash console command"
	default y
	depends on PLATFORM_EC_CONSOLE_CMD_CRASH
	help
	  Enables nesting for the crash console command.
	  Calling the crash console command with multiple crash arguments
	  will result in nested crashes in the order specified.

config PLATFORM_EC_PANIC_STRIP_GPR
	bool "Strip general purpose registers"
	help
	  Don't save General Purpose Registers during panic.

config PLATFORM_EC_PANIC_LOG
	bool "Enable EC panic log"
	default y
	select PLATFORM_EC_PRESERVED_RING_BUF
	depends on !CROS_EC_RO || ZTEST
	help
	  When enabled, a copy of the console log is kept in
	  preserved uninitialized ram. The log can be dumped
	  after a panic for debugging.

config PLATFORM_EC_PANIC_LOG_SIZE
	int "Size of EC panic log in bytes"
	default 2048
	depends on PLATFORM_EC_PANIC_LOG
	help
	  Size of the EC panic log in bytes.
	  Must be a power of 2.

config PLATFORM_EC_PANIC_LOG_DEBUG
	bool "Enables panic log debug features"
	default n
	depends on PLATFORM_EC_PANIC_LOG
	help
	  Enables panic log debug features, including
	  the `paniclog` console command.

endif # PLATFORM_EC_PANIC
```

## zephyr/Kconfig.system
```kconfig
# Copyright 2021 The ChromiumOS Authors
# Use of this source code is governed by a BSD-style license that can be
# found in the LICENSE file.

if PLATFORM_EC

config PLATFORM_EC_CONSOLE_CMD_SCRATCHPAD
	bool "Console Command: scratchpad"
	help
	  Enable the scratchpad console command. The scratchpad register
	  maintain its contents across a software-requested warm reset. The
	  command is used to set or get the scratchpad.

config PLATFORM_EC_CONSOLE_CMD_SYSINFO
	bool "Console Command: sysinfo"
	default y
	help
	  Enable the sysinfo console command, which shows statistics
	  about the current image copy running, reset flags, etc.

config PLATFORM_EC_HIBERNATE
	bool "Support system hibernating"
	default y
	help
	  Enable system hibernation.
	  The type of hibernation supported must be selected.

choice PLATFORM_EC_HIBERNATE_TYPE
	prompt "Choose a hibernate type"
	default PLATFORM_EC_HIBERNATE_PSL if DT_HAS_NUVOTON_NPCX_POWER_PSL_ENABLED && SOC_FAMILY_NPCX
	default PLATFORM_EC_HIBERNATE_VCI if DT_HAS_CROS_EC_HIBERNATE_VCI_PIN_ENABLED
	default PLATFORM_EC_HIBERNATE_ELPM if DT_HAS_ITE_IT8XXX2_POWER_ELPM_ENABLED
	default PLATFORM_EC_HIBERNATE_WAKE_PINS if DT_HAS_CROS_EC_HIBERNATE_WAKE_PINS_ENABLED
	default PLATFORM_EC_HIBERNATE_Z5 if DT_HAS_CROS_EC_HIBERNATE_Z5_ENABLED
	help
	  Select the type of hibernation supported. Either
	  PLATFORM_EC_HIBERNATE_PSL (for power switch logic support) or
	  PLATFORM_EC_HIBERNATE_WAKE_PINS (using wake pins) are
	  supported.

config PLATFORM_EC_HIBERNATE_PSL
	bool "System hibernating with PSL (Power Switch Logic) mechanism"
	depends on DT_HAS_NUVOTON_NPCX_POWER_PSL_ENABLED
	depends on SOC_FAMILY_NPCX
	help
	  Use PSL (Power Switch Logic) for hibernating. It turns off VCC power
	  rail for ultra-low power consumption and uses PSL inputs rely on VSBY
	  power rail to wake up ec and the whole system.

config PLATFORM_EC_HIBERNATE_VCI
	bool "System hibernating with VCI mechanism"
	depends on SOC_FAMILY_MICROCHIP_MEC
	help
	  Use VCI (VBAT-Powered Control Interface) for hibernating. It turns off
	  VTR power rail for ultra-low power consumption and uses VCI inputs which
	  rely on VBAT power rail to wake up ec and the whole system.

config PLATFORM_EC_HIBERNATE_ELPM
	bool "System hibernating with ELPM (Extreme Low Power) mechanism"
	depends on DT_HAS_ITE_IT8XXX2_POWER_ELPM_ENABLED
	help
	  Use ELPM (Extreme Low Power) for hibernating. It turns off chip's main
	  power(VSTBY) for extreme low power consumption and uses XLP inputs rely
	  on VBAT power rail to wake up ec and the whole system.

config PLATFORM_EC_HIBERNATE_WAKE_PINS
	bool "System hibernating with wake-source pins"
	depends on DT_HAS_CROS_EC_HIBERNATE_WAKE_PINS_ENABLED
	help
	  Use wake source pins for hibernating. It turns off VCC power
	  rail for ultra-low power consumption and uses a low power
	  power rail. Changes on wake source pins will wake up the EC.

config PLATFORM_EC_HIBERNATE_Z5
	bool "Hibernate to Z5 driver"
	depends on DT_HAS_CROS_EC_HIBERNATE_Z5_ENABLED
	help
	  Enable support for putting the board into the Z5 power state
	  using an EC controlled GPIO.

endchoice # PLATFORM_EC_HIBERNATE_TYPE

config HIBERNATE_Z5_INIT_PRIORITY
	int "Hibernate Z5 init priority"
	default 50
	depends on PLATFORM_EC_HIBERNATE_Z5
	help
	  Hibernate Z5 initialization priority. This should be a lower priority
	  (higher value) than CONFIG_GPIO_INIT_PRIORITY.

config PLATFORM_EC_HIBERNATE_DELAY_SEC
	int "Delay in seconds from AP power off to hibernate"
	depends on PLATFORM_EC_HIBERNATE
	default 3600
	help
	  This value is the delay in seconds from when the AP enters G3
	  to when the system is hibernated.

config PLATFORM_EC_SYSTEM_PRE_INIT_PRIORITY
	int "System pre-initialization priority"
	default 20
	range 0 99
	help
	  This defines the initialization priority for the CROS
	  system_pre_init() function. system_pre_init() reads chip level reset
	  cause and stores it into the system reset flags. All drivers, except
	  those critical to determining the reset type, should be initialized at
	  lower priority so that the system reset flags are valid.

config PLATFORM_EC_FW_RESET_VECTOR
	bool "Firmware Reset Vector chip specific retrieval"
	default y if SOC_FAMILY_ITE_EC
	default y if SOC_EGIS_ET171
	help
	  This defines if there is a chip specific machanism for
	  retrieving the firmware reset vector. The function that
	  needs to be provided is system_get_fw_reset_vector that
	  will return the address of the reset vector.

config PLATFORM_EC_HOST_COMMAND_MEMORY_DUMP
	bool "Enable Memory Dump Host Commands"
	select THREAD_STACK_INFO
	help
	  Enables fetching a memory dump using host commands. This is useful when
	  debugging panics. May not dump all memory, e.g. sensitive memory will
	  not be dumped.

config PLATFORM_EC_HOST_COMMAND_ENTER_BOOTLOADER
	bool "Enable Enter Bootloader Host Command"
	help
	  Enables entering bootloader mode via host command.
	  If the config is enabled, the chip_enter_bootloader function
	  has to be implemented.

DT_CHOSEN_CROS_EC_BBRAM := cros-ec,bbram
RETAINED_RAM_COMPAT := zephyr,retained-ram

choice PLATFORM_EC_BBRAM_TYPE
	prompt "Choose a BBRAM support type"
	depends on !SOC_FAMILY_INTEL_ISH
	default PLATFORM_EC_BBRAM_TYPE_RETAINED_MEM if $(dt_chosen_has_compat,$(DT_CHOSEN_CROS_EC_BBRAM),$(RETAINED_RAM_COMPAT))
	default PLATFORM_EC_BBRAM_TYPE_BBRAM
	help
	  Select the type of device used for BBRAM support.

config PLATFORM_EC_BBRAM_TYPE_BBRAM
	bool "BBRAM support based on BBRAM"
	help
	  The BBRAM support just uses the hardware BBRAM.

config PLATFORM_EC_BBRAM_TYPE_RETAINED_MEM
	bool "BBRAM support based on retained memory"
	help
	  The BBRAM support uses retained memory device. It can use e.g. SRAM.
	  Such option is useful for devices that don't have the hardware
	  BBRAM or Battery-Backed source is not connected.

endchoice # PLATFORM_EC_BBRAM_TYPE

endif # PLATFORM_EC
```
