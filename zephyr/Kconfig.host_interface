## zephyr/Kconfig.pd_console_cmd
```kconfig
# Copyright 2022 The ChromiumOS Authors
# Use of this source code is governed by a BSD-style license that can be
# found in the LICENSE file.

if PLATFORM_EC_USB_POWER_DELIVERY

menuconfig PLATFORM_EC_USB_PD_CONSOLE_CMD
	bool "Enable USB PD console commands"
	default y if PLATFORM_EC_USB_PD_ALT_MODE_DFP
	help
	  Enables various USB-C PD related console commands.

if PLATFORM_EC_USB_PD_CONSOLE_CMD

config PLATFORM_EC_CONSOLE_CMD_USB_PD_PE
	bool "Console command: pe"
	default y
	help
	  This command dumps information about the USB PD alternate mode options
	  discovered from the partner device. It can be useful for debugging.

	  Example: pe 1 dump
	     IDENT SOP:

	             [ID Header] 2c000bda :: AMA, VID:0bda
	             [Cert Stat] 00000000
	             [2] 00000209    [3] 11000f09
	     IDENT SOP':
	             [ID Header] 1c000489 :: PCable, VID:0489
	             [Cert Stat] 000001c6
	             [2] f6810000    [3] 11082051
	     SVID[0]: ff01 MODES: [1] 000c0045
	     MODE[1]: svid:ff01 caps:000c0045

config PLATFORM_EC_CONSOLE_CMD_USB_PD_CABLE
	bool "Console command: pdcable"
	default y
	help
	  This commands shows the USB cable charactistics as detected from the
	  device. It can be useful for debugging problems with cables and the
	  device's response to them.

	  Example: pdcable 1
	     Cable Type: Passive
	     Cable Rev: 1.0
	     Connector Type: 2
	     Cable Current: 5A
	     USB Superspeed Signaling support: 1
	     Rounded support: No
	     Optical cable: No
	     Retimer support: No
	     Link training: Bi-directional
	     Thunderbolt cable type: Passive

endif  # PLATFORM_EC_USB_PD_CONSOLE_CMD

endif # PLATFORM_EC_USB_POWER_DELIVERY
```

## zephyr/Kconfig.pd_discharge
```kconfig
# Copyright 2022 The ChromiumOS Authors
# Use of this source code is governed by a BSD-style license that can be
# found in the LICENSE file.

if PLATFORM_EC_USB_POWER_DELIVERY

config PLATFORM_EC_USB_PD_DISCHARGE
	bool "Board can discharge VBUS"
	default y
	help
	  Enable this if the board can enable VBUS discharge (eg. through a
	  GPIO-controlled discharge circuit, or through port controller
	  registers) to discharge VBUS rapidly on disconnect

choice PLATFORM_EC_USB_PD_DISCHARGE_MODE
	prompt "Select the discharge method"
	depends on PLATFORM_EC_USB_PD_DISCHARGE

config PLATFORM_EC_USB_PD_DISCHARGE_GPIO
	bool "GPIO control"
	help
	  Enable this if the discharge circuit is controlled by a GPIO

	  TODO: How to specify the GPIO?

config PLATFORM_EC_USB_PD_DISCHARGE_TCPC
	bool "Discharge circuit is provided by the TCPC"
	help
	  Enable this if the discharge circuit is provided by Power-Delivery
	  resistors on the USB Type-C Port Controller (TCPC).

config PLATFORM_EC_USB_PD_DISCHARGE_PPC
	bool "Discharge circuit is provided by the PPC"
	help
	  Enable this if the discharge circuit is using Power Delivery
	  resistors on the Power Path Controller.

endchoice # PLATFORM_EC_USB_PD_DISCHARGE_MODE

endif # PLATFORM_EC_USB_POWER_DELIVERY
```

## zephyr/Kconfig.pd_frs
```kconfig
# Copyright 2022 The ChromiumOS Authors
# Use of this source code is governed by a BSD-style license that can be
# found in the LICENSE file.

if PLATFORM_EC_USB_POWER_DELIVERY

config PLATFORM_EC_USB_PD_FRS
	bool "Support Fast Role Swap protocol"
	help
	  Enables the protocol side of Fast Role Swap (FRS). This allows the
	  device to switch from a SNK to a SRC (or vice versa) based on
	  communication with the partner device.

	  For this to work the trigger must be implemented in either the
	  Type-C Port Controller (TCPC) or Power Path Controller (PPC).

	  FRS differs from the traditional power-role swap in that FRS
	  guarantees there is no interruption of power nor disruption of data
	  communication to any downstream devices (such as devices connected
	  to a USB-C hub or dock).

if PLATFORM_EC_USB_PD_FRS

choice PLATFORM_EC_USB_PD_FRS_MODE
	prompt "Select where the trigger is implemented"
	help
	  The Fast Role Swap (protocol requires that a trigger be implemented to
	  initiate the swap. Use this option to select which of the available
	  options should be used.

config PLATFORM_EC_USB_PD_FRS_PPC
	bool "PPC"
	depends on PLATFORM_EC_USBC_PPC
	help
	  Enable this if the Fast Role Swap trigger is implemented in the
	  Power Path Controller (PPC).

config PLATFORM_EC_USB_PD_FRS_TCPC
	bool "TCPC"
	help
	  Enable this if the Fast Role Swap trigger is implemented in the
	  Type-C Port Controller (TCPC).

endchoice # PLATFORM_EC_USB_PD_FRS_MODE

endif # PLATFORM_EC_USB_PD_FRS

endif # PLATFORM_EC_USB_POWER_DELIVERY
```

## zephyr/Kconfig.pd_host_cmd
```kconfig
# Copyright 2023 The ChromiumOS Authors
# Use of this source code is governed by a BSD-style license that can be
# found in the LICENSE file.

config PLATFORM_EC_USB_PD_HOST_CMD
	bool "Host commands related to USB Power Delivery & Alternate mode info"
	default y
	help
	  This enables host commands which allow finding out the capabilities
	  of USB PD, checking its status and controlling how it operates. For
	  devices which support firmware update, this is provided as well,
	  with the firmware being sent from the AP.

config PLATFORM_EC_HOSTCMD_PD_CONTROL
	bool "Host command: EC_CMD_PD_CONTROL"
	default y
	help
	  Enable the EC_CMD_PD_CONTROL host command. This allows control
	  of the USB-PD chip from the AP, including reset, suspend/resume
	  and enabling power.

	  This host command can be manually executed using the
	  "ectool pdcontrol" command from the Chromium OS shell.

config PLATFORM_EC_USB_PD_LOGGING
	bool "Host command: EC_CMD_PD_GET_LOG_ENTRY"
	help
	  Enable logging of USB Power Delivery events. The AP can request the
	  log to see what has happened recently.

	  The log events are stored in a circular buffer, each one being a
	  struct event_log_entry.

config PLATFORM_EC_HOSTCMD_PD_CHIP_INFO
	bool "Host command: EC_CMD_PD_CHIP_INFO"
	default y
	help
	  Enables EC_CMD_PD_CHIP_INFO host command. This allows AP to gather
	  information of the connected PD chip.

	  This host command can be manually executed using the
	  "ectool pdchipinfo" command from the Chromium OS shell.

config PLATFORM_EC_HOSTCMD_RWHASHPD
	bool "Host command: EC_CMD_USB_PD_RW_HASH_ENTRY"
	default y
	help
	  Enables EC_CMD_USB_PD_RW_HASH_ENTRY host command. This allows AP to
	  set entry in PD MCU's device rw_hash table.

	  This host command can be manually executed using the
	  "ectool rwhashpd" command from the Chromium OS shell.

config PLATFORM_EC_HOSTCMD_TYPEC_DISCOVERY
	bool "Host command: EC_CMD_TYPEC_DISCOVERY"
	default y
	help
	  Enables EC_CMD_TYPEC_DISCOVERY host command. This allows AP to
	  get discovery information for port and type.

	  This host command can be manually executed using the
	  "ectool typecdiscovery" command from the Chromium OS shell.

config PLATFORM_EC_HOSTCMD_TYPEC_CONTROL
	bool "Host command: EC_CMD_TYPEC_CONTROL"
	default y
	depends on PLATFORM_EC_USB_PD_TCPMV2 || PLATFORM_EC_USB_PD_CONTROLLER
	help
	  Enables EC_CMD_TYPEC_CONTROL host command. This allows AP to
	  control USB PD policy.

	  This host command can be manually executed using the
	  "ectool typeccontrol" command from the Chromium OS shell.

config PLATFORM_EC_HOSTCMD_TYPEC_STATUS
	bool "Host command: EC_CMD_TYPEC_STATUS"
	default y
	help
	  Enables EC_CMD_TYPEC_STATUS host command. This allows AP to
	  get status information of port.

	  This host command can be manually executed using the
	  "ectool typecstatus" command from the Chromium OS shell.
```

## zephyr/Kconfig.pd_int_shared
```kconfig
# Copyright 2022 The Chromium OS Authors. All rights reserved.
# Use of this source code is governed by a BSD-style license that can be
# found in the LICENSE file.

if PLATFORM_EC_USBC
if PLATFORM_EC_USB_POWER_DELIVERY

menuconfig PLATFORM_EC_USB_PD_INT_SHARED
	bool "USB-C ports share PD interrupts"
	select HAS_TASK_PD_INT_SHARED
	help
	  This enables processing of shared interrupts where multiple ports
	  share a single IRQ on the EC. Only one shared IRQ is supported,
	  but any combination of ports can be serviced by that one IRQ.

if PLATFORM_EC_USB_PD_INT_SHARED

config PLATFORM_EC_USB_PD_PORT_0_SHARED
	bool "Port 0 IRQ is shared"
	help
	  Enable handling of port 0 PD interrupts signalled by an IRQ that is
	  shared by every other port enabled in this section.

config PLATFORM_EC_USB_PD_PORT_1_SHARED
	bool "Port 1 IRQ is shared"
	help
	  Enable handling of port 1 PD interrupts signalled by an IRQ that is
	  shared by every other port enabled in this section.

config PLATFORM_EC_USB_PD_PORT_2_SHARED
	bool "Port 2 IRQ is shared"
	help
	  Enable handling of port 2 PD interrupts signalled by an IRQ that is
	  shared by every other port enabled in this section.

config PLATFORM_EC_USB_PD_PORT_3_SHARED
	bool "Port 3 IRQ is shared"
	help
	  Enable handling of port 3 PD interrupts signalled by an IRQ that is
	  shared by every other port enabled in this section.

endif # PLATFORM_EC_USB_PD_INT_SHARED

endif # PLATFORM_EC_USB_POWER_DELIVERY
endif # PLATFORM_EC_USBC
```

## zephyr/Kconfig.pd_meas_vbus
```kconfig
# Copyright 2022 The ChromiumOS Authors
# Use of this source code is governed by a BSD-style license that can be
# found in the LICENSE file.

if PLATFORM_EC_USBC

choice PLATFORM_EC_USB_PD_VBUS_MEASURE_MODE
	prompt "Select how VBUS voltage is measured"
	optional

config PLATFORM_EC_USB_PD_VBUS_MEASURE_NOT_PRESENT
	bool "VBUS voltage cannot be read"
	help
	  Enable this if the board does not provide any mechanism for the EC to
	  read the analog VBUS voltage.

config PLATFORM_EC_USB_PD_VBUS_MEASURE_CHARGER
	bool "On-board charger supports VBUS measurement"
	help
	  Enable this if the VBUS voltage can be read using a charger on the
	  board.

config PLATFORM_EC_USB_PD_VBUS_MEASURE_TCPC
	bool "Type-C Port Controller supports VBUS measurement"
	help
	  Enable this if the VBUS voltage can be read using the on-board
	  TCPC.

config PLATFORM_EC_USB_PD_VBUS_MEASURE_ADC_EACH_PORT
	bool "VBUS on each port is measured using an ADC channel"
	help
	  Enable this if there is a separate ADC channel for each USB-C VBUS
	  voltage.

config PLATFORM_EC_USB_PD_VBUS_MEASURE_BY_BOARD
	bool "VBUS on each port is measured per board specific"
	help
	  Enable this if there are different VBUS measurement approaches on
	  the board, and also `board_get_vbus_voltage()` has to be implemented.

endchoice # PLATFORM_EC_USB_PD_VBUS_MEASURE_MODE

config PLATFORM_EC_CMD_VBUS
	bool "Console command to print VBUS"
	help
	  Support console command vbus to print the VBUS on each port
	  respectively.

endif # PLATFORM_EC_USBC
```

## zephyr/Kconfig.pd_usbc_device_type
```kconfig
# Copyright 2022 The ChromiumOS Authors
# Use of this source code is governed by a BSD-style license that can be
# found in the LICENSE file.

if PLATFORM_EC_USB_POWER_DELIVERY

choice PLATFORM_EC_USB_DEVICE_TYPE
	prompt "Select the USB-C device type"
	default PLATFORM_EC_USB_DRP_ACC_TRYSRC

config PLATFORM_EC_USB_VPD
	bool "VCONN-Powered Device"
	help
	  This enables support for supplying power to devices that accept power
	  over the USB VCONN line.

	  See here for details:

	  https://www.usb.org/sites/default/files/D1T2-3a%20-%20CTVPDs%20and%20Making%20Your%20Own%20USB-C%20Thingamajig.pdf

config PLATFORM_EC_USB_CTVPD
	bool "Charge-Through VCONN-Powered Device"
	help
	  This enables support for supplying power to devices, with a circuit
	  that deals with this without needing the involvement of the main
	  device.

config PLATFORM_EC_USB_DRP_ACC_TRYSRC
	bool "Dual-Role Port, Audio Accessory, and Try.SRC Device"
	help
	  This is the most flexible option, allowing the port to operate in
	  a dual-role capacity, so that power can be accepted or supplied on
	  a port.

endchoice # PLATFORM_EC_USB_DEVICE_TYPE

endif # PLATFORM_EC_USB_POWER_DELIVERY
```

## zephyr/Kconfig.pd_vbus_detection
```kconfig
# Copyright 2022 The ChromiumOS Authors
# Use of this source code is governed by a BSD-style license that can be
# found in the LICENSE file.

if PLATFORM_EC_USB_POWER_DELIVERY

config PLATFORM_EC_USB_PD_VBUS_DETECT_NONE
	bool "No way to detect VBUS"
	help
	  Choose this option if it is not possible to detect VBUS. This causes
	  the `check_vbus_level` function pointer in the driver struct to be NULL.

config PLATFORM_EC_USB_PD_VBUS_DETECT_TCPC
	bool "TCPC detects VBUS"
	help
	  Choose this option if the TCPC can detect the presence of VBUS

config PLATFORM_EC_USB_PD_VBUS_DETECT_CHARGER
	bool "Charger detects VBUS"
	help
	  Choose this option if the battery charger can detect the presence
	  of VBUS

config PLATFORM_EC_USB_PD_VBUS_DETECT_PPC
	bool "PPC detects VBUS"
	help
	  Choose this option if the Power-Path Controller (PPC) can detect the
	  presence of VBUS

endif # PLATFORM_EC_USB_POWER_DELIVERY
```

## zephyr/Kconfig.pmic
```kconfig
# Copyright 2021 The Chromium OS Authors. All rights reserved.
# Use of this source code is governed by a BSD-style license that can be
# found in the LICENSE file.

menuconfig PLATFORM_EC_PMIC
	bool "Power Management IC support"
	help
	  Enables support for controlling PMICs (Power Management ICs).
	  A system may have one or more PMICs to control various power
	  rails. These devices operate autonomously, but can sometimes
	  be accessed to tune operational parameters or read fault
	  codes.

if PLATFORM_EC_PMIC

config PLATFORM_EC_MP2964
	bool "Enable MP2964 PMIC support"
	depends on AP_X86_INTEL
	depends on PLATFORM_EC_I2C
	help
	  Enables support for the MPS MP2964 PMIC (Power Management IC).
	  This is a dual rail IMVP8 - IMVP9.1 compatible Digital
	  Multi-Phase Controller with an I2C interface.  This driver
	  enables reprogramming configuration registers when initial the
	  factory settings need to be tuned in prototype devices.

endif # PLATFORM_EC_PMIC
```

## zephyr/Kconfig.port80
```kconfig
# Copyright 2021 The Chromium OS Authors. All rights reserved.
# Use of this source code is governed by a BSD-style license that can be
# found in the LICENSE file.

if PLATFORM_EC_HOST_INTERFACE_ESPI

config PLATFORM_EC_PORT80_4_BYTE
	bool "Allow accept 4-byte Port80 codes"
	help
	  Enable this config to allow the common Port80 layer to accept 4-byte
	  codes when AP sends 4-byte Port80 codes via eSPI PUT_IOWR_SHORT
	  protocol in a single transaction.

config PLATFORM_EC_PORT80_QUIET
	bool "Do not log Port80 codes when they are received"
	help
	  Enable this config to avoid logging the entire buffer of
	  Port80 codes as each are received.
	  The history is still available via the 'port80' EC command.
	  Enabling this will reduce the logging overhead during AP startup.

endif # PLATFORM_EC_HOST_INTERFACE_ESPI
```
