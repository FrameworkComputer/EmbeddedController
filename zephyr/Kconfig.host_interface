## zephyr/Kconfig.host_interface
```kconfig
# Copyright 2021 The Chromium OS Authors. All rights reserved.
# Use of this source code is governed by a BSD-style license that can be
# found in the LICENSE file.

if PLATFORM_EC_HOSTCMD

choice PLATFORM_EC_HOST_INTERFACE_TYPE
	prompt "Select the host interface type"
	default PLATFORM_EC_HOST_INTERFACE_ESPI if AP_X86
	default PLATFORM_EC_HOST_INTERFACE_SHI if AP_ARM
	help
	  The AP communicates with the EC using one of several host interface
	  types.  The selection of the host interface type is based on the
	  capability of both the AP and the EC.

	  x86-compatible application processors typically use the enhanced SPI
	  (ESPI) interface while other application processors use the SPI host
	  interface (SHI).

config PLATFORM_EC_HOST_INTERFACE_ESPI
	bool "eSPI"
	depends on ESPI && AP
	help
	  Enable the Enhanced Serial Peripheral Interface (eSPI) host interface.
	  eSPI supports a shared physical connection between several on-board
	  devices, similar to SPI. It adds a few optional signals and a protocol
	  layer to provide independent 'channels' for each device to communicate
	  over.

	  eSPI is the replacement for LPC (Low-Pin-Count bus).

	  See here for information about eSPI:

	  https://www.intel.com/content/dam/support/us/en/documents/software/chipset-software/327432-004_espi_base_specification_rev1.0_cb.pdf

config PLATFORM_EC_HOST_INTERFACE_HECI
	bool "HECI"
	depends on AP
	help
	  Enable the Host Embedded Controller Interface (HECI).


config PLATFORM_EC_HOST_INTERFACE_LPC
	bool "LPC"
	depends on AP
	help
	  Enable the Low-Pin-Count (LPC) bus.

config PLATFORM_EC_HOST_INTERFACE_SHI
	bool "SPI Host Interface"
	depends on AP
	help
	  Enable the SPI Host Interface (SHI). This is a traditional SPI (serial
	  peripheral interface), where the AP is the SPI controller and the EC
	  is the SPI peripheral.

config PLATFORM_EC_HOST_INTERFACE_USB
	bool "USB"
	depends on AP
	help
	  Enable the USB host interface.

endchoice # PLATFORM_EC_HOST_INTERFACE_TYPE

endif # PLATFORM_EC_HOSTCMD
```

## zephyr/Kconfig.i2c
```kconfig
# Copyright 2022 The ChromiumOS Authors
# Use of this source code is governed by a BSD-style license that can be
# found in the LICENSE file.

config PLATFORM_EC_I2C
	bool "EC I2C Support"
	default y
	depends on DT_HAS_NAMED_I2C_PORTS_ENABLED
	select I2C
	select I2C_SHELL
	help
	  Enable compilation of the EC i2c module. Once enabled, it will be
	  possible to make calls using the old platform/ec i2c APIs defined
	  in include/i2c.h and implemented in common/i2c_controller.c. Doing so
	  should make shimming other platform/ec modules which rely on i2c
	  communication "just work" without requiring any further code changes.

if PLATFORM_EC_I2C

config PLATFORM_EC_I2C_DEBUG
	bool "I2C Tracing"
	help
	  This option enables I2C bus communication tracing. Use the console
	  command "i2ctrace" to enable and disable tracing on specific I2C
	  peripherals.

	  Please see the I2C debugging documentation for more details:

	  https://source.chromium.org/chromiumos/chromiumos/codesearch/+/main:src/platform/ec/docs/i2c-debugging.md

config PLATFORM_EC_I2C_PASSTHRU_RESTRICTED
	bool "Restrict I2C PASSTHRU command"
	help
	  Enables board-specific restrictions for the I2C PASSTHRU host command.
	  Once enabled, board_allow_i2c_passthru function has to be implemented,
	  which defines the allowed usage of the command.

config PLATFORM_EC_I2C_DEBUG_PASSTHRU
	bool "I2C Passthru Debug"
	help
	  This option enables extra debug for I2C passthru operations initiated
	  by the AP.

config PLATFORM_EC_CONSOLE_CMD_I2C_PORTMAP
	bool "Console command: i2c_portmap"
	default y
	help
	  Enable the 'i2c_portmap' console command. This comamnd is used to
	  display the mapping of the I2C ports defined by the named-i2c-ports
	  node to the physical port and remote port indexes.

config PLATFORM_EC_CONSOLE_CMD_I2C_SPEED
	bool "Console command: i2cspeed"
	help
	  Enable the 'i2cspeed' console command. This comamnd is used to
	  display an I2C port's bus speed. Additionally, for ports with
	  the DYNAMIC_SPEED port flag set, the speed can be set. In all
	  cases, the bus speed is in units of kHz.

config PLATFORM_EC_HOSTCMD_I2C_CONTROL
	bool "Host command: i2c_control"
	help
	  Enable the I2C_CONTROL host command. This comamnd is used to
	  display an I2C port's bus speed. Additionally, for ports with
	  the DYNAMIC_SPEED port flag set, the speed can be set. In all
	  cases, the bus speed is in units of kHz. More functionality of
	  the command may be added in the future.

config PLATFORM_EC_SMBUS_PEC
	bool "Packet error checking support for SMBus"
	help
	  If enabled, adds error checking support for i2c_readN, i2c_writeN,
	  i2c_read_string and i2c_write_block. Where
	  - write operation appends an error checking byte at end of transfer, and
	  - read operatoin verifies the correctness of error checking byte from the
	  peripheral.
	  Set I2C_FLAG on addr_flags parameter to use this feature.

	  This option also enables error checking function on smart batteries.

config PLATFORM_EC_I2C_NACK_RETRY_COUNT
	int "I2C operation retry count when transaction error"
	default 0
	help
	  Defines I2C operation retry count when transaction general input/output
	  error (-EIO) and also when the I2C is busy.

endif # PLATFORM_EC_I2C
```

## zephyr/Kconfig.ina2xx
```kconfig
# Copyright 2021 The ChromiumOS Authors
# Use of this source code is governed by a BSD-style license that can be
# found in the LICENSE file.

menuconfig PLATFORM_EC_INA2XX
	bool "Support current-shunt and power monitor"
	help
	  Enables support for current-shunt and power monitor chips.
	  Some project will use the current-shunt and power monitor chips
	  to read the actaully current.

if PLATFORM_EC_INA2XX

config PLATFORM_EC_INA236
	bool "Enable INA236 support"
	depends on PLATFORM_EC_I2C
	help
	  Enables support for the INA236.
	  This is a 16-bit digital current monitor with an I2C/SMBus-compatible
	  interface that is compliant with a wide rang of digital bus voltages.
	  The device monitors the voltage across an external sense resistor and
	  reports values for current, bus voltage, and power.

endif # PLATFORM_EC_INA2XX
```

## zephyr/Kconfig.init_priority
```kconfig
# Copyright 2021 The ChromiumOS Authors
# Use of this source code is governed by a BSD-style license that can be
# found in the LICENSE file.

config PLATFORM_EC_FLASH_INIT_PRIORITY
  int "Init priority of the flash module"
  default 90
  help
    The initialization priority of the flash module. This should always be
    a lower priority than PLATFORM_EC_GPIO_INIT_PRIORITY.

config PLATFORM_EC_GPIO_INIT_PRIORITY
  int "Init priority of the GPIO module"
  default 88 if MFD
  default 53
  help
    The initialization priority of the GPIO module. This should always happen
    after the gpio drivers are initialized.

config PLATFORM_EC_PWM_INIT_PRIORITY
	int "Initialization priority of the PWM module"
	depends on PLATFORM_EC_PWM
	default 53
	help
	  Sets the initialization priority of the PWM module. This MUST be a
	  value greater than the PWM driver's initialization priority which
	  currently defaults to KERNEL_INIT_PRIORITY_DEVICE.

config EEPROM_INIT_PRIORITY
	default 70
```

## zephyr/Kconfig.ioex
```kconfig
# Copyright 2021 The ChromiumOS Authors
# Use of this source code is governed by a BSD-style license that can be
# found in the LICENSE file.

menuconfig PLATFORM_EC_IOEX_CROS_DRV
	bool "IO expander support"
	depends on I2C
	help
	  Enable support for CrOS EC ioex drivers.

if PLATFORM_EC_IOEX_CROS_DRV

config PLATFORM_EC_IOEX_INIT_PRIORITY
	int "IO expander init priority"
	range 0 99
	default 50
	help
	  Sets the priority of function that initializes
	  the IO expander subsystem

config PLATFORM_EC_IOEX_CCGXXF
	bool "Cypress CCGXXF"
	help
	  Enables driver for Cypress CCGXXF IO expander (built inside PD chip)

config PLATFORM_EC_IOEX_IT8801
	bool "IT8801"
	help
	  Enables support for IT8801 IO expander with keyboard matrix controller

config PLATFORM_EC_IOEX_NCT38XX
	bool "Nuvoton NCT38xx"
	help
	  Enables support for IO expander built inside Nuvoton NCT38xx TCPC

config PLATFORM_EC_IOEX_PCA9675
	bool "NXP PCA9675PW"
	help
	  Enables support for NXP PCA9675PW IO expander

config PLATFORM_EC_IOEX_PCAL6408
	bool "NXP PCA(L)6408"
	help
	  Enables support for NXP PCA(L)6408 IO expander

config PLATFORM_EC_IOEX_TCA64XXA
	bool "TI TCA64xA"
	help
	  Enables support for Texas Instruments TCA64xxA IO expanders family

endif
```
