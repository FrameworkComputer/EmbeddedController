## zephyr/Kconfig.led
```kconfig
# Copyright 2021 The ChromiumOS Authors
# Use of this source code is governed by a BSD-style license that can be
# found in the LICENSE file.

menuconfig PLATFORM_EC_LED_COMMON
	depends on !PLATFORM_EC_LED_DT
	bool "LED Support"
	help
	  Enable the common LED module supporting automatic control of the
	  battery and power LEDs.

if PLATFORM_EC_LED_COMMON

# TODO: Add other choices
#  CONFIG_LED_PWM_CHARGE_STATE_ONLY
#  CONFIG_LED_PWM_ACTIVE_CHARGE_PORT_ONLY
#  CONFIG_LED_ONOFF_STATES

config PLATFORM_EC_LED_PWM
	bool "PWM (Pulse Width Modulation) LEDs"
	default y
	depends on DT_HAS_CROS_EC_PWM_LEDS_ENABLED
	select PWM
	help
	  Enable PWM (Pulse Width Modulation) controlled LEDs that conform to
	  the Chromium OS LED behavior specification.

	  Your board files must implement led_set_brightness() function, which
	  is used by the LED PWM module to set the board LEDs in response to
	  power and charging events.

if PLATFORM_EC_LED_PWM

config PLATFORM_EC_LED_PWM_TASK_DISABLED
	bool "Disable common PWM LEDs Task"
	help
	  Support common PWM (Pulse Width Modulation) controlled LEDs that do
	  not conform to the Chromium OS LED behavior specification.

	  Your board code must define and enable it's own task for managing the
	  LEDs.

config PLATFORM_EC_CONSOLE_CMD_LEDTEST
	bool "Console command: ledtest"
	default y
	help
	  Enable the "ledtest" command. This command lets you override the
	  automatic control of the platform LEDs. For example:

	    ledtest 0 enable red

	  disables automatic control of the first PWM LED and forces the LED
	  color to red.  Set the 2nd parameter to "disable" to return back
	  to automatic control:

	    ledtest 0 disable

config PLATFORM_EC_LED_PWM_CHARGE_COLOR
	int "Battery charging LED color"
	default 5
	range 0 5
	help
	  Configure the color of LED when battery is charging:
	    0 - EC_LED_COLOR_RED
	    1 - EC_LED_COLOR_GREEN
	    2 - EC_LED_COLOR_BLUE
	    3 - EC_LED_COLOR_YELLOW
	    4 - EC_LED_COLOR_WHITE
	    5 - EC_LED_COLOR_AMBER

	  This value is mapped directly to enum ec_led_colors.

config PLATFORM_EC_LED_PWM_CHARGE_ERROR_COLOR
	int "Charging error LED color"
	default 0
	range 0 5
	help
	  Configure the color of LED when Charging error or battery not present:
	    0 - EC_LED_COLOR_RED
	    1 - EC_LED_COLOR_GREEN
	    2 - EC_LED_COLOR_BLUE
	    3 - EC_LED_COLOR_YELLOW
	    4 - EC_LED_COLOR_WHITE
	    5 - EC_LED_COLOR_AMBER

	  This value is mapped directly to enum ec_led_colors.

config PLATFORM_EC_LED_PWM_NEAR_FULL_COLOR
	int "Battery almost full LED color"
	default 1
	range 0 5
	help
	  Configure the color of LED when charge battery is almost full:
	    0 - EC_LED_COLOR_RED
	    1 - EC_LED_COLOR_GREEN
	    2 - EC_LED_COLOR_BLUE
	    3 - EC_LED_COLOR_YELLOW
	    4 - EC_LED_COLOR_WHITE
	    5 - EC_LED_COLOR_AMBER

	  This value is mapped directly to enum ec_led_colors.

config PLATFORM_EC_LED_PWM_SOC_ON_COLOR
	int "AP powered on LED color"
	default 1
	range 0 5
	help
	  Configure the color of LED when AP powered on:
	    0 - EC_LED_COLOR_RED
	    1 - EC_LED_COLOR_GREEN
	    2 - EC_LED_COLOR_BLUE
	    3 - EC_LED_COLOR_YELLOW
	    4 - EC_LED_COLOR_WHITE
	    5 - EC_LED_COLOR_AMBER

	  This value is mapped directly to enum ec_led_colors.

config PLATFORM_EC_LED_PWM_SOC_SUSPEND_COLOR
	int "AP suspended LED color"
	default 1
	range 0 5
	help
	  Configure the color of LED when AP suspended:
	    0 - EC_LED_COLOR_RED
	    1 - EC_LED_COLOR_GREEN
	    2 - EC_LED_COLOR_BLUE
	    3 - EC_LED_COLOR_YELLOW
	    4 - EC_LED_COLOR_WHITE
	    5 - EC_LED_COLOR_AMBER

	  This value is mapped directly to enum ec_led_colors.

config PLATFORM_EC_LED_PWM_LOW_BATT_COLOR
	int "Low battery LED color"
	default 5
	range 0 5
	help
	  Configure the color of LED when battery is low:
	    0 - EC_LED_COLOR_RED
	    1 - EC_LED_COLOR_GREEN
	    2 - EC_LED_COLOR_BLUE
	    3 - EC_LED_COLOR_YELLOW
	    4 - EC_LED_COLOR_WHITE
	    5 - EC_LED_COLOR_AMBER

	  This value is mapped directly to enum ec_led_colors.

config PLATFORM_EC_LED_PWM_OFF_IN_SUSPEND
	bool "Enables power LED to be off in suspend (S0ix or S3)"
	help
	  Turns power LED off in suspend instead of pulsing this is the new
	  requirement after 2022. Boards that are already shipped maintain the
	  old requirement of pulse in suspend.

endif # PLATFORM_EC_LED_PWM

config PLATFORM_EC_LED_ONOFF_STATES
	bool "EC LED On-Off States"
	help
	  Enable EC Standard LED On-Off state code that conforms to the
	  Chromium OS LED On-Off state behavior.

if PLATFORM_EC_LED_ONOFF_STATES

config PLATFORM_EC_LED_ONOFF_STATES_BAT_LOW
	int "EC LED On-Off State Battery Low Percentage"
	default 10
	help
	  Enable EC Standard LED On-Off bettery low percentage
	  for standard Chromium OS LED On-Off battery low
	  state behavior.

endif # PLATFORM_EC_LED_ONOFF_STATES

endif # PLATFORM_EC_LED_COMMON

config PLATFORM_EC_MAX695X_SEVEN_SEGMENT_DISPLAY
	bool "MAX695X Seven Segment Display"
	default y
	depends on DT_HAS_MAXIM_MAX695X_ENABLED
	help
	  Enable this to support MAX6958/MAX6959 7-Segment LED Display.
	  The MAX6958/MAX6959 is a compact multiplexed common - cathode display
	  designed to interface microprocessors with seven - segment numerical
	  LED digits or to discrete LEDs via a 2-wire serial interface
	  compatible with SMBusTM and I2C.

config PLATFORM_EC_CONSOLE_CMD_SEVEN_SEGMENT_DISPLAY
	bool "Console command: seg"
	help
	  Enable the "seg" console command. This command allow the user to write
	  on seven segment display.
```

## zephyr/Kconfig.led_dt
```kconfig
# Copyright 2022 The ChromiumOS Authors
# Use of this source code is governed by a BSD-style license that can be
# found in the LICENSE file.

menuconfig PLATFORM_EC_LED_DT
	bool "DT LED Support"
	help
	  Enable devicetree based LED module supporting automatic control of the
	  battery and power LEDs.

if PLATFORM_EC_LED_DT

config PLATFORM_EC_LED_DT_GPIO
	bool "DT LED Support (GPIO)"
	default y
	depends on DT_HAS_CROS_EC_GPIO_LED_PINS_ENABLED
	help
	  Enable support for devicetree GPIO LEDs, requires a node using the
	  cros-ec,gpio-led-pins compatible.

config PLATFORM_EC_LED_DT_PWM
	bool "DT LED Support (PWM)"
	default y
	depends on DT_HAS_CROS_EC_PWM_LED_PINS_ENABLED
	help
	  Enable support for devicetree PWM LEDs, requires a node using the
          cros-ec,pwm-led-pins compatible.
endif
```

## zephyr/Kconfig.mkbp_event
```kconfig
# Copyright 2021 The ChromiumOS Authors
# Use of this source code is governed by a BSD-style license that can be
# found in the LICENSE file.

if PLATFORM_EC_MKBP_EVENT

choice
    prompt "MKBP delivery method"
    default PLATFORM_EC_MKBP_USE_GPIO
    help
      Select MKBP delivery method

config PLATFORM_EC_MKBP_USE_GPIO
    bool "Use GPIO"
    help
      Select to send MKBP events via GPIO. You should define GPIO_EC_INT_L
      as a GPIO output from the EC. The GPIO is used to indicate an
      event is ready for serving by the AP.

config PLATFORM_EC_MKBP_USE_HOST_EVENT
    bool "Use host event"
    help
      Select to send MKBP events via host event.

config PLATFORM_EC_MKBP_USE_HECI
    bool "Use HECI"
    help
      Select to send MKBP events via HECI.

config PLATFORM_EC_MKBP_USE_GPIO_AND_HOST_EVENT
    bool "Use GPIO and host event"
    help
      MKBP events are notified by using both a GPIO and a host event.

      You should use this if you are using a GPIO to notify the AP of an MKBP
      event, and you need an MKBP event to wake the AP in suspend and the
      AP cannot wake from the GPIO.  Since you are using both a GPIO and
      a hostevent for the notification, make sure that the S0 hostevent mask
      does NOT include MKBP events.  Otherwise, you will have multiple
      consumers for a single event. However, make sure to configure the
      host event *sleep* mask in coreboot to include MKBP events. In order to
      prevent all MKBP events from waking the AP, use
      CONFIG_MKBP_EVENT_WAKEUP_MASK to filter the events.

config PLATFORM_EC_MKBP_USE_CUSTOM
    bool "Use custom method"
    help
      Select to send MKBP events using custom method. You need to define
      mkbp_set_host_active_via_custom() which is called when there's a MKBP event
      to be sent. for more about the function, refer to mkbp_event.h.

endchoice

config PLATFORM_EC_MKBP_USE_GPIO_ACTIVE_HIGH
    bool "EC_SOC_INT active high"
    default n
    depends on PLATFORM_EC_MKBP_USE_GPIO
    help
      Select if HW invert the SOC_INT signal on EC side.

config PLATFORM_EC_EMULATED_SYSRQ
    bool "Enable Emulated SysRq MKBP Events"
    default n
    depends on PLATFORM_EC_MKBP_EVENT
    help
      Select to enable sending emulated SysRq MKBP events.
      Emulated SysRq events are used during AP sleep hang recovery to trigger
      stack dumps of all active AP cores, to help debug sleep hang issues.

endif # PLATFORM_EC_MKBP_EVENT
```

## zephyr/Kconfig.motionsense
```kconfig
# Copyright 2021 The ChromiumOS Authors
# Use of this source code is governed by a BSD-style license that can be
# found in the LICENSE file.

menuconfig PLATFORM_EC_MOTIONSENSE
    bool "Motion Sense"
    default y
    depends on DT_HAS_CROS_EC_MOTIONSENSE_SENSOR_INFO_ENABLED || \
      $(dt_nodelabel_enabled,lid_accel) || \
      $(dt_nodelabel_enabled,base_accel) || \
      $(dt_nodelabel_enabled,base_gyro)
    select HAS_TASK_MOTIONSENSE
    help
      Enable motion sense task. The task collects data from available sensors
      and report them to AP. Besides the task reports the sensor data to AP.
      Based on the data, it also does other things like calculating lid angle
      and detect tablet mode.

if PLATFORM_EC_MOTIONSENSE

config PLATFORM_EC_ACCEL_FIFO
    bool "Sensor FIFO"
    help
      Enable this to add the sensor FIFO used by sensor device drivers to fill.
      Using FIFO reduces power consumption since it reduces the number of
      AP wake-ups.

if PLATFORM_EC_ACCEL_FIFO

config PLATFORM_EC_ACCEL_FIFO_SIZE
    int "Motion Sense FIFO Size"
    default 256
    help
      This sets the size of the sensor FIFO, must be a power of 2.

config PLATFORM_EC_ACCEL_FIFO_THRES
    int "FIFO Threshold"
    default 85      # (PLATFORM_EC_ACCEL_FIFO_SIZE / 3)
    help
      This sets the amount of free entries that trigger an interrupt to the AP.

endif # PLATFORM_EC_ACCEL_FIFO

config PLATFORM_EC_SENSOR_TIGHT_TIMESTAMPS
    bool "Extra Sensor Timestamp"
    help
      If this is defined, motion_sense sends
      sensor events to the AP in the format
      +-----------+
      | Timestamp |
      |  Payload  |
      | Timestamp |
      |  Payload  |
      |    ...    |
      +-----------+
      If this is not defined, the events will be sent in the format
      +-----------+
      |  Payload  |
      |  Payload  |
      |  Payload  |
      |    ...    |
      | Timestamp |
      +-----------+
      The former format enables improved filtering of sensor event
      timestamps on the AP, but comes with stricter jitter requirements.

# TODO(b/173507858) config PLATFORM_EC_MOTION_FILL_LPC_SENSE_DATA
# if PLATFORM_EC_MOTION_FILL_LPC_SENSE_DATA
#endif # PLATFORM_EC_MOTION_FILL_LPC_SENSE_DATA

config PLATFORM_EC_MAX_SENSOR_FREQ_MILLIHZ
    int "Maximal EC sampling rate"
    default 250000
    help
       Lower this limit for slower EC (in mHz).

config PLATFORM_EC_ALS
    bool "Ambient Light Sensor(ALS)"
    help
      Enable this to indicate there's at least one or more ALS devices available.
      If PLATFORM_EC_MOTION_FILL_LPC_SENSE_DATA is set, then motion task updates
      the designated part of EC memmap with the ALS data. The updating EC memmap
      can be also done by the dedicated ALS task with HAS_ALS_TASK set.
      Number of ALS entries reserved in EC memmap are defined by EC_ALS_ENTRIES
      in ec_commands.h.

config PLATFORM_EC_DYNAMIC_MOTION_SENSOR_COUNT
    bool "Dynamic Motion Sensor Count"
    help
      Enable this to allow changing motion sensor count dynamically.

config PLATFORM_EC_LID_ANGLE
    bool "Lid Angle"
    select PLATFORM_EC_MATH_UTIL
    help
      Enable this to detect lid angle with two accelerometers. The andgle
      calculation requires the information about which sensor is on the lid
      and which one is on the base. The measured lid angle can be used for
      tablet mode detection(refer "Tablet Mode below") and enabling/disabling
      peripheral devices(refer "Lid Angle Update" below).
      # TODO(b/173507858): add more detail after .dts change

config PLATFORM_EC_LID_ANGLE_UPDATE
    bool "Lid Angle Update"
    depends on PLATFORM_EC_LID_ANGLE
    help
      Enable this to allow using the lid angle measurement to determine if
      peripheral devices should be enabled or disabled, like key scanning,
      trackpad interrupt.

config PLATFORM_EC_CONSOLE_CMD_ACCELS
    bool "Console commands: accels, accelrate, accelinit, accelinfo, etc."
    help
      Enables console commands:

        accelrange <sensor id> <data> <roundup> - Read or write accelerometer
        range
        accelres <sensor id> <data> <roundup> - Read or write accelerometer
        resolution
        accelrate <sensor id> <data> <roundup> - Read or write accelerometer
        ODR
        accelread <sensor id> [n(iteration)] - Read sensor x/y/z
        accelinit <sensor id> - Init sensor

if PLATFORM_EC_CONSOLE_CMD_ACCELS

config PLATFORM_EC_CONSOLE_CMD_ACCEL_INFO
    bool "Console Command: accelinfo"
    help
      Enable console command:

        accelinfo on/off [interval] - Print motion sensor info, lid angle
        calculations and set calculation frequency.

endif # PLATFORM_EC_CONSOLE_CMD_ACCELS

config PLATFORM_EC_ACCEL_SPOOF_MODE
	bool "Sensor spoof mode"
	help
	  Enable this to allow sensors values spoofed to any arbitrary value.
	  This is useful for testing the motion sense framework if the hardware
	  sensor or the sensor driver code is not ready.

if PLATFORM_EC_ACCEL_SPOOF_MODE

config PLATFORM_EC_CONSOLE_CMD_ACCEL_SPOOF
	bool "Console Command: accelspoof"
	help
	  Enable console command:

	    accelspoof id [on/off] [X] [Y] [Z] - Enable/Disable spoofing of
	    sensor readings.

endif # PLATFORM_EC_ACCEL_SPOOF_MODE

config PLATFORM_EC_GESTURE_DETECTION
	bool "Gesture detection"
	help
	  Enable this to support gesture detection.

config PLATFORM_EC_GESTURE_HOST_DETECTION
	bool "Gesture host detection"
	help
	  Enable gesture host interface

rsource "Kconfig.sensor_devices"
rsource "Kconfig.body_detection"

endif # PLATFORM_EC_MOTIONSENSE
```
