## zephyr/Kconfig.rollback
```kconfig
# Copyright 2023 The ChromiumOS Authors
# Use of this source code is governed by a BSD-style license that can be
# found in the LICENSE file.

config PLATFORM_EC_ROLLBACK
	bool "Rollback support"
	help
	  Enable rollback support. Rollback mechanism is used to manage minimal
	  version of RW firmware that can be booted (to block downgrade attacks
	  when old firmware have vulnerabilities) and to keep secret (used by
	  fingerprint functionality).

config PLATFORM_EC_ROLLBACK_VERSION
	int "Rollback version stored in the image data"
	default 0
	help
	  This value is used by the RW signature verification to check if RW
	  part of firmware wasn't downgraded to vulnerable version. Minimal
	  rollback version is stored in rollback regions.

if PLATFORM_EC_ROLLBACK

config PLATFORM_EC_ROLLBACK_SECRET_SIZE
	int "Size of rollback secret"
	default 32
	help
	  Size of the rollback secret.

config PLATFORM_EC_ROLLBACK_UPDATE
	bool "Allow rollback contents updating"
	default y if CROS_EC_RO
	help
	  If enabled, the contents of the rollback region can be updated
	  (e.g. by adding more entropy to the secret or changing minimal
	  RW version).

config PLATFORM_EC_ROLLBACK_MPU_PROTECT
	bool "Enable MPU protection of rollback regions"
	depends on MPU
	default y
	help
	  If enabled, flash area that contains rollback data will be protected
	  against unwanted read/write.

endif  # PLATFORM_EC_ROLLBACK
```

## zephyr/Kconfig.rsa
```kconfig
# Copyright 2023 The ChromiumOS Authors
# Use of this source code is governed by a BSD-style license that can be
# found in the LICENSE file.

config PLATFORM_EC_RSA
	bool "Support verifying RSA signature"
	help
	  Includes a library for verifying RSA signature.

	  The algorithm parameters are pre-defined and configurable using
	  following config variables.

if PLATFORM_EC_RSA

config PLATFORM_EC_RSA_KEY_SIZE
	int "RSA key size"
	default 2048
	help
	  This option specifies the key size used by RSA algorithm.

config PLATFORM_EC_RSA_EXPONENT_3
	bool "Use RSA exponent 3"
	help
	  Use public exponent 3 instead of F4(65537). Keys with exponent 3 are
	  much quicker to verify, can be used on time critical tasks.

endif # PLATFORM_EC_RSA

config PLATFORM_EC_RWSIG
	bool "Enable RW signature verification subsystem."
	select PLATFORM_EC_RWSIG_VERIFY if CROS_EC_RO
	help
	  For accessories without software sync, enable this option to allow RO
	  verify the RW firmware using RSA signature.

if PLATFORM_EC_RWSIG

config PLATFORM_EC_RWSIG_VERIFY
	bool "Verify the RW firmware using the RSA signature."
	select HAS_TASK_RWSIG
	select PLATFORM_EC_RSA
	help
	  If enabled, the RW part of the firmware will be verified using the
	  public key stored in the RO part of the firmware and the signature
	  provided with the RW part.

choice PLATFORM_EC_RWSIG_TYPE
	bool "futility signature type"
	default PLATFORM_EC_RWSIG_TYPE_RWSIG

config PLATFORM_EC_RWSIG_TYPE_RWSIG
	bool "RWSIG"
	help
	  Use command `futility sign --type rwsig` to sign the firmware.

	  Requires RO firmware contains a 1kB KEY_RO section that holds the
	  public key in vboot v2.1 format, and RW firmware contains a 1kB
	  SIG_RW section that holds the signature.

config PLATFORM_EC_RWSIG_TYPE_USBPD1
	bool "USBPD1"
	select DEPRECATED
	help
	  Use command `futility sign --type usbpd1` to sign the firmware.

	  [DEPRECATED] use PLATFORM_EC_RWSIG_TYPE_RWSIG instead.

endchoice

config PLATFORM_EC_RO_PUBKEY_STORAGE_OFF
	int "Offset of RWSIG public key"
	default $(dt_node_int_prop_int,/binman/wp-ro/ec-ro/key-ro,offset)
	help
	  Offset of the RWSIG public key, relative to RO firmware.

endif # PLATFORM_EC_RWSIG
```

## zephyr/Kconfig.rtc
```kconfig
# Copyright 2021 The Chromium OS Authors. All rights reserved.
# Use of this source code is governed by a BSD-style license that can be
# found in the LICENSE file.

if PLATFORM_EC_RTC

config PLATFORM_EC_CONSOLE_CMD_RTC
	bool "Console command: rtc"
	help
	  This command allows getting and setting the current RTC value. The
	  value is in seconds since the Epoch (midnight on 1/1/70). You can
	  convert this to a human date on the command line with 'date -u -d @n'
	  where n is the numeric value. To convert a time to seconds, use:

	     date -d '1970-01-01 UTC + n seconds'

config PLATFORM_EC_CONSOLE_CMD_RTC_ALARM
	bool "Console command: rtc_alarm"
	depends on PLATFORM_EC_CONSOLE_CMD_RTC
	help
	  This command supports setting a real-time-clock (RTC) alarm that
	  causes an interrupt when the timer reaches that point. To set the
	  alarm:

	     rtc <sec> [<usec>]

	  where:
	    <sec> is the number of seconds since the epoch
	    <usec> is the optional number of microseconds (fractional seconds)

config PLATFORM_EC_HOSTCMD_RTC
	bool "Host command: EC_CMD_RTC_GET_VALUE etc."
	depends on PLATFORM_EC_HOSTCMD
	help
	  Enables support for EC_CMD_RTC_GET_VALUE, EC_CMD_RTC_SET_VALUE,
	  EC_CMD_RTC_GET_ALARM and EC_CMD_RTC_SET_ALARM which colectively allow
	  the AP to control the EC's real-time-clock. The AP typically makes
	  use of the EC's RTC to avoid needing a discrete RTC chip on the board.

endif # PLATFORM_EC_RTC
```

## zephyr/Kconfig.sensor_devices
```kconfig
# Copyright 2021 The ChromiumOS Authors
# Use of this source code is governed by a BSD-style license that can be
# found in the LICENSE file.

menu "Sensor Devices"

config PLATFORM_EC_ACCELGYRO_BMI
	bool
	select PLATFORM_EC_MATH_UTIL
	help
	  This config does not contain a prompt on purpose, it cannot be set
	  directly from a .conf file. This value should be set using an `select`
	  statement in other BMI family of drivers such as BMI260.

config PLATFORM_EC_ACCELGYRO_ICM
	bool
	help
	  This config does not contain a prompt on purpose, it cannot be set
	  directly from a .conf file. This value should be set using an `select`
	  statement in other BMI family of drivers such as ICM426XX.

config PLATFORM_EC_ACCEL_BMA255
	bool "BMA2X2 Accelerometer Family Driver"
	select PLATFORM_EC_MATH_UTIL
	help
	  The driver supports Bosch's a triaxial, low-g acceleration sensor.
	  It allows measurements of acceleration in three perpendicular axes.
	  Currently the driver supports BMA253, BMA255, BMA355, BMA280, BMA282,
	  BMA223, BMA254, BMA284, BMA250E, BMA222E, BMC150 BMC056, BMC156.

config PLATFORM_EC_ACCEL_BMA4XX
	bool "BMA4XX Accelerometer Family Driver"
	default y
	depends on DT_HAS_CROS_EC_BMA4XX_ENABLED
	help
	  The driver supports Bosch's a triaxial, low-g acceleration sensor.
	  It allows measurements of acceleration in three perpendicular axes.
	  Currently the driver supports BMA4XX.

config PLATFORM_EC_ACCEL_KX022
	bool "KX022 Accelerometer Driver"
	help
	  The driver supports Kionix's KX022 triaxial low-g acceleration sensor.
	  It allows measurements of acceleration in three perpendicular axes.

config PLATFORM_EC_ACCEL_LIS2DS
	bool "LIS2DS12 Accelerometer Driver"
	select PLATFORM_EC_STM_MEMS_COMMON
	help
	  The driver supports ST's LIS2DS12 3D digital accelerometer sensor.
	  It allows measurements of acceleration in three perpendicular axes.

config PLATFORM_EC_ACCEL_LIS2DW12
	bool "LIS2DW12 Accelerometer Driver"
	select PLATFORM_EC_STM_MEMS_COMMON
	help
	  The driver supports ST's LIS2DW12 3D digital accelerometer sensor.
	  It allows measurements of acceleration in three perpendicular axes.

config PLATFORM_EC_ACCELGYRO_BMI160
	bool "BMI160 Accelgyrometer Driver"
	select PLATFORM_EC_ACCELGYRO_BMI
	help
	  The driver supports Bosch's BMI160 which is an Inertial Measurement
	  Unit (IMU) consisting of a 16-bit tri-axial gyroscope and a 16-bit
	  tri-axial accelerometer.

config PLATFORM_EC_ACCELGYRO_BMI260
	bool "BMI260 Accelgyrometer Driver"
	select PLATFORM_EC_ACCELGYRO_BMI
	help
	  The driver supports Bosch's BMI260 which is an Inertial Measurement
	  Unit (IMU) consisting of a 16-bit tri-axial gyroscope and a 16-bit
	  tri-axial accelerometer.

config PLATFORM_EC_ACCELGYRO_BMI3XX
	bool "BMI3XX Accelgyrometer Driver"
	select PLATFORM_EC_ACCELGYRO_BMI
	help
	  The driver supports Bosch's BMI3XX which is an Inertial Measurement
	  Unit (IMU) consisting of a 16-bit tri-axial gyroscope and a 16-bit
	  tri-axial accelerometer.

config PLATFORM_EC_ALS_TCS3400
	bool "TCS3400 Ambient Light Senseor Driver"
	help
	  The driver supports TCS3400 which provides color and
	  IR (red, green, blue, clear and IR) ambient light sensing.

config PLATFORM_EC_ALS_CM32183
	bool "CM32183 Ambient Light Sensor Driver"
	help
	  The driver supports CM32183 which provides ambient
	  light sensing.

config PLATFORM_EC_ALS_TCS3400_EMULATED_IRQ_EVENT
	bool "Enable TCS3400 Ambient Light Sensor Driver Polling mode"
	help
	  Enable tcs3400 to operate without interrupt pin. This config is used in
	  conjunction with CONFIG_ALS_TCS3400_INT_EVENT. When this option is enabled,
	  the read is initiated in the same manner as when interrupts are used, but the
	  event which triggers the irq_handler is generated by deferred call.

config PLATFORM_EC_ACCELGYRO_ICM426XX
	bool "ICM426XX Accelgyro Driver"
	select PLATFORM_EC_ACCELGYRO_ICM
	help
	  The driver supports ICM426XX which provides both accelerometer and
	  gyroscope readings.

config PLATFORM_EC_ACCELGYRO_ICM42607
	bool "ICM42607 Accelgyro Driver"
	select PLATFORM_EC_ACCELGYRO_ICM
	help
	  The driver supports ICM42607 which provides both accelerometer and
	  gyroscope readings.

config PLATFORM_EC_ACCELGYRO_LSM6DSO
	bool "LSM6DSO Accelgyro Driver"
	select PLATFORM_EC_STM_MEMS_COMMON
	help
	  The driver supports ST's LSM6DSO 3D digital accelerometer sensor.
	  It allows measurements of acceleration in three perpendicular axes.

config PLATFORM_EC_ACCELGYRO_LSM6DSM
	bool "LSM6DSM Accelgyro Driver"
	select PLATFORM_EC_STM_MEMS_COMMON
	help
	  The driver supports ST's LSM6DSM 3D digital accelerometer sensor.
	  It allows measurements of acceleration in three perpendicular axes.

config PLATFORM_EC_STM_MEMS_COMMON
	bool
	help
	  The driver supports functionality that is common to
	  STMicroelectronics(STM) micro-electromechanical system(MEMS)
	  sensor devices.  This should be enabled by drivers that use
	  this common framework.  It cannot be set otherwise, even in
	  prj.conf.

rsource "Kconfig.accelgyro_bmi"
rsource "Kconfig.accelgyro_icm"

endmenu # Sensor devices
```

## zephyr/Kconfig.stacks
```kconfig
# Copyright 2021 The ChromiumOS Authors
# Use of this source code is governed by a BSD-style license that can be
# found in the LICENSE file.

##############################################################################

# Zephyr internal stack sizes
#
# The intent is to try and keep the stack sizes in one place.

config MAIN_STACK_SIZE
	default 1536 if SOC_SERIES_ITE_IT8XXX2
	default 1200 if SOC_SERIES_NPCX7
	default 1536 if SOC_SERIES_NPCX9 && PLATFORM_EC_LOG_TOKENIZED
	default 1200 if SOC_SERIES_NPCX9

config IDLE_STACK_SIZE
	default 500 if SOC_SERIES_ITE_IT8XXX2
	default 192 if SOC_SERIES_NPCX7
	default 400 if SOC_SERIES_NPCX9

config ISR_STACK_SIZE
	default 1024 if SOC_SERIES_ITE_IT8XXX2
	default 1024 if SOC_SERIES_NPCX7
	default 1024 if SOC_SERIES_NPCX9

config SHELL_STACK_SIZE
	default 1536 if SOC_SERIES_ITE_IT8XXX2
	default 1536 if SOC_SERIES_NPCX7
	default 1536 if SOC_SERIES_NPCX9

config SYSTEM_WORKQUEUE_STACK_SIZE
	default 1536 if SOC_SERIES_ITE_IT8XXX2
	default 1024 if SOC_SERIES_NPCX7
	default 1024 if SOC_SERIES_NPCX9

# Chromium EC stack sizes

config TASK_CHARGER_STACK_SIZE
	default 1280 if SOC_SERIES_ITE_IT8XXX2
	default 704 if SOC_SERIES_NPCX7
	default 1056 if SOC_SERIES_NPCX9

config TASK_CHIPSET_STACK_SIZE
	default 820 if SOC_SERIES_ITE_IT8XXX2
	default 1280 if AP_X86 && PLATFORM_EC_LOG_TOKENIZED
	default 1056 if AP_X86
	default 684 if AP_ARM && SOC_SERIES_NPCX7
	default 1056 if AP_ARM && SOC_SERIES_NPCX9

config TASK_HOSTCMD_STACK_SIZE
	default 1152 if SOC_SERIES_ITE_IT8XXX2
	default 800 if SOC_SERIES_NPCX7
	default 800 if SOC_SERIES_NPCX9

config TASK_KEYPROTO_STACK_SIZE
	default 1280 if SOC_SERIES_ITE_IT8XXX2
	default 800 if SOC_SERIES_NPCX7
	default 800 if SOC_SERIES_NPCX9

config TASK_KEYSCAN_STACK_SIZE
	default 1280 if SOC_SERIES_ITE_IT8XXX2
	default 1024 if SOC_SERIES_NPCX7
	default 1024 if SOC_SERIES_NPCX9

config TASK_MOTIONSENSE_STACK_SIZE
	default 1280 if SOC_SERIES_ITE_IT8XXX2
	default 1024 if SOC_SERIES_NPCX7
	default 1024 if SOC_SERIES_NPCX9

config TASK_POWERBTN_STACK_SIZE
	default 1280 if SOC_SERIES_ITE_IT8XXX2
	default 800 if SOC_SERIES_NPCX7
	default 800 if SOC_SERIES_NPCX9

config TASK_PD_STACK_SIZE
	default 1536 if SOC_SERIES_ITE_IT8XXX2
	default 1184 if SOC_SERIES_NPCX7
	default 1184 if SOC_SERIES_NPCX9

config TASK_PD_ALTMODE_INTEL_STACK_SIZE
	default 1536 if SOC_SERIES_ITE_IT8XXX2
	default 1184 if SOC_SERIES_NPCX7
	default 1184 if SOC_SERIES_NPCX9

config TASK_PD_INT_STACK_SIZE
	default 1152 if SOC_SERIES_ITE_IT8XXX2
	default 880 if SOC_SERIES_NPCX7
	default 880 if SOC_SERIES_NPCX9

config TASK_USB_CHG_STACK_SIZE
	default 1152 if SOC_SERIES_ITE_IT8XXX2
	default 800 if SOC_SERIES_NPCX7
	default 800 if SOC_SERIES_NPCX9

config TASK_USB_MUX_STACK_SIZE
	default 1280 if SOC_SERIES_ITE_IT8XXX2
	default 1024 if SOC_SERIES_NPCX7
	default 1024 if SOC_SERIES_NPCX9

config AP_PWRSEQ_STACK_SIZE
	default 1280 if SOC_SERIES_ITE_IT8XXX2
	default 1280 if SOC_SERIES_NPCX7
	default 1280 if SOC_SERIES_NPCX9
	default 1280 # Needed since there is no other default
```

## zephyr/Kconfig.svdm_rsp
```kconfig
# Copyright 2022 The ChromiumOS Authors
# Use of this source code is governed by a BSD-style license that can be
# found in the LICENSE file.

if PLATFORM_EC_USB_POWER_DELIVERY

choice SVDM_RSP_CHOICE
	prompt "SVDM handler implementation"
	# Default value is the first listed choice that has satisfied
	# dependencies: this defaults to DFP_ONLY if possible.
	help
	  Select how USB-PD Structured Vendor Defined Messages (SVDM) will be
	  handled.

config SVDM_RSP_DFP_ONLY
	bool "DFP-only"
	# USB4 and TBT modes require more support
	depends on !PLATFORM_EC_USB_PD_USB4
	depends on !PLATFORM_EC_USB_PD_TBT_COMPAT_MODE
	# DRDs are not DFP-only
	depends on !PLATFORM_EC_USB_PD_USB32_DRD
	help
	  Respond to Discover Identity requests only, reporting DFP-only
	  operation on all ports. The Identity response indicates the device has
	  Type-C receptacles and supports USB 3.2, operating as a USB-PD host.

	  This is appropriate for systems that only ever operate as USB hosts
	  and do not require support for more complex modes like USB4 or TBT.

config SVDM_RSP_CUSTOM
	bool "Custom"
	help
	  The application defines SVDM handler functions appropriate to its
	  feature set by populating fields of the svdm_rsp struct:

	      __override const struct svdm_response svdm_rsp = { ... };

	  If any pointer in this struct is NULL, that command is unsupported:
	  matching SVDM commands that are received will be ignored and a
	  Not_Supported reply sent if required. If no definition __overrides
	  the default, all SVDM commands are treated as unsupported.

endchoice
endif  # PLATFORM_EC_USB_POWER_DELIVERY
```
