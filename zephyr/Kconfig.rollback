## zephyr/Kconfig.usb_mux
```kconfig
# Copyright 2022 The ChromiumOS Authors
# Use of this source code is governed by a BSD-style license that can be
# found in the LICENSE file.

menuconfig PLATFORM_EC_USB_MUX
	bool "USB muxes"
	default y
	depends on DT_HAS_CROS_EC_USB_MUX_CHAIN_ENABLED
	help
	  Enables support for USB muxes. These allow multiplexing

if PLATFORM_EC_USB_MUX

config PLATFORM_EC_USB_MUX_TASK
	bool "Run mux set operations in a dedicated thread"
	default n
	help
	  Run a dedicated task to process USB mux sets and HPD, which avoids
	  blocking the PD task on mux updates. This is useful if a mux is slow
	  to update, since blocking PD handling during mux operations can cause
	  timing violations.

config TASK_USB_MUX_STACK_SIZE
	int "USB mux task stack size"
	depends on PLATFORM_EC_USB_MUX_TASK
	default 1024
	help
	  Set the size of the USB mux task stack, in bytes.

config PLATFORM_EC_USB_MUX_AP_CONTROL
	bool "AP USB mux control"
	depends on PLATFORM_EC_USB_MUX_TASK
	help
	  Allows the AP to send commands in order to control any muxes and
	  retimers for the board.

config PLATFORM_EC_USB_MUX_AMD_FP6
	bool "AMD FP6 integrated mux"
	default y
	depends on DT_HAS_AMD_USBC_MUX_AMD_FP6_ENABLED
	help
	  Integrated AMD FP6 mux for USB and DP.  Mux control happens over
	  an i2c channel.

config PLATFORM_EC_USB_MUX_AMD_FP8
	bool "AMD FP8 integrated mux"
	default y
	depends on DT_HAS_AMD_USBC_MUX_AMD_FP8_ENABLED
	help
	  Integrated AMD FP8 mux for USB, DP, and USB4.  Mux control happens over
	  an i2c channel.

config PLATFORM_EC_USB_MUX_IT5205
	bool "ITE IT5205 USB Type-C 3:2 Alternative mode passive mux"
	default y
	depends on DT_HAS_ITE_IT5205_ENABLED
	help
	  This is a USB Type-C 3:2 Alternative mode mux, supporting USB 3.1
	  Gen 2 10Gbps as well as DisplayPort (DP1.4) at 8Gbps. It provides a
	  cross-point mux for low-speed Side-Band-Use (SBU) pins. The mux can
	  be controlled via I2C.

config PLATFORM_EC_USB_MUX_PS8743
	bool "Parade PS8743 USB-C Host Switch with redriver"
	default y
	depends on DT_HAS_PARADE_PS8743_ENABLED || DT_HAS_ZEPHYR_PS8743_EMUL_ENABLED
	help
	  This is a Parade USB 3.1 Gen 1 / DisplayPort (DP) Alt Mode
	  High-Bit-Rate 2 (HBR2) redriver. It provides control of switching
	  modes through either GPIO or I2C.

choice PLATFORM_EC_USB_MUX_TUSB_TYPE
	prompt "Select the TUSB USB-C Redriver type"
	default PLATFORM_EC_USB_MUX_TUSB1064 if DT_HAS_TI_TUSB1064_ENABLED
	default PLATFORM_EC_USB_MUX_TUSB1064 if DT_HAS_ZEPHYR_TUSB1064_EMUL_ENABLED
	help
	  There are three supported types of TUSB USB-C Redriver: TUSB546,
	  TUSB1044, and TUSB1064.

config PLATFORM_EC_USB_MUX_TUSB_NONE
	bool "None"
	help
	  Default option if the board doesn't contain any model of TUSB family.

config PLATFORM_EC_USB_MUX_TUSB546
	bool "TI TUSB546 USB-C DP ALT Mode Linear Redriver Crosspoint Switch"
	help
	  This is a USB Type-C Alt Mode redriving switch supporting USB 3.1 data
	  rates up to 5 Gbps and DisplayPort 1.4 up to 8.1 Gbps for downstream
	  facing port.

config PLATFORM_EC_USB_MUX_TUSB1044
	bool "TI TUSB1044 USB-C 10 Gbps Linear Redriver"
	help
	  This is a USB Type-C Alt Mode redriver. This supports USB 3.1
	  Gen 2 and DisplayPort 1.4 as Alternate Mode. It Provides GPIO and
	  I2C Control for Channel Direction and Equalization.

config PLATFORM_EC_USB_MUX_TUSB1064
	bool "TI TUSB1064 USB-C 10 Gbps Linear Redriver"
	help
	  This is a USB Type-C Alt Mode redriver. This supports USB 3.1
	  Gen 2 and DisplayPort 1.4.

endchoice # PLATFORM_EC_USB_MUX_TUSB_TYPE

endif # PLATFORM_EC_USB_MUX
```

## zephyr/Kconfig.usb_update
```kconfig
# Copyright 2023 The ChromiumOS Authors
# Use of this source code is governed by a BSD-style license that can be
# found in the LICENSE file.

config PLATFORM_EC_USB_UPDATE
	bool "USB update protocol support"
	help
	  Enable the firmware update protocol (see docs/usb_updater.md)
	  over USB interface.

if PLATFORM_EC_USB_UPDATE

config PLATFORM_EC_TOUCHPAD_VIRTUAL_SIZE
	int "Touchpad virtual size"
	help
	  Enable touchpad FW update over USB update protocol, and define
	  the size of the touchpad firmware.

config PLATFORM_EC_TOUCHPAD_VIRTUAL_OFF
	int "Touchpad virtual address"
	help
	  Enable touchpad FW update over USB update protocol, and define
	  the virtual address of the touchpad firmware.

config PLATFORM_EC_USB_PAIRING
	bool "Pairing support"
	select PLATFORM_EC_CURVE25519
	help
	  Add support for pairing over the USB update interface

config PLATFORM_EC_UPDATE_PDU_SIZE
	int "Maximum size allowed in the update protocol"
	default 1024
	help
	  Maximum size of an update protocol data unit (PDU). (see
	  docs/usb_updater.md)

config PLATFORM_EC_TOUCHPAD_HASH_FW
	bool "Include hashes of the touchpad FW in the EC image"
	help
	  Include hashes of the touchpad FW in the EC image.
	  If enabled, the SHA256 hash of the touchpad FW is stored in EC's
	  `touchpad_fw_hashes` and `touchpad_fw_full_hash` section.
	  EC will verify if the received FW chunk using the hashes.

	  To enable this feature, board should include cros/touchpad_hashes.dtsi
	  in their dts file, and set the size of `touchpad_fw_hashes` section to
	  `(TOUCHPAD_VIRTUAL_SIZE / UPDATE_PDU_SIZE) * 32`.

config PLATFORM_EC_USB_CONSOLE_READ
	bool "Enable support for reading the EC console via the USB interface"
	select PLATFORM_EC_HOSTCMD
	help
	  This option enables support for reading the EC console via the USB
	  interface.

endif # PLATFORM_EC_USB_UPDATE
```

## zephyr/Kconfig.usba
```kconfig
# Copyright 2022 The Chromium OS Authors. All rights reserved.
# Use of this source code is governed by a BSD-style license that can be
# found in the LICENSE file.

menuconfig PLATFORM_EC_USBA
	bool "USB Type-A support"
	help
	  Enable USB Type A ports

	  To use this your board code must provide a usb_port_enable[] array
	  with the GPIOs to use for each port, which may be specified via
	  device tree with "cros-ec,usba-port-enable-pins" nodes. This
	  implements the EC_CMD_USB_CHARGE_SET_MODE host command and provides
	  a 'usbchargemode' console command.

if PLATFORM_EC_USBA

choice
	prompt "Port power control mode"

config PLATFORM_EC_USB_PORT_POWER_DUMB
	bool "Dumb"
	help
	  USB-A ports are controlled with a single GPIO each, where turning it
	  on enables the port and turning it off disables the port.

config PLATFORM_EC_USB_PORT_POWER_SMART
	bool "Smart"
	help
	  USB-A ports are controlled via a smart switch, which allows dynamic
	  selection of port current limits and BC1.2 charging modes as well
	  as a signal to enable or disable power to the port.

endchoice

config PLATFORM_EC_USB_PORT_POWER_DUMB_CUSTOM_HOOK
	bool "Disable default dumb port power hooks"
	depends on PLATFORM_EC_USB_PORT_POWER_DUMB
	help
	  Enable this if your board does not want to use the default S3 hooks
	  from USB_PORT_POWER_DUMB.

if PLATFORM_EC_USB_PORT_POWER_SMART

config PLATFORM_EC_USB_PORT_POWER_SMART_CDP_SDP_ONLY
	bool "CDP/SDP mode only"
	help
	  Enable this if the USB-A smart switch mode selection is fixed and
	  the only control is for CDP or SDP mode via current limit selection.
	  Only the ILIM GPIOs will be controlled, not CTL*.

config PLATFORM_EC_USB_PORT_POWER_SMART_SIMPLE
	bool "Shared 2-wire control"
	depends on !PLATFORM_EC_USB_PORT_POWER_SMART_CDP_SDP_ONLY
	select PLATFORM_EC_USB_PORT_POWER_SMART_INVERTED
	help
	  Enable this if the EC has a single GPIO tied to the CTL1 line and a
	  single ILIM signal, each shared with every USB-A port. This implies
	  that only these lines can be manipulated (CTL2 and CTL3 are fixed in
	  hardware) and that any configuration to one port will also adjust the
	  others.

	  If disabled, the EC controls all of ILIM and CTL1 through CTL3 for
	  every port individually.

config PLATFORM_EC_USB_PORT_POWER_SMART_INVERTED
	bool "ILIM signal polarity is inverted"
	help
	  Select this option if the ILIM signal going to the port controller(s)
	  is inverted, meaning a low value indicates a high current limit and a
	  high value requests a low current limit.

endif # PLATFORM_EC_USB_PORT_POWER_SMART

endif # PLATFORM_EC_USBA
```

## zephyr/Kconfig.usbc_common_altmode
```kconfig
# Copyright 2023 The ChromiumOS Authors
# Use of this source code is governed by a BSD-style license that can be
# found in the LICENSE file.

if PLATFORM_EC_USB_POWER_DELIVERY || PLATFORM_EC_USB_PD_CONTROLLER

config PLATFORM_EC_USB_PD_DP_MODE
	bool "EC-driven DP support"
	depends on !PLATFORM_EC_USB_PD_VDM_AP_CONTROL
	default y
	help
	  This enables support for entering DisplayPort alternate mode as a
	  DFP from the Embedded Controller directly.  This flag gates all the
	  on-EC logic for determining specifics such as VDM contents.

config PLATFORM_EC_USB_PD_REV30
	bool "USB PD Rev3.0 functionality"
	default y
	help
	  Enable this to allow Rev3.0 functionality, including features such as
	  Fast Role Swap, advertising the available power across all ports of a
	  multi-port charger, and USB4. If disabled, only USB Power Delivery
	  Rev2.0 functionality is supported.

	  This defaults to y because PD Rev3.0 is required for USB4
	  functionality.

config PLATFORM_EC_USB_PD_TBT_COMPAT_MODE
	bool "Thunderbolt-compatible mode support"
	depends on PLATFORM_EC_USB_PD_REV30
	default n
	help
	  Enable this to allow entering into Thunderbolt-compatible mode between
	  two port partners. This does not require that USB4 mode be enabled.

config PLATFORM_EC_USB_PD_USB4
	bool "USB4 support"
	depends on PLATFORM_EC_USB_PD_REV30
	default n
	help
	  This enables support for entering into USB4 mode between two port
	  partners. The provides new features such as higher speeds and more
	  flexible multiplexing of data on the cable for different purposes,
	  e.g. attaching multiple displays and storage devices on the same bus.

config PLATFORM_EC_USB_PD_3A_PORTS
	int "Number of USBC ports that can supply 3A"
	default 1
	help
	  Specifies the number of ports the platform can source 3.0A on
	  simultaneously.  When this setting is lower than the total number
	  of USB Type-C ports on the platform, the source policy logic
	  provides 3.0A to connected partners in this order.

	  1. PD capabable sinks that request more than 1.5A in their Get Sink
	     Caps response.
	  2. FRS capable sources that request 3.0A FRS current.
	  3. Non-PD sinks

	  To turn off 3.0A current allocation, set this field to 0.

endif # PLATFORM_EC_USB_POWER_DELIVERY || PLATFORM_EC_USB_PD_CONTROLLER
```

## zephyr/Kconfig.usbc_ss_mux
```kconfig
# Copyright 2022 The ChromiumOS Authors
# Use of this source code is governed by a BSD-style license that can be
# found in the LICENSE file.

config PLATFORM_EC_USBC_SS_MUX
	bool "SuperSpeed mux"
	default y
	help
	  Enable this to support the USB Type-C SuperSpeed Mux. If enabled,
	  the USB stack will call usb_mux_set() to change the mux settings.
	  The board must provide a driver in usb_muxes[] for each port so
	  that this can work.

if PLATFORM_EC_USBC_SS_MUX

config PLATFORM_EC_USB_MUX_RUNTIME_CONFIG
	bool "USB mux runtime config"
	default y
	help
	  Allows the configuration of the USB mux to be set up at runtime. This
	  makes the usb_muxes[] array writable, i.e. not const. It should be
	  declared as such in the board config.

	  This is useful when the board has runtime information that changes
	  the configuration, such as Chromium OS Board Info (CBI set in the
	  factory. Without this, multiple EC images would need to be installed
	  depending on the board.

config PLATFORM_EC_USBC_SS_MUX_DFP_ONLY
	bool "Use SuperSpeed mux only when DFP"
        help
	  Only configure the USB Type-C SuperSpeed Mux when a port is a
	  Downstream Facing Port (DFP). This is needed for chipsets which
	  don't support being an Upstream Facing Port UFP).

config PLATFORM_EC_USB_MUX_VIRTUAL
	bool "USB Mux is virtual"
	default y
	depends on DT_HAS_CROS_EC_USBC_MUX_VIRTUAL_ENABLED
	depends on PLATFORM_EC_USBC_SS_MUX
	help
	  Enable this if a virtual USB mux is supported on the EC, which is
	  actually handled by the AP. In this case the AP gets an interrupt
	  and is is informed when status changes, via the
	  EC_CMD_USB_PD_MUX_INFO host command.

config PLATFORM_EC_USBC_RETIMER_FW_UPDATE
	bool "Support firmware update of USB Type-C retimers"
	depends on PLATFORM_EC_USBC_SS_MUX
	help
	   Enable this to support USB Type-C retimer firmware update. Each
	   Type-C retimer indicates its capability of supporting firmware update
	   independently in its usb_mux_driver.

	   During AP boot-up, the AP scans each PD port for retimers but only
	   if there are no Type-C devices attached to the port. The firmware
	   update can only be performed on retimers which show up in the AP
	   thunderbolt device entries.

endif  # PLATFORM_EC_USBC_SS_MUX
```
