## zephyr/Kconfig.temperature
```kconfig
# Copyright 2021 The ChromiumOS Authors
# Use of this source code is governed by a BSD-style license that can be
# found in the LICENSE file.

menuconfig PLATFORM_EC_TEMP_SENSOR
	bool "Temperature sensors"
	default y
	depends on DT_HAS_CROS_EC_TEMP_SENSORS_ENABLED
	help
	  Support for temperature sensors. Once enabled, "temps" console
	  command and EC_CMD_TEMP_SENSOR_GET_INFO host command are available.

if PLATFORM_EC_TEMP_SENSOR

config PLATFORM_EC_TEMP_SENSOR_POWER
	bool "Temperature sensors are not always powered on"
	help
	  If enabled, temperature sensors require enabling power rail before
	  being read. Enabling it requires to define a pin enabling the power
	  as GPIO_TEMP_SENSOR_POWER.

config PLATFORM_EC_DPTF
	bool "Dynamic Platform and Thermal Framework"
	default y if PLATFORM_EC_ACPI
	help
	  Enables the Dynamic Platform and Thermal Framework (DPTF). DPTF
	  exposes the temperature sensors and the fan controls to the
	  Applicaiton Processor (AP) using Advanced Configuration and Power
	  Interface (ACPI). This permits the AP to control thermal management
	  independent of the EC.

	  Even when DPTF is enabled, the EC still monitors temperature sensors
	  and will take corrective actions for high temperatures such as turning
	  on the fans or powering down the AP.

config PLATFORM_EC_DPTF_PRINTS
	bool "Dynamic Platform and Thermal Framework debug prints"
	default n
	help
	  Enables debug prints for DPTF. These are not needed in normal operation
	  and result in a large amount of console prints when enabled.

config PLATFORM_EC_THERMISTOR
	bool "Thermistor support"
	default y
	depends on DT_HAS_CROS_EC_THERMISTOR_ENABLED
	depends on ADC
	help
	  Enables support for thermistors (resistor whose resistance is
	  strongly dependent on temperature) as temperature-sensor type.

config PLATFORM_EC_TEMP_SENSOR_PCT2075
	bool "PCT2075 support"
	default y
	depends on DT_HAS_NXP_PCT2075_ENABLED
	help
	  Enables support for the CrosEC PCT2075 sensor, an i2c peripheral
	  temperature sensor from NXP.

config PLATFORM_EC_TEMP_SENSOR_SB_TSI
	bool "SB TSI support"
	default y
	depends on DT_HAS_CROS_EC_TEMP_SENSOR_SB_TSI_ENABLED
	help
	  Enables support for the Side Band Temperature Sensor Interface,
	  an i2c peripheral available on AMD platforms.

config PLATFORM_EC_TEMP_SENSOR_TMP112
	bool "TMP112 support"
	default y
	depends on DT_HAS_CROS_EC_TEMP_SENSOR_TMP112_ENABLED
	help
	  Enables support for the CrosEC TMP112 driver, an i2c peripheral
	  temperature sensor from TI.

config PLATFORM_EC_TEMP_SENSOR_F75303
	bool "F75303 support"
	default y
	depends on DT_HAS_CROS_EC_TEMP_SENSOR_F75303_ENABLED
	help
	  Enables support for the CrosEC F75303 driver, an i2c peripheral
	  temperature sensor from TI.

endif # PLATFORM_EC_TEMP_SENSOR


config PLATFORM_EC_TEMP_SENSOR_FIRST_READ_DELAY
	bool "Enable a delay before reading temperature seensors"
	help
	  Enables a delay on the first read of temperature sensors after
	  the EC powers on. This allows for setting of any power rails that
	  control the temperature sensors on the platform.

if PLATFORM_EC_TEMP_SENSOR_FIRST_READ_DELAY

config PLATFORM_EC_TEMP_SENSOR_FIRST_READ_DELAY_MS
	int "Temperature sensor read delay time"
	default 500
	help
	  Sets the delay time, in milliseconds, before the first the EC will
	  read any temperature sensors and perform any thermal management.

endif # PLATFORM_EC_TEMP_SENSOR_FIRST_READ_DELAY

config PLATFORM_EC_FAN
	bool "Fan support"
	default y
	depends on DT_HAS_CROS_EC_FANS_ENABLED
	select PWM
	select SENSOR
	help
	  Enables support for fans. Allows periodic thermal task to
	  automatically set the fan speed (control temperature).
	  Once enabled fanduty, fanset, faninfo, fanauto consol command and
	  EC_CMD_PWM_GET_FAN_TARGET_RPM, EC_CMD_PWM_SET_FAN_TARGET_RPM,
	  EC_CMD_PWM_SET_FAN_DUTY, EC_CMD_THERMAL_AUTO_FAN_CTRL are
	  available. Also enables a periodic task (1s) to verify fan is
	  running (is not stalled).

if PLATFORM_EC_FAN

config PLATFORM_EC_CUSTOM_FAN_CONTROL
	bool "Fan custom control support"
	default n
	help
	  Enable fan custom control to let projects define
	  their own fan control mechanism by EC.

config PLATFORM_EC_FAN_DYNAMIC_CONFIG
	bool "Fan dynamic config support"
	default n
	help
	  Enable fan dynamic config to let projects define
	  their own fan control mechanism by EC.

config PLATFORM_EC_CUSTOM_FAN_DUTY_CONTROL
	bool "Fan custom control support"
	default n
	help
	  Enable fan duty custom control to let projects define
	  their own fan duty control mechanism by implementing
	  the routine board_override_fan_control_duty().


config PLATFORM_EC_NUM_FANS
	int "Number of fans"
	default 1
	help
	  Declare the number of fans supported on this board and avilable
	  for control through fan APIs.

endif # PLATFORM_EC_FAN

config PLATFORM_EC_FAN_BYPASS_SLOW_RESPONSE
	bool "Enable fan slow response control mechanism"
	default n
	help
	  A specific type of fan needs a longer time to output the TACH
	  signal to EC after EC outputs the PWM signal to the fan.
	  During this period, the driver will read two consecutive RPM = 0.
	  In this case, don't step the PWM duty too aggressively.
```

## zephyr/Kconfig.test
```kconfig
# Copyright 2023 The ChromiumOS Authors
# Use of this source code is governed by a BSD-style license that can be
# found in the LICENSE file.

# Common location for test related Kconfigs

if ZTEST

config PLATFORM_EC_TEST_CC_USBPD
	bool "Enable USBPD console channel"
	help
	  Enable USBPD console channel

endif # ZTEST

config HW_TEST
	bool "Include tests that will be run on hardware"
	help
	  Enables building full image with zmake that includes tests.
	  The tests can be run via console or are run automatically depending
	  on a test framework and other configs.

if HW_TEST

config HW_TEST_RW_ONLY
	bool "Include harwdware tests only in the RW copy"
	default y

config HW_TEST_ON
	bool
	default y if HW_TEST_RW_ONLY && CROS_EC_RW
	default y if !HW_TEST_RW_ONLY

if HW_TEST_ON

rsource "test/hwtest/Kconfig"

endif # HW_TEST_ON
endif # HW_TEST
```

## zephyr/Kconfig.throttle_ap
```kconfig
# Copyright 2021 The Chromium OS Authors. All rights reserved.
# Use of this source code is governed by a BSD-style license that can be
# found in the LICENSE file.

if PLATFORM_EC_THROTTLE_AP

config PLATFORM_EC_CHIPSET_CAN_THROTTLE
	bool "CPU can support throttling"
	default y
	help
	  Indicates that the SoC supports throttling. This means that a
	  chipset_throttle_cpu() function is provided by the chipset, to be
	  called to set the throttle state. The typical implementation asserts
	  GPIO_CPU_PROCHOT, to make the CPU slow down.

config PLATFORM_EC_CONSOLE_CMD_APTHROTTLE
	bool "Console command: apthrottle"
	default y
	help
	  This command shows the current status of AP throttling. Both soft
	  (type 0) and hard (type 1) throttling are supported. Soft throttling
	  is typically controlled by the AP via a host event. Hard throttling
	  typically uses the PROCHOT (Processor Hot) signal on x86 CPUs.

	  Example output:

	     AP throttling type 0 is off (0x00000000)
	     AP throttling type 1 is off (0x00000000)

config PLATFORM_EC_THROTTLE_AP_ON_BAT_DISCHG_CURRENT
	bool "Throttle AP based on battery discharge current"
	default n
	help
	  Throttle the CPU when battery discharge current is too high. When
	  this feature is enabled, the threshold value must be set in
	  PLATFORM_EC_THROTTLE_AP_ON_BAT_DISCHG_CURRENT_LIMIT.

if PLATFORM_EC_THROTTLE_AP_ON_BAT_DISCHG_CURRENT

config PLATFORM_EC_THROTTLE_AP_ON_BAT_DISCHG_CURRENT_LIMIT
	int "Discharge current limit in milliamperes"
	default 0
endif

config PLATFORM_EC_THROTTLE_AP_ON_BAT_LOW_VOLTAGE
	bool "Throttle AP based on battery voltage"
	default n
	help
	  Throttle the CPU when battery voltage drops below a defined threshold
	  where the board still boots but some components don't function
	  perfectly. When this feature is enabled, the threshold value must be
	  set in PLATFORM_EC_THROTTLE_AP_ON_BAT_LOW_VOLTAGE_THRESH.

if PLATFORM_EC_THROTTLE_AP_ON_BAT_LOW_VOLTAGE

config PLATFORM_EC_THROTTLE_AP_ON_BAT_LOW_VOLTAGE_THRESH
	int "Low voltage threshold in millivolts"
	default 0
endif

endif # PLATFORM_EC_THROTTLE_AP
```

## zephyr/Kconfig.timer
```kconfig
# Copyright 2021 The Chromium OS Authors. All rights reserved.
# Use of this source code is governed by a BSD-style license that can be
# found in the LICENSE file.

if PLATFORM_EC_TIMER

config PLATFORM_EC_CONSOLE_CMD_GETTIME
	bool "Console command: gettime"
	default y
	help
	  Enable the "gettime" command. This shows the current time (in
	  microseconds since boot) in both hex and in decimal converted to
	  seconds. For example:

	     Time: 0x0000000002706a62 = 40.921698 s


config PLATFORM_EC_CONSOLE_CMD_TIMERINFO
	bool "Console command: timerinfo"
	default y
	help
	  Enable the "timerinfo" command which shows the current time (in
	  microseconds and seconds since boot), the deadline (next time the EC
	  needs to wake up) and a list of active timers along with when they
	  will next fire.

	  Example:

	    Time:     0x0000000002706a62 us,   40.921698 s
	    Deadline: 0x000000000270774d ->    0.003307 s from now
	    Active timers:
	      Tsk  1  0x000000000271db8f ->    0.094509
	      Tsk  4  0x00000000027396b3 ->    0.207953
	      Tsk 13  0x00000000027133a1 ->    0.051519


config PLATFORM_EC_CONSOLE_CMD_WAITMS
	bool "Console command: waitms"
	default y
	help
	  Enable the "waitms" command. This waits for a given number of
	  milliseconds. For example:

	    waitms 100

	  waits for 100ms. Note that long waits can introduce problems since
	  it stops the EC from executing its normal tasks. For example, a
	  two-second wait can cause the EC to reset.

endif # PLATFORM_EC_TIMER
```

## zephyr/Kconfig.touchpad
```kconfig
# Copyright 2023 The ChromiumOS Authors
# Use of this source code is governed by a BSD-style license that can be
# found in the LICENSE file.

config PLATFORM_EC_TOUCHPAD
	bool "Touchpad support"
	select HAS_TASK_TOUCHPAD
	help
	  Enable touchpad support. Enabling this automatically enables
	  HAS_TASK_TOUCHPAD to have a dedicated task for touchpad data
	  pipeline.

	  Must pick a driver from the options below.

config PLATFORM_EC_TOUCHPAD_ELAN
	bool "Elan touchpad driver"
	default y if DT_HAS_ELAN_EKTH3000_ENABLED
	select PLATFORM_EC_TOUCHPAD
	help
	  Adds support for Elan I2C touchpad.
```

## zephyr/Kconfig.usb_charger
```kconfig
# Copyright 2020 The ChromiumOS Authors
# Use of this source code is governed by a BSD-style license that can be
# found in the LICENSE file.

config PLATFORM_EC_USB_CHARGER
	bool "Support charging from a USB-C port"
	default y
	help
	  This enables common BC1.2 (Battery-Charging Specification Rev1.2)
	  charger-detection routines. With this is possible to negotiate a
	  power contract with an attached battery charger and use this to
	  charge the device's battery.

if PLATFORM_EC_USB_CHARGER

config PLATFORM_EC_USB_CHARGER_SINGLE_TASK
	bool
	default y
	help
	  Helper symbol use in the common EC code for Zephyr specific charger
	  changes.


config PLATFORM_EC_BC12_DETECT_DATA_ROLE_TRIGGER
	bool
	default y if USB_BC12_PI3USB9201
	help
	  This is a helper symbol that indicates the BC1.2 chip needs to be
	  triggered on data role swaps in addition to VBUS changes.

config PLATFORM_EC_BC12_DETECT_RT1718S
	bool "Enable support for BC 1.2 detection on the RT1718S"
	depends on DT_HAS_RICHTEK_RT1718S_BC12_ENABLED && PLATFORM_EC_USB_PD_TCPM_RT1718S
	default y
	help
	   This enables the BC 1.2 detection on the highly-integrated RT1718S
	   chip.  Note this chip also functions as a TCPC and a PPC. While the
	   TCPC may be enabled without the BC 1.2 detection, the BC 1.2
	   detection module is currently dependent on the TCPC existing.

config PLATFORM_EC_BC12_DETECT_RT9490
	bool "Enable BC 1.2 detection on the RT9490"
	default y
	depends on DT_HAS_RICHTEK_RT9490_ENABLED || DT_HAS_ZEPHYR_RT9490_EMUL_ENABLED
	depends on PLATFORM_EC_I2C
	help
	   This enables the BC 1.2 detection on the R9490 charging chip.
	   Note this chip provides both charging and BC1.2 detection
	   capabilities. While the charger may be enabled without the BC 1.2
	   detection, the BC 1.2 detection module is currently dependent on the
	   charger existing.

config PLATFORM_EC_BC12_CLIENT_MODE_ONLY_PI3USB9201
	bool "Run as BC1.2 client while using PI3USB9201"
	depends on PLATFORM_EC_BC12_DETECT_PI3USB9201
	default n
	help
	  This is a helper symbol that indicates the PI3USB9201 will only
	  advertise itself as a BC1.2 client, not a BC1.2 host.

config PLATFORM_EC_BC12_DETECT_PI3USB9201
	bool "Enable support for Pericom PI3USB9201"
	default y
	depends on DT_HAS_PERICOM_PI3USB9201_ENABLED || DT_HAS_ZEPHYR_PI3USB9201_EMUL_ENABLED
	select PLATFORM_EC_BC12_DETECT_DATA_ROLE_TRIGGER
	help
	  This is a Dual-Role USB Charging-Type Detector. It can operate in
	  host or client mode. It supports Battery Charging Specification, rev
	  1.2 (BC1.2) with Standard/Charging/Dedicated downstream port
	  (SDP/CDP/DCP) advertisement when in host mode. In client mode it
	  starts BC1.2 detection to detect the attached host type. It provides
	  an I2C interface to report detection results.

config PLATFORM_EC_BC12_DETECT_MT6360
	bool "MediaTek MT6360P PMIC"
	help
	  This PMIC includes a battery charger with an On-The-Go (OTG) output
	  range of 4.85 to 5.825V. It provides integrated ADCs for system
	  monitoring. The MT6360 also supports USB Power Delivery 3.0 with
	  Dual-Role, with host or client mode. It supports alternate mode as
	  well as VCONN with programmable over-current protection (OCP).

config PLATFORM_EC_MT6360_BC12_GPIO
	bool "USB-PHY connection is controlled by a GPIO"
	depends on PLATFORM_EC_BC12_DETECT_MT6360
	help
	  If enabled, the MT6360 USB-PHY connection is controlled by
	  a GPIO: GPIO_BC12_DET_EN. Assert GPIO_BC12_DET_EN to detect a BC1.2
	  device, and deassert GPIO_BC12_DET_EN to mux the USB-PHY back.

endif  # PLATFORM_EC_USB_CHARGER
```

## zephyr/Kconfig.usb_i2c
```kconfig
# Copyright 2024 The ChromiumOS Authors
# Use of this source code is governed by a BSD-style license that can be
# found in the LICENSE file.

config PLATFORM_EC_USB_I2C
	bool "I2C over USB support"
	help
	  Enable the I2C transaction over USB interface.

config PLATFORM_EC_USB_I2C_MAX_READ_COUNT
	int "Max. I2C read count"
	depends on PLATFORM_EC_USB_I2C
	default 1018
	help
	  The maximum count of I2C receive.

config PLATFORM_EC_USB_I2C_MAX_WRITE_COUNT
	int "Max. I2C write count"
	depends on PLATFORM_EC_USB_I2C
	default 1020
	help
	  The maximum count of I2C transmitters.
```
