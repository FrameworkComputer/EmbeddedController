## zephyr/Kconfig.tabletmode
```kconfig
# Copyright 2023 The ChromiumOS Authors
# Use of this source code is governed by a BSD-style license that can be
# found in the LICENSE file.

config PLATFORM_EC_TABLET_MODE
    bool "Tablet Mode"
    help
      Enable this for a device which can be a tablet as well as a clamshell.
      Tablet mode detection is done either by using the lid angle
      measurement, or by the dedicated GMR sensor; or from external sensor hub
      via GPIO, or I2C. One example of the external sensor hub is ISH.

if PLATFORM_EC_TABLET_MODE

config PLATFORM_EC_TABLET_MODE_SWITCH
    bool "Tablet Mode Switch"
    depends on PLATFORM_EC_MKBP_INPUT_DEVICES
    help
      Enable a virtual switch to indicate when we are in tablet mode. The tablet
      mode state is sent to AP via MKBP protocol(switch event).

config PLATFORM_EC_GMR_TABLET_MODE
    bool "Giant Magnetoresistance(GMR) Tablet Mode"
    help
      Enable this to use GMR sensor to detect tablet mode.
      It requires to set GPIO_TABLET_MODE_L to map the interrupt from
      the sensor and direct its mapping to gmr_tablet_switch_isr
      in common/tablet_mode.c.

config PLATFORM_EC_DPTF_MOTION_LID_NO_GMR_SENSOR
    bool
    default y
    depends on !PLATFORM_EC_GMR_TABLET_MODE
    depends on PLATFORM_EC_MOTIONSENSE
    help
      Enable lid angle calculation as the only source of the tablet mode switch.
      For this to work, we must have enabled tablet mode, not have a GMR sensor,
      and have motionsense enabled.

config PLATFORM_EC_TABLET_MODE_SKIP_LID_CLOSE
    bool "Skip lid close"
    help
      Due to hardware design limitations that may trigger accidental lid close
      when devices are stacked, this configuration skips lid close event when
      the system is in tablet mode

config PLATFORM_EC_GMR_SENSOR_DEBOUNCE_US
	int "GMR tablet mode sensor debounce delay (microseconds)"
	default 40000
	help
	  Delay between seeing a table mode switch change and sampling
	  the new state.
	  Default is 10 milliseconds longer than the default lid switch
	  debounce delay (LID_DEBOUNCE_US).

config PLATFORM_EC_EXTERNAL_NOTEBOOK_MODE
    bool "Notify EC for clamshell/tablet mode change"
    depends on PLATFORM_EC_TABLET_MODE
    help
      Enable this option when the motionsense task runs on a separate processor
      (such as the ISH) so that the motionsense task can notify the EC for
      clamshell/tablet mode changes. The motionsense task notifies the EC
      using the GPIO mapped to the devicetree alias "gpio_nb_mode".

endif # PLATFORM_EC_TABLET_MODE
```

## zephyr/Kconfig.tasks
```kconfig
# Copyright 2020 The ChromiumOS Authors
# Use of this source code is governed by a BSD-style license that can be
# found in the LICENSE file.

# Please keep these tasks in alphabetical order

menu "Tasks"

config TASKS_SET_TEST_RUNNER_TID_RULE
	bool "Automatically call set_test_runner_tid() for each test"
	depends on ZTEST
	help
	  This enables the test rule which will run before each unit test and
	  call set_test_runner_tid(). This function is needed to allow-list the
	  new thread created by ztest to access some of the components in the
	  EC.

config HAS_TASK_CHARGER
	bool
	depends on PLATFORM_EC_BATTERY
	help
	  This turns on the charger task. This deals with monitoring the
	  battery to make sure it is present and is responding properly to
	  requests. If the battery is not full, it enables charging from a
	  suitable power source.

if HAS_TASK_CHARGER

config TASK_CHARGER_STACK_SIZE
	int "CHARGER task stack size"
	default 1024	# EC uses VENTI_TASK_STACK_SIZE which is 896
	help
	  The stack size of the charger task.

	  See b/176180736 for checking these stack sizes.

endif # HAS_TASK_CHARGER

config HAS_TASK_CHG_RAMP
	bool
	depends on PLATFORM_EC_BATTERY
	help
	  This turns on the charger ramp task. This attempts to ramp up the
	  current from an attached charger to the maximum available current.
	  It handles the incoming VBUS voltage sagging as well as the user
	  attaching different chargers.

if HAS_TASK_CHG_RAMP

config TASK_CHG_RAMP_STACK_SIZE
	int "CHG_RAMP task stack size"
	default 768	# EC uses TASK_STACK_SIZE which is 512 for npcx
	help
	  The stack size of the charger task.

	  See b/176180736 for checking these stack sizes.

endif # HAS_TASK_CHG_RAMP

config HAS_TASK_CHIPSET
	bool
	depends on PLATFORM_EC_POWERSEQ
	help
	  This turns on the chipset task which handles powering the chipset
	  on and off. Powering on involves going through a sequence of enabling
	  different power rails (e.g. by enabling GPIOs that control a PMIC)
	  and monitoring power-good indicators to meet the specifications
	  defined by the vendor.

if HAS_TASK_CHIPSET

config TASK_CHIPSET_STACK_SIZE
	int "CHIPSET task stack size"
	default 1024
	help
	  The stack size of the power button task.

endif # HAS_TASK_CHIPSET

config HAS_TASK_HOSTCMD
	bool
	depends on PLATFORM_EC_HOSTCMD
	help
	  This turns on the hostcmd task which handles communication with the
	  AP. The AP sends a command to the EC and it responds when able. An
	  interrupt can be used to indicate to the AP that the EC has something
	  for it.

if HAS_TASK_HOSTCMD

choice TASK_HOSTCMD_THREAD_MODE
	prompt "Host command thread selection"
	default TASK_HOSTCMD_THREAD_DEDICATED if ZTEST

config TASK_HOSTCMD_THREAD_MAIN
	bool "Run the host command in the main thread"
	help
	  Run the HOSTCMD task in the main thread, reusing the main thread
	  resources. Set the stack size using MAIN_STACK_SIZE.

config TASK_HOSTCMD_THREAD_DEDICATED
	bool "Run the host command in a dedicated thread"
	help
	  Run the HOSTCMD task in a dedicated thread.

endchoice

config TASK_HOSTCMD_STACK_SIZE
	int "HOSTCMD task stack size"
	depends on TASK_HOSTCMD_THREAD_DEDICATED
	default 1024
	help
	  The size of the host-command task stack.

endif # HAS_TASK_HOSTCMD

config HAS_TASK_KEYPROTO
	bool
	depends on PLATFORM_EC_KEYBOARD_PROTOCOL_8042
	help
	  This turns on the keyproto task which handles conversion of keyboard
	  scans into i8042 messages on x86 platforms. This is not used or needed
	  on ARM platforms, which send the raw keyboard scans to the AP for
	  processing.

if HAS_TASK_KEYPROTO

config TASK_KEYPROTO_STACK_SIZE
	int "KEYPROTO task stack size"
	default 768
	help
	  The stack size of the keyproto task.

endif # HAS_TASK_KEYPROTO

config HAS_TASK_KEYSCAN
	bool
	help
	  This turns on the keyscan task which handles scanning the keyboard
	  and producing a list of changes in the key state. This list can either
	  be sent to the keyboard-protocol task or directly to the AP for
	  processing.

if HAS_TASK_KEYSCAN

config TASK_KEYSCAN_STACK_SIZE
	int "KEYSCAN task stack size"
	default 768
	help
	  The stack size of the keyscan task.

endif # HAS_TASK_KEYSCAN

config HAS_TASK_MOTIONSENSE
	bool
	help
	  This turns on the motion sense task which collects sensor data from the
	  sensors and reports them to AP. Using the data, it also produces other
	  meaningful reports to AP like lid angle and tablet mode.

if HAS_TASK_MOTIONSENSE

config TASK_MOTIONSENSE_STACK_SIZE
	int "MOTIONSENSE task stack size"
	default 4096
	help
	  The size of the motion sense task stack.

endif # HAS_TASK_MOTIONSENSE

config HAS_TASK_POWERBTN
	bool
	depends on PLATFORM_EC_POWER_BUTTON
	help
	  This turns on the powerbtn task which handles monitoring the power
	  button. When the application processor (AP) is off (S5 or G3 states),
	  this task triggers a power-up sequence on a power-button press. When
	  the AP is on (S3 or above state) x86 machines normally reset when the
	  power button is held for 4 seconds but this tasks adjusts that to 8
	  seconds, to allow time for the usual Chromium OS shutdown sequence.

if HAS_TASK_POWERBTN

config TASK_POWERBTN_STACK_SIZE
	int "POWERBTN task stack size"
	default 1024
	help
	  The stack size of the power-button task.

endif # HAS_TASK_POWERBTN

if PLATFORM_EC_USB_POWER_DELIVERY

config TASK_PD_STACK_SIZE
	int "PD tasks stack size"
	default 1024	# EC uses VENTI_TASK_STACK_SIZE which is 896
	help
	  The stack size of the PD_Cx tasks.

config TASK_PD_INT_STACK_SIZE
	int "PD_INT task stack size"
	default 1280
	help
	  The stack size of the PD_Cn_INT tasks.

endif # PLATFORM_EC_USB_POWER_DELIVERY

if HAS_TASK_DPS

config TASK_DPS_STACK_SIZE
	int "DPS task stack size"
	default 1024
	help
	  The stack size of the DPS task.

endif # HAS_TASK_DPS

config HAS_TASK_DPS
	bool
	depends on PLATFORM_EC_USB_PD_DPS
	help
	  This turns on the DPS task which evalutes the SRCCAP from all the SNK
	  ports and issues a new power request to the port which has the most
	  efficient power data object (PDO).


config HAS_TASK_PD_INT_SHARED
	bool # Selected by PLATFORM_EC_USB_PD_INT_SHARED
	help
	  This turns on the PD_INT_SHARED task which services PD message
	  interrupts for any port which has a shared IRQ enabled.


if PLATFORM_EC_USB_POWER_DELIVERY

config TASK_USB_CHG_STACK_SIZE
	int "USB_CHG tasks stack size"
	default 1280	# EC uses VENTI_TASK_STACK_SIZE which is 896
	help
	  The stack size of the USB charger task. If there are multiple tasks,
	  each one gets the same stack size.

	  See b/176180736 for checking these stack sizes.

endif # PLATFORM_EC_USB_POWER_DELIVERY

config HAS_TASK_TOUCHPAD
	bool
	help
	  This turns on the touchpad task which handles the input event from
	  touchpad, and forwards the event to AP through either USB-HID or MKBP
	  interface.

if HAS_TASK_TOUCHPAD

config TASK_TOUCHPAD_STACK_SIZE
	int "TOUCHPAD task stack size"
	default 1280
	help
	  The stack size of the touchpad task.

	  See b/176180736 for checking these stack sizes.

endif # HAS_TASK_CHG_RAMP

config HAS_TASK_RWSIG
	bool # Selected by PLATFORM_EC_RWSIG
	help
	  This turns on the RWSIG task which verifys and jumps to the RW
	  firmware automatically.

if HAS_TASK_RWSIG

config TASK_RWSIG_STACK_SIZE
	int "RWSIG task stack size"
	default 1536
	help
	  The stack size of the RWSIG task.

	  See b/176180736 for checking these stack sizes.

endif # HAS_TASK_RWSIG

config HAS_TASK_CEC
	bool # Selected by PLATFORM_EC_CEC
	help
	  Enable the CEC task, which sends CEC messages from the AP on the
	  appropriate CEC bus, and passes received messages back to the AP.

if HAS_TASK_CEC

config TASK_CEC_STACK_SIZE
	int "CEC task stack size"
	default 800	# Most boards use LARGER_TASK_STACK_SIZE = 800 on npcx
	help
	  The stack size of the CEC task.

endif # HAS_TASK_CEC

config HAS_TASK_FPSENSOR
	bool # Selected by PLATFORM_EC_FINGERPRINT
	help
	  This turns on the FPSENSOR task which provides fingerprint
	  authentication service.

if HAS_TASK_FPSENSOR

config TASK_FPSENSOR_STACK_SIZE
	int "FPSENSOR task stack size"
	default 4096
	help
	  The stack size of the FPSENSOR task.

endif # HAS_TASK_FPSENSOR

endmenu # Tasks
```
