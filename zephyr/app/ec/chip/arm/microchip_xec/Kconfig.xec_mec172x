## zephyr/app/ec/chip/arm/microchip_xec/Kconfig.xec_mec172x
```kconfig
# Copyright 2022 The ChromiumOS Authors
# Use of this source code is governed by a BSD-style license that can be
# found in the LICENSE file.

#
# This file defines the correct defaults when using the MEC172x series chipset
#

if SOC_SERIES_MEC172X

#
# MEC1727NSZ: 416KB total SRAM as 352 KiB Code and 64 KiB data.
#             Top 2KB of data SRAM used by Boot-ROM and a 1KB persistent
#             region for customer use.
#             512 KiB internal SPI flash

# Code RAM base for MEC172x series
# First 4KB reserved for SRAM based EC LFW functionality
# Experiment remove reserve of first 4KB and use ROM load API
config CROS_EC_PROGRAM_MEMORY_BASE
	default 0xc0000

# Data SRAM base
config CROS_EC_RAM_BASE
	default 0x118000

# Total data SRAM size
config CROS_EC_DATA_RAM_SIZE
	default 0x010000

# Top 2KB reserved for PUF leaving 62KB
# 61KB for data + 1KB persistent across chip reset.
config CROS_EC_RAM_SIZE
	default 0x00f800

config FLASH_SIZE
	default 512

config CROS_EC_RO_MEM_OFF
	default 0x0

# was 0x40000
config CROS_EC_RO_SIZE
	default 0x3F000

# RW firmware in program memory - Identical to RO, only one image loaded at a
# time.
config CROS_EC_RW_MEM_OFF
	default 0x0

config CROS_EC_RW_SIZE
	default 0x40000

endif # SOC_SERIES_MEC172X
```

## zephyr/app/ec/chip/arm/nuvoton_npcx/Kconfig.npcx
```kconfig
# Copyright 2021 The ChromiumOS Authors
# Use of this source code is governed by a BSD-style license that can be
# found in the LICENSE file.

#
# This file defines the default config values shared by all NPCX chipsets
#

if SOC_FAMILY_NPCX

# Enable MPU for ARM targets
config ARM_MPU
	default y

# Enable NPCX firmware header generator
config NPCX_HEADER
	default y

choice NPCX_HEADER_SPI_MAX_CLOCK_CHOICE
	default NPCX_HEADER_SPI_MAX_CLOCK_50
endchoice

choice NPCX_HEADER_SPI_READ_MODE_CHOICE
	default NPCX_HEADER_SPI_READ_MODE_DUAL
endchoice

choice NPCX_HEADER_CORE_CLOCK_SPI_CLOCK_RATIO_CHOICE
	default NPCX_HEADER_CORE_CLOCK_SPI_CLOCK_RATIO_2
endchoice

# ADC
# The resolution and oversamplig values are fixed by the NPCX ADC driver
config PLATFORM_EC_ADC_RESOLUTION
	default 10

config PLATFORM_EC_ADC_OVERSAMPLING
	default 0

# Set the system clock to 15MHz.
config SYS_CLOCK_HW_CYCLES_PER_SEC
	default 15000000

if WATCHDOG

# Set the delay time for printing panic data.
config WDT_NPCX_WARNING_LEADING_TIME_MS
	default 500

endif # WATCHDOG

# The maximum supported time the NPCX can spend in deep-sleep with instant
# wake is 200 ms, so the hook tick interval is set to match.
config CROS_EC_HOOK_TICK_INTERVAL
	default 200000

endif # SOC_FAMILY_NPCX
```

## zephyr/app/ec/chip/arm/nuvoton_npcx/Kconfig.npcx7
```kconfig
# Copyright 2021 The Chromium OS Authors. All rights reserved.
# Use of this source code is governed by a BSD-style license that can be
# found in the LICENSE file.

#
# This file defines the correct defaults when using the NPCX7 series chipset
#

if SOC_SERIES_NPCX7

#
# NPCX796FB: 1024 KiB Flash, 192 KiB code RAM, 62 KiB data RAM
# NPCX796FC: 512 KiB Flash, 192 KiB code RAM, 62 KiB data RAM
# NPCX797FC: 512 KiB Flash, 320 KiB code RAM, 62 KiB data RAM
#

# Code RAM base for NPCX7 series
config CROS_EC_PROGRAM_MEMORY_BASE
	default 0x10090000 if SOC_NPCX7M6FB || SOC_NPCX7M6FC
	default 0x10070000 if SOC_NPCX7M7FC

config CROS_EC_RAM_BASE
	default 0x200c0000

config CROS_EC_DATA_RAM_SIZE
	default 0x00010000

config CROS_EC_RAM_SIZE
	default 0x0000f800

config FLASH_SIZE
	default 1024 if SOC_NPCX7M6FB
	default 512  if SOC_NPCX7M6FC || SOC_NPCX7M7FC

config CROS_EC_RO_MEM_OFF
	default 0x0

# NPCX796FB/NPCX796FC: Image size limited by code RAM size (192 KiB)
# NPCX797FC:           Image size limited by 1/2 Flash size (256 KiB)
config CROS_EC_RO_SIZE
	default 0x30000 if SOC_NPCX7M6FB || SOC_NPCX7M6FC
	default 0x40000 if SOC_NPCX7M7FC

# RW firmware in program memory - Identical to RO, only one image loaded at a
# time.
config CROS_EC_RW_MEM_OFF
	default 0x0

config CROS_EC_RW_SIZE
	default 0x30000 if SOC_NPCX7M6FB || SOC_NPCX7M6FC
	default 0x40000 if SOC_NPCX7M7FC

endif # SOC_SERIES_NPCX7
```

## zephyr/app/ec/chip/arm/nuvoton_npcx/Kconfig.npcx9
```kconfig
# Copyright 2021 The ChromiumOS Authors
# Use of this source code is governed by a BSD-style license that can be
# found in the LICENSE file.

#
# This file defines the correct defaults when using the NPCX9 series chipset
#

if SOC_SERIES_NPCX9

#
# NPCX993F: 512 KiB Flash, 256 KiB code RAM, 64 KiB data RAM
# NPCX996F: 512 KiB Flash, 192 KiB code RAM, 64 KiB data RAM
# NPCX997F: 1024 KiB Flash, 320 KiB code RAM, 64 KiB data RAM
# NPCX997FB: 512 KiB Flash, 256 KiB code RAM, 128 KiB data RAM
# NPCX99FP: 1024 KiB Flash, 416 KiB code RAM, 92 KiB data RAM
#

# Code RAM base for NPCX9 series
config CROS_EC_PROGRAM_MEMORY_BASE
	default 0x10080000 if SOC_NPCX9M3F
	default 0x10090000 if SOC_NPCX9M6F
	default 0x10070000 if SOC_NPCX9M7F || SOC_NPCX9M7FB
	default 0x10058000 if SOC_NPCX9MFP

config CROS_EC_RAM_BASE
	default 0x200b0000 if SOC_NPCX9M7FB
	default 0x200c0000

config CROS_EC_DATA_RAM_SIZE
	default 0x00018000 if SOC_NPCX9MFP
	default 0x00020000 if SOC_NPCX9M7FB
	default 0x00010000

config CROS_EC_RAM_SIZE
	default 0x00017000 if SOC_NPCX9MFP
	default 0x00020000 if SOC_NPCX9M7FB
	default 0x0000f800

config CROS_EC_RO_MEM_OFF
	default 0x0

# NPCX993F: Image size limited by 1/2 Flash size (256 KiB) and
#           code RAM size (256 KiB)
# NPCX996F: Image size limited by code RAM size (192 KiB)
# NPCX997F: Image size limited by code RAM size (320 KiB)
# NPCX997FB: Image size limited by 1/2 Flash size (256 KiB)
# NPCX99FP: Image size limited by code RAM size (416 KiB)

config CROS_EC_RO_SIZE
	default 0x40000 if SOC_NPCX9M3F || SOC_NPCX9M7FB
	default 0x30000 if SOC_NPCX9M6F
	default 0x50000 if SOC_NPCX9M7F
	default 0x68000 if SOC_NPCX9MFP

config CROS_EC_RW_MEM_OFF
	default 0x0

config CROS_EC_RW_SIZE
	default 0x40000 if SOC_NPCX9M3F || SOC_NPCX9M7FB
	default 0x30000 if SOC_NPCX9M6F
	default 0x50000 if SOC_NPCX9M7F
	default 0x68000 if SOC_NPCX9MFP

endif # SOC_SERIES_NPCX9
```

## zephyr/app/ec/chip/arm/st_stm32/Kconfig.stm32
```kconfig
# Copyright 2023 The ChromiumOS Authors.
# Use of this source code is governed by a BSD-style license that can be
# found in the LICENSE file.

if SOC_FAMILY_STM32

DT_CHOSEN_Z_SRAM := zephyr,sram

config CROS_EC_PROGRAM_MEMORY_BASE
	default FLASH_BASE_ADDRESS

config CROS_EC_RAM_BASE
	default SRAM_BASE_ADDRESS

config CROS_EC_DATA_RAM_SIZE
	default $(dt_chosen_reg_size_hex,$(DT_CHOSEN_Z_SRAM))

config CROS_EC_RAM_SIZE
	default $(dt_chosen_reg_size_hex,$(DT_CHOSEN_Z_SRAM))

config CROS_EC_RO_MEM_OFF
	default $(dt_node_int_prop_hex,/binman/wp-ro,offset)

config CROS_EC_RW_MEM_OFF
	default $(dt_node_int_prop_hex,/binman/ec-rw,offset)

# Tell the linker where the RO/RW part is.
config FLASH_LOAD_OFFSET
	default CROS_EC_RO_MEM_OFF if CROS_EC_RO
	default CROS_EC_RW_MEM_OFF if CROS_EC_RW

endif # SOC_FAMILY_STM32
```

## zephyr/app/ec/chip/riscv/riscv-ite/Kconfig.it8xxx2
```kconfig
# Copyright 2021 The ChromiumOS Authors
# Use of this source code is governed by a BSD-style license that can be
# found in the LICENSE file.

if SOC_FAMILY_ITE_EC

# Code RAM base for IT8XXX2
config CROS_EC_PROGRAM_MEMORY_BASE
	default 0x80000000

# The total RAM size of IT8xxx2 is 60 KB.
# The first 4KB block be always reserved for ram code functions,
# so the total available RAM size will be 56KB.
config CROS_EC_RAM_BASE
	default 0x80101000

config CROS_EC_DATA_RAM_SIZE
	default 0x0000e000

config CROS_EC_RAM_SIZE
	default 0x0000e000

# Image size is configured with binman's property.
# (CROS_EC_RO_SIZE and CROS_EC_RW_SIZE)
config CROS_EC_RO_MEM_OFF
	default 0x0

config CROS_EC_RW_MEM_OFF
	default $(dt_node_int_prop_hex,/binman/ec-rw,offset)

config FLASH_LOAD_OFFSET
	default CROS_EC_RW_MEM_OFF if CROS_EC_RW

endif # SOC_FAMILY_ITE_EC
```

## zephyr/app/ec/soc/Kconfig
```kconfig
# Copyright 2021 The ChromiumOS Authors
# Use of this source code is governed by a BSD-style license that can be
# found in the LICENSE file.

menuconfig AP
	bool "Enable AP SoC support code"
	default y
	help
	  This device has an application processor (AP) on-board and
	  support code should be enabled.

if AP

choice
	prompt "SoC chipset generation"

config AP_X86_INTEL_CML
	bool "AP is CML chipset"
	select AP_X86_INTEL
	help
	  The application processor is Intel Comet Lake (CML) chipset.

config AP_X86_INTEL_TGL
	bool "AP is TGL chipset"
	select AP_X86_INTEL
	help
	  The application processor is Intel Tiger Lake (TGL) chipset.

config AP_X86_INTEL_ADL
	bool "AP is ADL chipset"
	select AP_X86_INTEL
	help
	  The application processor is Intel Alder Lake (ADL) chipset.

config AP_X86_AMD
	bool "AP is an AMD chipset"
	select AP_X86
	help
	  The application processor is a product of AMD.

config AP_X86_INTEL_MTL
	bool "AP is MTL chipset"
	select AP_X86_INTEL
	help
	  The application processor is Intel Meteor Lake (MTL) chipset.

config AP_ARM_MTK_MT8192
	bool "MediaTek MT8192"
	select AP_AARCH64
	help
	  The application processor is a MediaTek MT8192 processor.

config AP_ARM_MTK_MT8186
	bool "MediaTek MT8186"
	select AP_AARCH64
	help
	  The application processor is a MediaTek MT8186 processor.

config AP_ARM_MTK_MT8188
	bool "MediaTek MT8188"
	select AP_AARCH64
	help
	  The application processor is a MediaTek MT8188 processor.

config AP_ARM_MTK_MT8196
	bool "MediaTek MT8196"
	select AP_AARCH64
	help
	  The application processor is a MediaTek MT8196 processor.

config AP_ARM_QUALCOMM_SC7180
	bool "Qualcomm Snapdragon SC7180"
	select AP_AARCH64
	help
	  The application processor is a Qualcomm Snapdragon SC7180
	  ARMv8 processor.

config AP_ARM_QUALCOMM_SC7280
	bool "Qualcomm Snapdragon SC7280"
	select AP_AARCH64
	help
	  The application processor is a Qualcomm Snapdragon SC7280
	  ARMv8 processor.

endchoice

# Invisible meta-symbols generated by the selected chipset.
config AP_X86_INTEL
	bool
	select AP_X86
	help
	  The application processor (AP) is an Intel SoC.

config AP_X86
	bool
	help
	  The application processor (AP) is X86-like.

config AP_AARCH64
	bool
	select AP_ARM
	help
	  The application processor (AP) is 64-bit ARMv8 architecture.

config AP_ARM
	bool
	help
	  The application processor (AP) is ARM-like.

endif # AP
```

## zephyr/boards/arm/brya/Kconfig.defconfig
```kconfig
# Copyright 2021 The Chromium OS Authors. All rights reserved.
# Use of this source code is governed by a BSD-style license that can be
# found in the LICENSE file.

if BOARD_BRYA

config BOARD
	default "brya"

endif # BOARD_BRYA
```

## zephyr/boards/arm/herobrine_npcx9/Kconfig.board
```kconfig
# Copyright 2021 The Chromium OS Authors. All rights reserved.
# Use of this source code is governed by a BSD-style license that can be
# found in the LICENSE file.

# "BOARD" below refers to a Zephyr board, which does not have a 1:1
# mapping with the Chrome OS concept of a board.  By Zephyr's
# conventions, we'll still call it "BOARD_*" to make this more
# applicable to be upstreamed, even though this code is shared by all
# projects using Herobrine-NPCX9 baseboard.
config BOARD_HEROBRINE_NPCX9
	bool "Google Herobrine-NPCX9 Baseboard"
	depends on SOC_NPCX9M3F
	# NPCX doesn't actually have enough ram for coverage, but this will
	# allow generating initial 0 line coverage.
	select HAS_COVERAGE_SUPPORT
```

## zephyr/boards/arm/kohaku/kohaku_defconfig
```kconfig
# Copyright 2021 The Chromium OS Authors. All rights reserved.
# Use of this source code is governed by a BSD-style license that can be
# found in the LICENSE file.

# Zephyr Kernel Configuration
CONFIG_SOC_SERIES_NPCX7=y
CONFIG_SOC_NPCX7M6FC=y

# Platform Configuration
CONFIG_BOARD_KOHAKU=y

# Serial Drivers
CONFIG_SERIAL=y
CONFIG_UART_INTERRUPT_DRIVEN=y

# Enable console
CONFIG_CONSOLE=y
CONFIG_UART_CONSOLE=y

# Pinmux Driver
CONFIG_PINMUX=y

# GPIO Controller
CONFIG_GPIO=y

# Clock configuration
CONFIG_CLOCK_CONTROL=y

# WATCHDOG configuration
CONFIG_WATCHDOG=y

# BBRAM
CONFIG_BBRAM=y
CONFIG_BBRAM_NPCX=y
```

## zephyr/boards/arm/mec1727/mec1727_defconfig
```kconfig
# Copyright 2022 The Chromium OS Authors. All rights reserved.
# Use of this source code is governed by a BSD-style license that can be
# found in the LICENSE file.

# Zephyr Kernel Configuration
CONFIG_SOC_SERIES_MEC172X=y

# Platform Configuration
CONFIG_SOC_MEC172X_NSZ=y
CONFIG_BOARD_MEC1727=y
CONFIG_RTOS_TIMER=y
CONFIG_SYS_CLOCK_HW_CYCLES_PER_SEC=32768
CONFIG_SYS_CLOCK_TICKS_PER_SEC=32768

# Serial Drivers
CONFIG_SERIAL=y
CONFIG_UART_INTERRUPT_DRIVEN=y

# Enable console
CONFIG_CONSOLE=y
CONFIG_UART_CONSOLE=y

# Pinmux Driver
CONFIG_PINMUX=y

# Pinctrl Driver
CONFIG_PINCTRL=y

# GPIO Controller
CONFIG_GPIO=y

# Clock configuration
CONFIG_CLOCK_CONTROL=y

# WATCHDOG configuration
CONFIG_WATCHDOG=y
CONFIG_WDT_XEC=y

# Power Management
#CONFIG_PM=y
#CONFIG_PM_POLICY_APP=y
#CONFIG_UART_CONSOLE_INPUT_EXPIRED=y

# BBRAM
CONFIG_BBRAM=y
CONFIG_BBRAM_XEC=y

# SPI
CONFIG_SPI=y
# MCHP build config error CONFIG_SPI_FLASH=y

# Flash
CONFIG_FLASH=y
CONFIG_SPI_NOR=y
# disabling this causes build error: calling function to read JEDEC ID
# MEC1727 internal SST25PF040 does not support SFDP
CONFIG_FLASH_JESD216_API=y
```

## zephyr/boards/arm/mec172x/Kconfig.board
```kconfig
# Copyright 2022 The ChromiumOS Authors
# Use of this source code is governed by a BSD-style license that can be
# found in the LICENSE file.

# "BOARD" below refers to a Zephyr board, which does not have a 1:1
# mapping with the Chrome OS concept of a board.  By Zephyr's
# conventions, we'll still call it "BOARD_*" to make this more
# applicable to be upstreamed, even though this code is shared by all
# projects using the MEC172x EVB board.
config BOARD_MEC172X
	bool "MEC172X Zephyr Board"
	depends on SOC_MEC172X_NSZ
	# MCHP XEC doesn't actually have enough ram for coverage, but this will
	# allow generating initial 0 line coverage.
	select HAS_COVERAGE_SUPPORT
```

## zephyr/boards/arm/mec172x/Kconfig.defconfig
```kconfig
# Copyright 2022 The ChromiumOS Authors
# Use of this source code is governed by a BSD-style license that can be
# found in the LICENSE file.

if BOARD_MEC172X

config BOARD
	default "mec172x"

# Zephyr internal stack sizes

config IDLE_STACK_SIZE
	default 400

config SYSTEM_WORKQUEUE_STACK_SIZE
	default 1024

# Chromium EC stack sizes

config TASK_CHARGER_STACK_SIZE
	default 1056

config TASK_KEYSCAN_STACK_SIZE
	default 1024

config TASK_PD_STACK_SIZE
	default 1184

config TASK_PD_INT_STACK_SIZE
	default 1024

config TASK_USB_CHG_STACK_SIZE
	default 1024

endif # BOARD_MEC172X
```

## zephyr/boards/arm/mec172x/mec1727_defconfig
```kconfig
# Copyright 2022 The ChromiumOS Authors
# Use of this source code is governed by a BSD-style license that can be
# found in the LICENSE file.

# Zephyr Kernel Configuration
CONFIG_SOC_SERIES_MEC172X=y

# Platform Configuration
CONFIG_SOC_MEC172X_NSZ=y
CONFIG_BOARD_MEC172X=y
CONFIG_RTOS_TIMER=y
CONFIG_SYS_CLOCK_HW_CYCLES_PER_SEC=32768
CONFIG_SYS_CLOCK_TICKS_PER_SEC=32768

# Serial Drivers
CONFIG_SERIAL=y
CONFIG_UART_INTERRUPT_DRIVEN=y

# Enable console
CONFIG_CONSOLE=y
CONFIG_UART_CONSOLE=y

# Pinctrl Driver
CONFIG_PINCTRL=y

# GPIO Controller
CONFIG_GPIO=y
CONFIG_GPIO_GET_CONFIG=y

# Clock configuration
CONFIG_CLOCK_CONTROL=y

# WATCHDOG configuration
CONFIG_WATCHDOG=y

# Power Management
#CONFIG_PM=y
#CONFIG_PM_POLICY_APP=y
#CONFIG_UART_CONSOLE_INPUT_EXPIRED=y

# BBRAM
CONFIG_BBRAM=y

# SPI
CONFIG_SPI=y
# MCHP build config error CONFIG_SPI_FLASH=y

# Flash
CONFIG_FLASH=y
# SPI NOR driver implements read_jedec_id() and read_sfdp() public API’s
# Both API's can be called by application
CONFIG_FLASH_JESD216_API=y
```
