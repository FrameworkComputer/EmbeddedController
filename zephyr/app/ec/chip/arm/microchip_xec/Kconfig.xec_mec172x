## zephyr/boards/arm/npcx7/Kconfig.board
```kconfig
# Copyright 2022 The Chromium OS Authors. All rights reserved.
# Use of this source code is governed by a BSD-style license that can be
# found in the LICENSE file.

config BOARD_NPCX7
	bool "NPCX7 Zephyr Baseboard"
	depends on SOC_NPCX7M7FC
	# NPCX doesn't actually have enough ram for coverage, but this will
	# allow generating initial 0 line coverage.
	select HAS_COVERAGE_SUPPORT
```

## zephyr/boards/arm/npcx7/Kconfig.defconfig
```kconfig
# Copyright 2022 The Chromium OS Authors. All rights reserved.
# Use of this source code is governed by a BSD-style license that can be
# found in the LICENSE file.

if BOARD_NPCX7

config BOARD
	default "npcx7"

endif # BOARD_NPCX7
```

## zephyr/boards/arm/npcx9/Kconfig.board
```kconfig
# Copyright 2021 The Chromium OS Authors. All rights reserved.
# Use of this source code is governed by a BSD-style license that can be
# found in the LICENSE file.

config BOARD_NPCX9
	bool "NPCX9 Zephyr Board"
	depends on SOC_NPCX9M3F || SOC_NPCX9M7F
	# NPCX doesn't actually have enough ram for coverage, but this will
	# allow generating initial 0 line coverage.
	select HAS_COVERAGE_SUPPORT
```

## zephyr/boards/arm/npcx9/Kconfig.defconfig
```kconfig
# Copyright 2021 The ChromiumOS Authors
# Use of this source code is governed by a BSD-style license that can be
# found in the LICENSE file.

if BOARD_NPCX9

config BOARD
	default "npcx9"

if FLASH
config PLATFORM_EC_CONSOLE_CMD_FLASH
	default y
endif # FLASH

endif # BOARD_NPCX9
```

## zephyr/boards/arm/npcx_evb/Kconfig.board
```kconfig
# Copyright 2021 The Chromium OS Authors. All rights reserved.
# Use of this source code is governed by a BSD-style license that can be
# found in the LICENSE file.

# Note: this Zephyr board more closely represents the Chrome OS
# concept of a baseboard.  Zephyr boards and Chrome OS boards do not
# have a 1:1 mapping.
config BOARD_NPCX7_EVB
	bool "NPCX7 Evaluation Board"
	depends on SOC_NPCX7M6FB || SOC_NPCX7M6FC || SOC_NPCX7M7FC
	# Allow generating initial 0 line coverage.
	select HAS_COVERAGE_SUPPORT

config BOARD_NPCX9_EVB
	bool "NPCX9 Evaluation Board"
	depends on SOC_NPCX9M3F || SOC_NPCX9M6F || SOC_NPCX9M7F
	# Allow generating initial 0 line coverage.
	select HAS_COVERAGE_SUPPORT
```

## zephyr/boards/arm/npcx_evb/Kconfig.defconfig
```kconfig
# Copyright 2021 The ChromiumOS Authors
# Use of this source code is governed by a BSD-style license that can be
# found in the LICENSE file.

config BOARD
	default "npcx7_evb" if BOARD_NPCX7_EVB
	default "npcx9_evb" if BOARD_NPCX9_EVB
```

## zephyr/boards/arm/npcx_evb/npcx7_evb_defconfig
```kconfig
# Copyright 2021 The Chromium OS Authors. All rights reserved.
# Use of this source code is governed by a BSD-style license that can be
# found in the LICENSE file.

# Zephyr Kernel Configuration
CONFIG_SOC_SERIES_NPCX7=y
# NPCX7 soc list
#  CONFIG_SOC_NPCX7M6FB
#  CONFIG_SOC_NPCX7M6FC
#  CONFIG_SOC_NPCX7M7FC
CONFIG_SOC_NPCX7M6FC=y

# Platform Configuration
CONFIG_BOARD_NPCX7_EVB=y

# Serial Drivers
CONFIG_SERIAL=y
CONFIG_UART_INTERRUPT_DRIVEN=y

# Enable console
CONFIG_CONSOLE=y
CONFIG_UART_CONSOLE=y

# Pinmux Driver
CONFIG_PINMUX=y

# GPIO Controller
CONFIG_GPIO=y

# Clock configuration
CONFIG_CLOCK_CONTROL=y

# WATCHDOG configuration
CONFIG_WATCHDOG=y

# I2C
CONFIG_I2C=y

# ADC
CONFIG_ADC=y
CONFIG_ADC_SHELL=n

# PWM
CONFIG_PWM=y
CONFIG_PWM_SHELL=n

# Power Management
CONFIG_PM=y
CONFIG_PM_DEVICE=y
CONFIG_PM_POLICY_CUSTOM=y
CONFIG_UART_CONSOLE_INPUT_EXPIRED=y

# BBRAM
CONFIG_BBRAM=y
CONFIG_BBRAM_NPCX=y

# SPI
CONFIG_SPI=y

# Flash
CONFIG_FLASH=y
CONFIG_SPI_NOR=y
CONFIG_FLASH_JESD216_API=y
```

## zephyr/boards/arm/npcx_evb/npcx9_evb_defconfig
```kconfig
# Copyright 2021 The Chromium OS Authors. All rights reserved.
# Use of this source code is governed by a BSD-style license that can be
# found in the LICENSE file.

# Zephyr Kernel Configuration
CONFIG_SOC_SERIES_NPCX9=y
# NPCX9 soc list
#  CONFIG_SOC_NPCX9M3F
#  CONFIG_SOC_NPCX9M6F
CONFIG_SOC_NPCX9M6F=y

# Platform Configuration
CONFIG_BOARD_NPCX9_EVB=y

# Serial Drivers
CONFIG_SERIAL=y
CONFIG_UART_INTERRUPT_DRIVEN=y

# Enable console
CONFIG_CONSOLE=y
CONFIG_UART_CONSOLE=y

# Pinmux Driver
CONFIG_PINMUX=y

# GPIO Controller
CONFIG_GPIO=y

# Clock configuration
CONFIG_CLOCK_CONTROL=y

# WATCHDOG configuration
CONFIG_WATCHDOG=y
```

## zephyr/boards/arm/stm32g4/Kconfig.board
```kconfig
# Copyright 2023 The Chromium OS Authors. All rights reserved.
# Use of this source code is governed by a BSD-style license that can be
# found in the LICENSE file.

config BOARD_STM32G4_G473
	bool "STM32G473"
	depends on SOC_STM32G473XX
	# Enables support for the STM32 HAL drivers
	select HAS_STM32CUBE
	select USE_STM32_HAL_CORTEX
```

## zephyr/boards/arm/stm32g4/stm32g473_defconfig
```kconfig
# Copyright 2023 The ChromiumOS Authors
# Use of this source code is governed by a BSD-style license that can be
# found in the LICENSE file.


# SOC Config
CONFIG_ARM_MPU=y
CONFIG_SOC_SERIES_STM32G4X=y
CONFIG_SOC_STM32G473XX=y

# Pinctrl Driver
CONFIG_PINCTRL=y

# GPIO Controller
CONFIG_GPIO=y

# Enable sys_reboot
CONFIG_REBOOT=y

# Clock configuration
CONFIG_CLOCK_CONTROL=y

# Watchdog configuration
CONFIG_WATCHDOG=y

# Enable HW Stack protection
CONFIG_HW_STACK_PROTECTION=y

# USB configuration
CONFIG_USB_DEVICE_MANUFACTURER="Google Inc."
CONFIG_USB_DEVICE_VID=0x18d1
```
