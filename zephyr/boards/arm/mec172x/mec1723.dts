/* Copyright 2023 Microchip Technology Inc. All rights reserved.
 * Use of this source code is governed by a BSD-style license that can be
 * found in the LICENSE file.
 */

/dts-v1/;

#include "mec172x.dts"

/*
 * MEC1723 External SPI flash information
 * Note: If a different flash chip is used by the platform, board file needs
 * to override it.
 */
&spi0 {
	status = "okay";
	compatible = "microchip,xec-qmspi-ldma";
	clock-frequency = <12000000>;
	lines = <2>;
	chip-select = <0>;
	pinctrl-0 = < &shd_cs0_n_gpio055
		      &shd_clk_gpio056
		      &shd_io0_gpio223
		      &shd_io1_gpio224 >;
	pinctrl-names = "default";

	int_flash: sst25pf040@0 {
		compatible ="jedec,spi-nor";
		/*  268435456 bits = 32M Bytes */
		size = <0x10000000>;
		label = "GD25LR512ME";
		reg = <0>;
		spi-max-frequency = <16000000>;
		status = "okay";
		jedec-id = [c8 67 1a];
	};
};
