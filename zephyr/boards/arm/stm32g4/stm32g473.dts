/* Copyright 2023 The ChromiumOS Authors
 * Use of this source code is governed by a BSD-style license that can be
 * found in the LICENSE file.
 */

/dts-v1/;

#include <st/g4/stm32g473Xc.dtsi>
#include <st/g4/stm32g473m(b-c-e)tx-pinctrl.dtsi>

/ {
	model = "STMicroelectronics STM32G473";
	compatible = "st,stm32g473";

	chosen {
		zephyr,sram = &sram0;
	};
};
