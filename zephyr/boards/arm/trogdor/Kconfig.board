## zephyr/drivers/cros_bbram/Kconfig
```kconfig
# Copyright 2021 The Chromium OS Authors. All rights reserved.
# Use of this source code is governed by a BSD-style license that can be
# found in the LICENSE file.

menuconfig CROS_BBRAM_NPCX
	bool "Nuvoton NPCX battery backed RAM driver for Zephyr"
	depends on SOC_FAMILY_NPCX
	default y
	help
	  This enables the NPCX cros_bbram driver. The NPCX BBRAM module
	  provides 128 bytes of battery-backed memory area.

if CROS_BBRAM_NPCX

config CROS_BBRAM_NPCX_INIT_PRIORITY
	int "cros_bbram npcx initialization priority"
	default 11
	range 10 19
	help
	  This sets the npcx cros_bbram driver initialization priority. NPCX
	  chip uses BBRAM to save some system information that persists across
	  chip resets. The priority should be higher than
	  SYSTEM_PRE_INIT_PRIORITY & lower than CROS_SYSTEM_NPCX_INIT_PRIORITY.

endif # CROS_BBRAM_NPCX

config CROS_BBRAM_IT8XXX2
	bool "ITE IT81202 battery backed RAM driver for Zephyr"
	depends on SOC_FAMILY_RISCV_ITE
	default y
	help
	  This module provides 192 bytes of battery-backed memory area.

if CROS_BBRAM_IT8XXX2

config CROS_BBRAM_IT8XXX2_INIT_PRIORITY
	int "cros_bbram it8xxx2 initialization priority"
	default 11
	help
	  This sets the it8xxx2 cros_bbram driver initialization priority.

endif # CROS_BBRAM_IT8XXX2
```

## zephyr/drivers/cros_kb_raw/Kconfig
```kconfig
# Copyright 2021 The ChromiumOS Authors
# Use of this source code is governed by a BSD-style license that can be
# found in the LICENSE file.

if PLATFORM_EC_KEYBOARD_CROS_EC_RAW_KB

menuconfig CROS_KB_RAW_NPCX
	bool "Nuvoton NPCX raw-keyboard-scan driver for the Zephyr shim"
	default y
	depends on DT_HAS_NUVOTON_NPCX_CROS_KB_RAW_ENABLED
	help
	  This option enables a driver for providing raw access to the
	  keyboard-scan peripheral in the chip. This is used instead of the
	  kscan interface so we can continue to use most of the existing
	  keyboard-scanning code in ECOS.

if CROS_KB_RAW_NPCX

config CROS_KB_RAW_NPCX_KSO_HIGH_DRIVE
	bool "Enable quasi-bidirectional buffers for KSO pins"
	help
	  This option enables quasi-bidirectional buffers for KSO pins. The
	  low-impedance high drive is active when ec changes the output data
	  buffers from 0 to 1, thereby reducing the low-to-high transition time.

endif # CROS_KB_RAW_NPCX

config CROS_KB_RAW_ITE
	bool "ITE raw-keyboard-scan driver for the Zephyr shim"
	default y
	depends on DT_HAS_ITE_IT8XXX2_CROS_KB_RAW_ENABLED
	select PINCTRL
	help
	  This option enables a driver for providing raw access to the
	  keyboard-scan peripheral in the chip. This is used instead of the
	  kscan interface so we can continue to use most of the existing
	  keyboard-scanning code in ECOS.

menuconfig CROS_KB_RAW_XEC
	bool "Microchip raw-keyboard-scan driver for the Zephyr shim"
	default y
	depends on DT_HAS_MICROCHIP_XEC_CROS_KB_RAW_ENABLED
	help
	  This option enables a driver for providing raw access to the
	  keyboard-scan peripheral in the chip. This is used instead of the
	  kscan interface so we can continue to use most of the existing
	  keyboard-scanning code in ECOS.

endif # PLATFORM_EC_KEYBOARD
```

## zephyr/drivers/cros_rtc/Kconfig
```kconfig
# Copyright 2021 The ChromiumOS Authors
# Use of this source code is governed by a BSD-style license that can be
# found in the LICENSE file.

if PLATFORM_EC_RTC && !ARCH_POSIX

choice CROS_RTC_TYPE
	prompt "Select the RTC to use"
	# List standalone controllers before embedded once so that they get
	# higher priority.
	default CROS_RTC_NPCX if DT_HAS_NUVOTON_NPCX_CROS_MTC_ENABLED
	default CROS_RTC_XEC if DT_HAS_MICROCHIP_XEC_CROS_RTC_ENABLED
	help
	  Select the RTC used on the board.

config CROS_RTC_NPCX
	bool "Nuvoton NPCX Real-Time Clock (RTC) driver for the Zephyr shim"
	depends on SOC_FAMILY_NPCX
	help
	  This option enables a driver for providing the support of Real-Time
	  Clock (RTC) on the NPCX chip.

config CROS_RTC_XEC
	bool "Microchip XEC Real-Time Clock (RTC) driver for the Zephyr shim"
	depends on SOC_FAMILY_MICROCHIP_MEC
	help
	  This option enables a driver for providing the support of Real-Time
	  Clock (RTC) on the MCHP XEC chip.

endchoice # CROS_RTC_TYPE

config PLATFORM_EC_PCF85063A_CAP_SEL
	bool "Set CAP_SEL of PCF85063A"
	depends on CROS_RTC_NXP_PCF85063A
	help
	  This option select the internal oscillator capacitor to 12.5 pF,
	  default is 7 pF.

endif # PLATFORM_EC_RTC
```
