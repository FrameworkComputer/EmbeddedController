## zephyr/boards/arm/trogdor/Kconfig.board
```kconfig
# Copyright 2021 The Chromium OS Authors. All rights reserved.
# Use of this source code is governed by a BSD-style license that can be
# found in the LICENSE file.

# "BOARD" below refers to a Zephyr board, which does not have a 1:1
# mapping with the Chrome OS concept of a board.  By Zephyr's
# conventions, we'll still call it "BOARD_*" to make this more
# applicable to be upstreamed, even though this code is shared by all
# projects using Trogdor baseboard.
config BOARD_TROGDOR
	bool "Google Trogdor Baseboard"
	depends on SOC_NPCX7M7FC
	# NPCX doesn't actually have enough ram for coverage, but this will
	# allow generating initial 0 line coverage.
	select HAS_COVERAGE_SUPPORT
```

## zephyr/boards/google/it8xxx2/Kconfig.it8xxx2
```kconfig
# Copyright 2021 The ChromiumOS Authors
# Use of this source code is governed by a BSD-style license that can be
# found in the LICENSE file.

config BOARD_IT8XXX2
	# Allow generating initial 0 line coverage.
	select HAS_COVERAGE_SUPPORT
	select SOC_IT81202BX if BOARD_IT8XXX2_IT81202BX
	select SOC_IT81202CX if BOARD_IT8XXX2_IT81202CX
	select SOC_IT81202DX if BOARD_IT8XXX2_IT81202DX
	select SOC_IT81302BX if BOARD_IT8XXX2_IT81302BX
	select SOC_IT81302CX if BOARD_IT8XXX2_IT81302CX
	select SOC_IT81302DX if BOARD_IT8XXX2_IT81302DX
	select SOC_IT82002AW if BOARD_IT8XXX2_IT82002AW
	select SOC_IT82002BW if BOARD_IT8XXX2_IT82002BW
	select SOC_IT82202AX if BOARD_IT8XXX2_IT82202AX
	select SOC_IT82202AX if BOARD_IT8XXX2_IT82202AX_512
	select SOC_IT82302AX if BOARD_IT8XXX2_IT82302AX
	select SOC_IT82202BW if BOARD_IT8XXX2_IT82202BW
	select SOC_IT82302BW if BOARD_IT8XXX2_IT82302BW
```

## zephyr/boards/google/it8xxx2/it8xxx2_it81302dx_defconfig
```kconfig
# Copyright 2024 The ChromiumOS Authors
# Use of this source code is governed by a BSD-style license that can be
# found in the LICENSE file.

# Power Management
CONFIG_PM=y
CONFIG_PM_DEVICE=y
CONFIG_PM_POLICY_CUSTOM=y

# Console
CONFIG_CONSOLE=y

# GPIO Controller
CONFIG_GPIO=y
CONFIG_GPIO_GET_CONFIG=y

# Clock Controller
CONFIG_CLOCK_CONTROL=n

# Serial Drivers
CONFIG_SERIAL=y

# WATCHDOG configuration
CONFIG_WATCHDOG=y

# BBRAM
CONFIG_BBRAM=y
```

## zephyr/boards/google/npcx7/Kconfig.npcx7
```kconfig
# Copyright 2022 The ChromiumOS Authors
# Use of this source code is governed by a BSD-style license that can be
# found in the LICENSE file.

config BOARD_NPCX7
	bool
	select SOC_NPCX7M7FC
	# NPCX doesn't actually have enough ram for coverage, but this will
	# allow generating initial 0 line coverage.
	select HAS_COVERAGE_SUPPORT
```

## zephyr/boards/google/npcx9/Kconfig.npcx9
```kconfig
# Copyright 2021 The ChromiumOS Authors
# Use of this source code is governed by a BSD-style license that can be
# found in the LICENSE file.

config BOARD_NPCX9
	# NPCX doesn't actually have enough ram for coverage, but this will
	# allow generating initial 0 line coverage.
	select HAS_COVERAGE_SUPPORT
	select SOC_NPCX9M7F if BOARD_NPCX9_NPCX9M7F
	select SOC_NPCX9M3F if BOARD_NPCX9_NPCX9M3F
```

## zephyr/boards/nuvoton/npcx_evb/Kconfig.npcx_evb
```kconfig
# Copyright 2021 The ChromiumOS Authors
# Use of this source code is governed by a BSD-style license that can be
# found in the LICENSE file.

# Note: this Zephyr board more closely represents the Chrome OS
# concept of a baseboard.  Zephyr boards and Chrome OS boards do not
# have a 1:1 mapping.

config BOARD_NPCX_EVB_NPCX7M6FC
	bool
	select SOC_NPCX7M6FC
	# Allow generating initial 0 line coverage.
	select HAS_COVERAGE_SUPPORT

config BOARD_NPCX_EVB_NPCX9M6F
	bool
	select SOC_NPCX9M6F
	# Allow generating initial 0 line coverage.
	select HAS_COVERAGE_SUPPORT
```

## zephyr/boards/nuvoton/npcx_evb/npcx_evb_npcx7m6fc_defconfig
```kconfig
# Copyright 2021 The ChromiumOS Authors
# Use of this source code is governed by a BSD-style license that can be
# found in the LICENSE file.

# Serial Drivers
CONFIG_SERIAL=y
CONFIG_UART_INTERRUPT_DRIVEN=y

# Enable console
CONFIG_CONSOLE=y
CONFIG_UART_CONSOLE=y

# Pinctrl Driver
CONFIG_PINCTRL=y

# GPIO Controller
CONFIG_GPIO=y
CONFIG_GPIO_GET_CONFIG=y

# Clock configuration
CONFIG_CLOCK_CONTROL=y

# WATCHDOG configuration
CONFIG_WATCHDOG=y

# I2C
CONFIG_I2C=y

# Power Management
CONFIG_PM=y
CONFIG_PM_DEVICE=y
CONFIG_PM_POLICY_CUSTOM=y
CONFIG_UART_CONSOLE_INPUT_EXPIRED=y

# BBRAM
CONFIG_BBRAM=y

# Flash
CONFIG_FLASH=y
CONFIG_FLASH_JESD216_API=y
CONFIG_FLASH_EX_OP_ENABLED=y
```

## zephyr/boards/riscv/asurada/Kconfig.defconfig
```kconfig
# Copyright 2021 The Chromium OS Authors. All rights reserved.
# Use of this source code is governed by a BSD-style license that can be
# found in the LICENSE file.

if BOARD_ASURADA

config BOARD
	default "asurada"

config TASK_PD_STACK_SIZE
	default 1280

config TASK_CHARGER_STACK_SIZE
	default 1280

config TASK_KEYSCAN_STACK_SIZE
	default 1280

config TASK_MOTIONSENSE_STACK_SIZE
	default 1536

config TASK_HOSTCMD_STACK_SIZE
	default 1280

config SYSTEM_WORKQUEUE_STACK_SIZE
	default 1536

choice PLATFORM_EC_HOSTCMD_DEBUG_MODE
	default HCDEBUG_OFF
endchoice # PLATFORM_EC_HOSTCMD_DEBUG_MODE

endif # BOARD_ASURADA
```

## zephyr/boards/riscv/it8xxx2/Kconfig.board
```kconfig
# Copyright 2021 The Chromium OS Authors. All rights reserved.
# Use of this source code is governed by a BSD-style license that can be
# found in the LICENSE file.

# "BOARD" below refers to a Zephyr board, which does not have a 1:1
# mapping with the Chrome OS concept of a board.  By Zephyr's
# conventions, we'll still call it "BOARD_*" to make this more
# applicable to be upstreamed, even though this code is shared by all
# projects using Trogdor baseboard.
config BOARD_IT8XXX2
	bool "IT8XXX2 Zephyr Board"
	depends on SOC_IT8XXX2
	# Allow generating initial 0 line coverage.
	select HAS_COVERAGE_SUPPORT
```

## zephyr/boards/riscv/it8xxx2/Kconfig.defconfig
```kconfig
# Copyright 2021 The Chromium OS Authors. All rights reserved.
# Use of this source code is governed by a BSD-style license that can be
# found in the LICENSE file.

if BOARD_IT8XXX2

config BOARD
	default "it8xxx2"

choice PLATFORM_EC_HOSTCMD_DEBUG_MODE
	default HCDEBUG_OFF
endchoice # PLATFORM_EC_HOSTCMD_DEBUG_MODE

endif # BOARD_IT8XXX2
```

## zephyr/boards/riscv/it8xxx2/it81302bx_defconfig
```kconfig
# Copyright 2022 The ChromiumOS Authors.
# Use of this source code is governed by a BSD-style license that can be
# found in the LICENSE file.

# Zephyr Kernel Configuration
CONFIG_SOC_SERIES_RISCV32_IT8XXX2=y
CONFIG_SOC_IT8XXX2=y
CONFIG_SOC_IT81302_BX=y

# Platform Configuration
CONFIG_BOARD_IT8XXX2=y

# Power Management
CONFIG_PM=y
CONFIG_PM_DEVICE=y
CONFIG_PM_POLICY_CUSTOM=y

# Console
CONFIG_CONSOLE=y

# GPIO Controller
CONFIG_GPIO=y

# Clock Controller
CONFIG_CLOCK_CONTROL=n

# Serial Drivers
CONFIG_SERIAL=y

# WATCHDOG configuration
CONFIG_WATCHDOG=y

# BBRAM
CONFIG_BBRAM=y

# TODO(b:227415000) re-enable once
# https://github.com/zephyrproject-rtos/zephyr/pull/47934 is merged.
CONFIG_I2C_IT8XXX2_CQ_MODE=n
```

## zephyr/boards/riscv/it8xxx2/it82002aw_defconfig
```kconfig
# Copyright 2023 The ChromiumOS Authors
# Use of this source code is governed by a BSD-style license that can be
# found in the LICENSE file.

# Zephyr Kernel Configuration
CONFIG_SOC_SERIES_ITE_IT8XXX2=y
CONFIG_SOC_IT8XXX2=y
CONFIG_SOC_IT82002_AW=y

# Platform Configuration
CONFIG_BOARD_IT8XXX2=y

# Power Management
CONFIG_PM=y
CONFIG_PM_DEVICE=y
CONFIG_PM_POLICY_CUSTOM=y

# Console
CONFIG_CONSOLE=y

# GPIO Controller
CONFIG_GPIO=y
CONFIG_GPIO_GET_CONFIG=y

# Clock Controller
CONFIG_CLOCK_CONTROL=n

# Serial Drivers
CONFIG_SERIAL=y

# WATCHDOG configuration
CONFIG_WATCHDOG=y

# BBRAM
CONFIG_BBRAM=y
```

## zephyr/boards/riscv/it8xxx2/it8xxx2_defconfig
```kconfig
# Copyright 2021 The Chromium OS Authors. All rights reserved.
# Use of this source code is governed by a BSD-style license that can be
# found in the LICENSE file.

# Zephyr Kernel Configuration
CONFIG_SOC_SERIES_RISCV32_IT8XXX2=y
CONFIG_SOC_IT8XXX2=y

# Platform Configuration
CONFIG_BOARD_IT8XXX2=y

# Power Management
CONFIG_PM=y
CONFIG_PM_DEVICE=y
CONFIG_PM_POLICY_CUSTOM=y

# Console
CONFIG_CONSOLE=y

# GPIO Controller
CONFIG_GPIO=y
# For IT81202, the GPIO group k/l are not brought out to pins,
# so by default they can be set to pull down inputs.
# However with the IT81302, they are available on pins,
# and should not be set to pull down inputs by default.
CONFIG_SOC_IT8XXX2_GPIO_GROUP_K_L_DEFAULT_PULL_DOWN=n

# Clock Controller
CONFIG_CLOCK_CONTROL=n

# Serial Drivers
CONFIG_SERIAL=y

# WATCHDOG configuration
CONFIG_WATCHDOG=y

# BBRAM
CONFIG_BBRAM=y
```

## zephyr/boards/riscv/it8xxx2_evb/Kconfig.board
```kconfig
# Copyright 2021 The Chromium OS Authors. All rights reserved.
# Use of this source code is governed by a BSD-style license that can be
# found in the LICENSE file.

config BOARD_IT8XXX2_EVB
	bool "IT8XXX2 EV-board"
	depends on SOC_IT8XXX2
	# Allow generating initial 0 line coverage.
	select HAS_COVERAGE_SUPPORT
```

## zephyr/boards/riscv/it8xxx2_evb/Kconfig.defconfig
```kconfig
# Copyright 2021 The Chromium OS Authors. All rights reserved.
# Use of this source code is governed by a BSD-style license that can be
# found in the LICENSE file.

if BOARD_IT8XXX2_EVB

config BOARD
	default "it8xxx2_evb"

endif # BOARD_IT8XXX2_EVB
```

## zephyr/boards/riscv/it8xxx2_evb/it8xxx2_evb_defconfig
```kconfig
# Copyright 2021 The Chromium OS Authors. All rights reserved.
# Use of this source code is governed by a BSD-style license that can be
# found in the LICENSE file.

# Zephyr Kernel Configuration
CONFIG_SOC_SERIES_RISCV32_IT8XXX2=y

# Platform Configuration
CONFIG_SOC_IT8XXX2=y
CONFIG_BOARD_IT8XXX2_EVB=y

# Serial Drivers
CONFIG_SERIAL=y
CONFIG_UART_INTERRUPT_DRIVEN=y

# Enable console
CONFIG_CONSOLE=y
CONFIG_UART_CONSOLE=y
CONFIG_UART_NS16550=y
CONFIG_SHELL_TAB=y
CONFIG_SHELL_TAB_AUTOCOMPLETION=y
CONFIG_SHELL_HISTORY=y

# Pinmux Driver
CONFIG_PINMUX=y
CONFIG_PINMUX_ITE_IT8XXX2=y

# PWM
CONFIG_PWM=y
CONFIG_PWM_SHELL=n
CONFIG_PLATFORM_EC_PWM=y
CONFIG_PWM_ITE_IT8XXX2=y

# GPIO Controller
CONFIG_GPIO=y
CONFIG_GPIO_ITE_IT8XXX2=y

# Clock configuration
CONFIG_CLOCK_CONTROL=y

# WATCHDOG configuration
CONFIG_WATCHDOG=y
CONFIG_WDT_ITE_WARNING_LEADING_TIME_MS=500

# I2C Controller
CONFIG_I2C_ITE_IT8XXX2=y

CONFIG_ITE_IT8XXX2_TIMER=y

# ADC
CONFIG_ADC=y
CONFIG_ADC_ITE_IT8XXX2=y
CONFIG_PLATFORM_EC_ADC_RESOLUTION=10

CONFIG_SYS_CLOCK_HW_CYCLES_PER_SEC=32768
CONFIG_SYS_CLOCK_TICKS_PER_SEC=32768

# Flash
CONFIG_SOC_FLASH_ITE_IT8XXX2=y

# Code RAM base for IT8XXX2
CONFIG_CROS_EC_PROGRAM_MEMORY_BASE=0x80000000
CONFIG_CROS_EC_RAM_BASE=0x80100000
CONFIG_CROS_EC_DATA_RAM_SIZE=0x00100000
CONFIG_CROS_EC_RAM_SIZE=0x0000f000


CONFIG_CROS_EC_RO_MEM_OFF=0x0
CONFIG_CROS_EC_RO_SIZE=0x80000
CONFIG_CROS_EC_RW_MEM_OFF=0x0
CONFIG_CROS_EC_RW_SIZE=0x80000

# BBRAM
CONFIG_BBRAM=y
CONFIG_BBRAM_IT8XXX2=y
```

## zephyr/cmake/toolchain/coreboot-sdk/Kconfig
```kconfig
# Copyright 2025 The ChromiumOS Authors
# Use of this source code is governed by a BSD-style license that can be
# found in the LICENSE file.

config TOOLCHAIN_COREBOOT_SDK
	def_bool y
	select HAS_NEWLIB_LIBC_NANO

config TOOLCHAIN_COREBOOT_SDK_SUPPORTS_THREAD_LOCAL_STORAGE
   def_bool y
   select TOOLCHAIN_SUPPORTS_THREAD_LOCAL_STORAGE

config TOOLCHAIN_COREBOOT_SDK_SUPPORTS_GNU_EXTENSIONS
	def_bool y
	select TOOLCHAIN_SUPPORTS_GNU_EXTENSIONS

config TOOLCHAIN_COREBOOT_SDK_PICOLIBC_SUPPORTED
   def_bool y
   select PICOLIBC_SUPPORTED
```

## zephyr/cmake/toolchain/llvm/Kconfig
```kconfig
# Copyright 2024 The ChromiumOS Authors
# Use of this source code is governed by a BSD-style license that can be
# found in the LICENSE file.

# Change default linker to LLD. This must be placed before 'source' line.
# Note that we can't enable it in config file for program, because it breaks
# compilation with other toolchains.
choice LLVM_LINKER
	default LLVM_USE_LLD
endchoice

# The armv7m-cros-eabi compiler-rt was compiled with assumption that it will
# run on Cortex-M4 MCU with enabled FPU. It means that even with '-mfpu=none'
# option the floating point instructions will be used (because they are used in
# compiler-rt). Let's enable FPU always when compiling for ARMv7-M with FPU.
config FPU
	default y if ARMV7_M_ARMV8_M_FP

# LLVM toolchains for ARM use newlib as libc, indicate that it's supported.
# Original config (definied in 'lib/libc/Kconfig') depends on
# TOOLCHAIN_HAS_NEWLIB == y, which means that TOOLCHAIN_HAS_NEWLIB must be set
# before Kconfig files are processed. The only place that satisfies this
# requirement is ${ZEPHYR_BASE}/cmake/toolchain/llvm/generic.cmake, but due to
# HWMv2 we don't know the architecture at that point. The architecture is
# determined while processing Kconfig files, so let's indicate that Newlib is
# supported here.
config NEWLIB_LIBC_SUPPORTED
        bool
        default y if ARM
        select FULL_LIBC_SUPPORTED

# Include LLVM Kconfig from Zephyr
source "${ZEPHYR_BASE}/cmake/toolchain/llvm/Kconfig"
```

## zephyr/drivers/Kconfig
```kconfig
# Copyright 2020 The ChromiumOS Authors
# Use of this source code is governed by a BSD-style license that can be
# found in the LICENSE file.

rsource "cros_flash/Kconfig"
rsource "cros_kb_raw/Kconfig"
rsource "cros_rtc/Kconfig"
rsource "cros_shi/Kconfig"
rsource "cros_system/Kconfig"
rsource "fingerprint/Kconfig"
rsource "keyboard_input/Kconfig"
rsource "one_wire_uart/Kconfig"
rsource "usbc/Kconfig"
```

## zephyr/drivers/aic/Kconfig
```kconfig
# Copyright 2025 The ChromiumOS Authors
# Use of this source code is governed by a BSD-style license that can be
# found in the LICENSE file.

config CROS_EC_IO_SWEEP
	bool "io_sweep command"
	depends on DT_HAS_CROS_AIC_PINS_ENABLED
	default y
	help
	  EC AIC io_sweep shell command.
```

## zephyr/drivers/boot_keys/Kconfig
```kconfig
# Copyright 2024 The ChromiumOS Authors
# Use of this source code is governed by a BSD-style license that can be
# found in the LICENSE file.

config CROS_EC_BOOT_KEYS
	bool "Boot keys support"
	depends on DT_HAS_CROS_EC_BOOT_KEYS_ENABLED
	depends on INPUT
	default y
	help
	  Enable support for detecting boot keys combination to enter recovery
	  mode, force memory retraining and booting without starting the AP.

config BOOT_KEYS_GHOST_REFRESH_WORKAROUND
	bool "Ignore stray refresh keys keys workaround"
	depends on CROS_EC_BOOT_KEYS
	default y if PLATFORM_EC_POWER_BUTTON
	help
	  Ignore stray keys on the refresh key row when looking for boot key
	  combination.
	  Some TI50 versions have a bug where they keep the refresh key row
	  asserted the whole time that the power button is pressed, this causes
	  a stray press to show up on all other column on the row corresponding
	  to the rfresh key. This option ignores such presses, so that they
	  don't trigger the stray key check code which would otherwise prevent
	  from entering boot mode due (b/300418915).
```
