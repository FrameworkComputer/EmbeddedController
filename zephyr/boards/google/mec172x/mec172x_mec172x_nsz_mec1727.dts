/* Copyright 2023 Microchip Technology Inc. All rights reserved.
 * Use of this source code is governed by a BSD-style license that can be
 * found in the LICENSE file.
 */

/dts-v1/;

#include "mec172x.dtsi"

/* MEC1727 Internal SPI flash information */
&spi0 {
	status = "okay";
	compatible = "microchip,xec-qmspi-ldma";
	clock-frequency = <12000000>;
	lines = <2>;
	chip-select = <0>;
	pinctrl-0 = < &gpspi_cs_n_gpio116
		      &gpspi_clk_gpio117
		      &gpspi_io0_gpio074
		      &gpspi_io1_gpio075
		      &gpspi_wp_n_gpio076 >;
	pinctrl-names = "default";

	int_flash: sst25pf040@0 {
		compatible ="jedec,spi-nor";
		/*  4194304 bits = 512K Bytes */
		size = <0x400000>;
		label = "SST25PF040";
		reg = <0>;
		spi-max-frequency = <40000000>;
		status = "okay";
		jedec-id = [62 06 13];
	};
};
