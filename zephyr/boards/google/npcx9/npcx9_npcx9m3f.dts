/* Copyright 2022 The ChromiumOS Authors
 * Use of this source code is governed by a BSD-style license that can be
 * found in the LICENSE file.
 */

/dts-v1/;

#include <cros/nuvoton/npcx9.dtsi>
#include <nuvoton/npcx9m3f.dtsi>
#include "npcx9.dtsi"
