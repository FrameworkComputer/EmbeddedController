## zephyr/dts/bindings/battery/atl,l26n2pk1.yaml
```yaml
# Copyright 2026 The ChromiumOS Authors
# Use of this source code is governed by a BSD-style license that can be
# found in the LICENSE file.

description: "ATL L26N2pk1"
compatible: "atl,l26n2pk1"

include: battery-smart.yaml

properties:
  enum-name:
    type: string
    default: "atl,l26n2pk1"

  # Fuel gauge
  manuf_name:
    default: "ATL"
  device_name:
    default: "L26N2PK1"
  ship_mode_reg_addr:
    default: 0x34
  ship_mode_reg_data:
    default: [0x0000, 0x1000]
  flags:
    default: 0
  fet_reg_addr:
    default: 0x00
  fet_reg_mask:
    default: 0x0010
  fet_disconnect_val:
    default: 0x0000
  fet_cfet_mask:
    default: 0x0008
  fet_cfet_off_val:
    default: 0x0000

  # Battery info
  voltage_max:
    default: 8800
  voltage_normal:
    default: 7540
  voltage_min:
    default: 6000
  precharge_current:
    default: 221
  start_charging_min_c:
    default: 0
  start_charging_max_c:
    default: 50
  charging_min_c:
    default: 0
  charging_max_c:
    default: 60
  discharging_min_c:
    default: -20
  discharging_max_c:
    default: 60
```

## zephyr/dts/bindings/battery/battery-smart.yaml
```yaml
# Copyright 2021 The ChromiumOS Authors
# Use of this source code is governed by a BSD-style license that can be
# found in the LICENSE file.

compatible: "battery-smart"

include: ["base.yaml", "battery-info.yaml", "battery-fuel-gauge.yaml"]

properties:
  enum-name:
    description: Unique value used for creating enum of batteries types
    type: string
    enum:
      - "aec,5477109"
      - "atl,313-b7-32-a"
      - "atl,ap24cal"
      - "atl,ap25aap"
      - "atl,cfd72"
      - "atl,gb-s20-4473a9"
      - "atl,gb-s30-586075-020h"
      - "atl,gb-s30-636076-010h"
      - "atl,l25n3pg1"
      - "bms-gf,cr50"
      - "byd,byd"
      - "byd,byd-1"
      - "byd,yt39x"
      - "byd,l21b2pg2"
      - "byd,l22b3pg0"
      - "byd,l23b2pg5"
      - "byd,l25b3pg1"
      - "byd,x0y5m"
      - "byd,wv3k8"
      - "cdt,c340152"
      - "celxpert,p360644"
      - "celxpert,b300049"
      - "celxpert,b340442"
      - "celxpert,c235-41"
      - "celxpert,c340152"
      - "celxpert,l22c3pg0"
      - "cosmx,313-ac-32-a"
      - "cosmx,313-ac-38-a"
      - "cosmx,333-ac-3f-a"
      - "cosmx,ap20cbl"
      - "cosmx,ap20cbl-2"
      - "cosmx,ap20cbl-3"
      - "cosmx,ap20cbl-4"
      - "cosmx,ap23abl"
      - "cosmx,ap23cbp"
      - "cosmx,ap25cbk"
      - "cosmx,c22n2505"
      - "cosmx,com-cos4-122"
      - "cosmx,cm32054"
      - "cosmx,gg02047xl"
      - "cosmx,gh02047xl"
      - "cosmx,pg01lj3353"
      - "cosmx,si03058xl"
      - "cosmx,l22x3pg0"
      - "cosmx,l24x3pg1"
      - "cosmx,l24x3pg2"
      - "cosmx,l25x3pg1"
      - "cosmx,li7"
      - "cosmx,mvk11"
      - "dynapack,atl_gh02047xl"
      - "dynapack,byd_gg02047xl"
      - "dynapack,b140435"
      - "dynapack,b340435"
      - "dynapack,cosmx_gh02047xl"
      - "dynapack,c140254"
      - "dynapack,coslight_po02037xl"
      - "dynapack,highpower_po02037xl"
      - "dynapack,hpp_gg02047xl"
      - "dynapack,313-27-38-a"
      - "dynapack,313-27-3f-a"
      - "dynapack,313-2d-32-a"
      - "dynapack,333-2d-38-a"
      - "dynapack,333-2c-32-a"
      - "ganfeng,7c01"
      - "ganfeng,sg20"
      - "pow-tech,sg20"
      - "pow-tech,sg20qt1c"
      - "getac,bq40z50-R3-S3"
      - "getac,bq40z50-R3-S2"
      - "getac,ca31a53"
      - "getac,pg01jh3353"
      - "getac,pg01lj3353"
      - "gfl,hq71101003dj0"
      - "gfl,mfp-549358"
      - "gfl,mfp-466894"
      - "gfl,nb0299-485489"
      - "gfl,nb0346-427689"
      - "lgc,ac17a8m"
      - "lgc,ap16l8j"
      - "lgc,ap18c8k"
      - "lgc,ap19a8k"
      - "lgc,ap19b8k"
      - "lgc,ap19b8m"
      - "lgc,ap19b8m-2"
      - "lgc,l20l3pg2"
      - "lgc,8ghcx"
      - "lgc,xphx8"
      - "lges,ap22a8n"
      - "lges,ap23a8l"
      - "murata,ap18c4k"
      - "nvt,313-b7-32-a"
      - "nvt,atl-atl4-106"
      - "panasonic,ap16l5j"
      - "panasonic,ap16l5j-009"
      - "panasonic,ap19a5k"
      - "panasonic,ap19b5k"
      - "panasonic,ap23a5l"
      - "panasonic,ap23a5l-2"
      - "powertech,batgqa05l22"
      - "sdi,4404d57"
      - "sdi,4404d57m"
      - "smp,313-12-32-a"
      - "smp,333-17-32-a"
      - "smp,333-1d-0d-a"
      - "smp,333-1d-2d-a"
      - "smp,313-1d-38-a"
      - "smp,ap18c7k"
      - "smp,ap23a7l"
      - "smp,ap23a7l-2"
      - "smp,ap23b7q"
      - "smp,ap25a7p"
      - "smp,ap25c7k"
      - "smp,atlrf9h3"
      - "smp,atl26jgk"
      - "smp,atlxdy9k"
      - "smp,c223-50"
      - "smp,c31n1915"
      - "smp,c31n2005"
      - "smp,c31n2313"
      - "smp,cosrf9h3"
      - "smp,cos26jgk"
      - "SIMPLO,CP856931"
      - "SIMPLO,CP856932"
      - "smp,l20m3pg0"
      - "smp,l20m3pg1"
      - "smp,l20m3pg2"
      - "smp,l21m4pg0"
      - "smp,l21m4pg5"
      - "smp,l22m3pg0"
      - "smp,l22m3pg1"
      - "smp,l23m4pg4"
      - "smp,l24m3pg2"
      - "smp,l25m3pg1"
      - "smp,byd_pc-vp-bp162"
      - "smp,cosmx_pc-vp-bp162"
      - "smp,pc-vp-bp153"
      - "smp,pc-vp-bp162"
      - "smp,coslight_gh02047xl"
      - "smp,cosxdy9k"
      - "smp,highpower_gh02047xl"
      - "smp,highpower_si03058xl"
      - "smp,hptrf9h3"
      - "smp,si03054xl"
      - "smp,smp-atl-4-106"
      - "smp,smp-atl-4-106-1"
      - "smp,smp-cos-4-122"
      - "smp,smp-hpt-4-122"
      - "smp,pg01nl3353"
      - "scud,g71c000pk110"
      - "sunwoda,333-cf-32-a"
      - "sunwoda,333-cf-38-a"
      - "sunwoda,333-cf-3f-a"
      - "sunwoda,atlvkyjx"
      - "sunwoda,cosvkyjx"
      - "sunwoda,cosctgkt"
      - "sunwoda,l21d2pg2"
      - "sunwoda,l21d4pg4"
      - "sunwoda,l22d3pg0"
      - "sunwoda,l22d3pg1"
      - "sunwoda,l23d2pg5"
      - "sunwoda,l23d4pg4"
      - "sunwoda,l24d3pg1"
      - "sunwoda,l24d3pg2"
      - "sunwoda,l25d3pg1"
      - "sunwoda,ctgkt"
      - "swd,swd-atl4-106"
      - "swd,swd-cos4-122"
      - "utl,hq24u3s1p3i"
      - "utl,hq24u2s1p3l"
```

## zephyr/dts/bindings/battery/byd,l25b4pk5.yaml
```yaml
# Copyright 2025 The ChromiumOS Authors
# Use of this source code is governed by a BSD-style license that can be
# found in the LICENSE file.

description: "BYD L25B4PK5"
compatible: "byd,l25b4pk5"

include: battery-smart.yaml

properties:
  enum-name:
    type: string
    default: "byd,l25b4pk5"

  # Fuel gauge
  manuf_name:
    default: "byd"
  device_name:
    default: "L25b4pk5"
  ship_mode_reg_addr:
    default: 0x34
  ship_mode_reg_data:
    default: [0x0000, 0x1000]
  flags:
    default: 0
  fet_reg_addr:
    default: 0x34
  fet_reg_mask:
    default: 0x0100
  fet_disconnect_val:
    default: 0x0100

  # Battery info
  voltage_max:
    default: 17800
  voltage_normal:
    default: 15480
  voltage_min:
    default: 12000
  precharge_current:
    default: 453
  start_charging_min_c:
    default: 0
  start_charging_max_c:
    default: 50
  charging_min_c:
    default: 0
  charging_max_c:
    default: 60
  discharging_min_c:
    default: -20
  discharging_max_c:
    default: 70
```

## zephyr/dts/bindings/battery/byd,l26b2pk1.yaml
```yaml
# Copyright 2026 The ChromiumOS Authors
# Use of this source code is governed by a BSD-style license that can be
# found in the LICENSE file.

description: "BYD L26B2PK1"
compatible: "byd,l26b2pk1"

include: battery-smart.yaml

properties:
  enum-name:
    type: string
    default: "byd,l26b2pk1"

  # Fuel gauge
  manuf_name:
    default: "BYD"
  device_name:
    default: "L26B2PK1"
  ship_mode_reg_addr:
    default: 0x34
  ship_mode_reg_data:
    default: [0x0000, 0x1000]
  flags:
    default: 0
  fet_reg_addr:
    default: 0x46
  fet_reg_mask:
    default: 0x0001
  fet_disconnect_val:
    default: 0x0000
  fet_cfet_mask:
    default: 0x0002
  fet_cfet_off_val:
    default: 0x0000

  # Battery info
  voltage_max:
    default: 8800
  voltage_normal:
    default: 7540
  voltage_min:
    default: 6000
  precharge_current:
    default: 442
  start_charging_min_c:
    default: 0
  start_charging_max_c:
    default: 50
  charging_min_c:
    default: 0
  charging_max_c:
    default: 60
  discharging_min_c:
    default: -20
  discharging_max_c:
    default: 70
```

## zephyr/dts/bindings/battery/cosmx,c22n2505.yaml
```yaml
# Copyright 2025 The ChromiumOS Authors
# Use of this source code is governed by a BSD-style license that can be
# found in the LICENSE file.

description: "COSMX C22N2505"
compatible: "cosmx,c22n2505"

include: battery-smart.yaml

properties:
  enum-name:
    type: string
    default: "cosmx,c22n2505"

  # Fuel gauge
  manuf_name:
    default: "AS3GXXL3KD"
  device_name:
    default: "B940689"
  ship_mode_reg_addr:
    default: 0x00
  ship_mode_reg_data:
    default: [0x0010, 0x0010]
  # Charging/Discharging FETs Status
  # Register SBS_PackStatus_ACCESS (0x99)
  # Bit-3: XDSG
  # Bit-2: XCHG
  fet_reg_addr:
    default: 0x99
  fet_reg_mask:
    default: 0x0008
  fet_disconnect_val:
    default: 0x0008
  fet_cfet_mask:
    default: 0x0004
  fet_cfet_off_val:
    default: 0x0004

  # Battery info
  voltage_max:
    default: 9000
  voltage_normal:
    default: 7800
  voltage_min:
    default: 6000
  precharge_current:
    default: 256
  start_charging_min_c:
    default: 0
  start_charging_max_c:
    default: 45
  charging_min_c:
    default: 0
  charging_max_c:
    default: 60
  discharging_min_c:
    default: -20
  discharging_max_c:
    default: 60
```

## zephyr/dts/bindings/battery/cosmx,cm32054.yaml
```yaml
# Copyright 2025 The ChromiumOS Authors
# Use of this source code is governed by a BSD-style license that can be
# found in the LICENSE file.

description: "COSMX  AS3GXXH3KA CM32054"
compatible: "cosmx,cm32054"

include: battery-smart.yaml

properties:
  enum-name:
    type: string
    default: "cosmx,cm32054"

  # Fuel gauge
  manuf_name:
    default: "AS3GXXH3KA"
  device_name:
    default: "CM32054"
  ship_mode_reg_addr:
    default: 0x00
  ship_mode_reg_data:
    default: [0x0010, 0x0010]
  fet_reg_addr:
    default: 0x99
  fet_reg_mask:
    default: 0x8
  fet_disconnect_val:
    default: 0x8
  fet_cfet_mask:
    default: 0x4
  fet_cfet_off_val:
    default: 0x4


  # Battery info
  voltage_max:
    default: 8900
  voltage_normal:
    default: 7760
  voltage_min:
    default: 6000
  precharge_current:
    default: 256
  start_charging_min_c:
    default: 0
  start_charging_max_c:
    default: 45
  charging_min_c:
    default: 0
  charging_max_c:
    default: 60
  discharging_min_c:
    default: -20
  discharging_max_c:
    default: 60
```
