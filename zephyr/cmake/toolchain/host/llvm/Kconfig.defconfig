## zephyr/drivers/board_id/Kconfig
```kconfig
# Copyright 2025 The ChromiumOS Authors
# Use of this source code is governed by a BSD-style license that can be
# found in the LICENSE file.

config COMMON_BOARD_ID
	bool "Specific RVP Support"
	help
	  Enable support only for specific RVPs that require common
	  board id driver support.

config BOARD_ID_INTEL_RVP
	bool "Intel RVP board ID read"
	depends on DT_HAS_INTEL_RVP_BOARD_ID_ENABLED \
			&& COMMON_BOARD_ID && PLATFORM_EC_CBI
	default y
	help
	  Enable support for reading board id for INTEL RVP.
```

## zephyr/drivers/cros_flash/Kconfig
```kconfig
# Copyright 2020 The ChromiumOS Authors
# Use of this source code is governed by a BSD-style license that can be
# found in the LICENSE file.

menuconfig CROS_FLASH_NPCX
	bool "Nuvoton NPCX flash driver for the Zephyr shim"
	default y if PLATFORM_EC
	depends on DT_HAS_NUVOTON_NPCX_CROS_FLASH_ENABLED
	select PLATFORM_EC_FLASH_CROS
	select PLATFORM_EC_SPI_FLASH_REGS
	help
	  This option enables a flash unit interface (FIU) driver for the NPCX
	  chip. This is used instead of the flash memory interface so we can
	  continue to use most of the existing flash memory processing code in
	  ECOS.

config CROS_FLASH_NPCX_ERASE_SIZE
	hex "The NPCX flash erase size."
	default 0x1000
	depends on CROS_FLASH_NPCX
	help
	  This option sets the NPCX flash erase size. The default value is 0x1000
	  (4K bytes).

config CROS_FLASH_IT8XXX2
	bool "ITE IT81202 flash driver for the Zephyr shim"
	depends on SOC_FAMILY_ITE_EC
	default y if PLATFORM_EC
	select PLATFORM_EC_FLASH_CROS
	help
	  This option enables the flash driver for the it8xxx2 chip. We can
	  access the flash by read, write and erase. The it8xxx2 flash size
	  is 1M byte.

config CROS_FLASH_XEC
	bool "Microchip XEC flash driver for the Zephyr shim"
	default y if PLATFORM_EC
	depends on DT_HAS_MICROCHIP_XEC_CROS_FLASH_ENABLED
	select PLATFORM_EC_FLASH_CROS
	select PLATFORM_EC_SPI_FLASH_REGS
	help
	  This option enables the flash driver for the MEC172x chips. Flash
	  access is via the QSPI driver to one of three ports: internal 512KB
	  SPI flash in the MEC1727 or external shared or private ports on
	  MEC1723, etc.

config CROS_FLASH_MCHP_INTERNAL_WP
	bool "Microchip Internal WP pin is present"
	default n
	depends on CROS_FLASH_XEC
	help
	  This option enables keeping the internal and external Microchip WP
	  gpios in the same state to allow for HW Write Protect on MEC172x chips.

config CROS_FLASH_RTK
	bool "REALTEK RTS5915 flash driver for the Zephyr shim"
	depends on DT_HAS_REALTEK_RTK_CROS_FLASH_ENABLED
	default y if PLATFORM_EC
	select PLATFORM_EC_FLASH_CROS
	select PLATFORM_EC_SPI_FLASH_REGS
	help
	  This option enables the flash driver for the rts5915 chip. We can
	  access the flash by read, write and erase. The rts5915 flash size
	  is 1M byte.

config CROS_FLASH
	bool "Generic cros-flash driver for the Zephyr shim"
	depends on DT_HAS_CROS_EC_CROS_FLASH_ENABLED
	default y
	select PLATFORM_EC_FLASH_CROS
	help
	  This option enables the cros-flash driver used by EC code.
	  This driver actually acts as a translation layer between Zephyr flash
	  driver and EC flash protection flags (ro_now, ro_at_boot, etc.). The
	  driver uses a backend to perform flash specific operations, e.g.
	  change protection settings.

config CROS_FLASH_INIT_PRIORITY
	int "Init priority for CrOS flash shim"
	default 55
	help
	  Initialization priority for the CrOS flash shim drivers.
	  Must initialize after CONFIG_FLASH_INIT_PRIORITY.

if CROS_FLASH

config CROS_FLASH_HAS_READOUT_PROTECTION
	bool
	help
	  This option is enabled if readout protection is supported.

choice CROS_FLASH_BACKEND
	prompt "Backend for cros-flash driver"
	default CROS_FLASH_BACKEND_STM32 if SOC_FAMILY_STM32
	help
	  Backend for cros-flash driver provides functions responsible for
	  changing write protection and readout protection state, blocking
	  flash protection changes or basic flash operations.

	  Backend performs these operations using extended operations exposed by
	  flash API or can interact with the hardware directly.

config CROS_FLASH_BACKEND_STM32
	bool "STM32 backend for cros-flash driver"
	depends on SOC_FLASH_STM32
	select CROS_FLASH_HAS_READOUT_PROTECTION if FLASH_STM32_READOUT_PROTECTION
	select FLASH_EX_OP_ENABLED
	select FLASH_STM32_WRITE_PROTECT

config CROS_FLASH_BACKEND_FAKE
	bool "Fake backend for cros-flash driver"
	select CROS_FLASH_HAS_READOUT_PROTECTION
	help
	  Fake backend is just set functions provided by test. It's used to test
	  the driver only.
endchoice

config CROS_FLASH_READOUT_PROTECTION
	bool "Enable flash readout protection"
	depends on CROS_FLASH_HAS_READOUT_PROTECTION
	default n
	help
	  This option enables support for readout protection in cros-flash driver.

config CROS_FLASH_CUSTOM_JUMP_STRUCTURE
	bool "Use custom functions to encode/decode flash jump data"
	help
	  If enabled, the driver will call decode_wp_from_sysjump() and
	  prepare_wp_jump() to decode/encode flash jump data.

# Backend-specific configs

config CROS_FLASH_STM32_EC_JUMP_STRUCTURE
	bool "Enable backward compatibility with EC flash jump structure"
	depends on CROS_FLASH_BACKEND_STM32 && SOC_SERIES_STM32F4X
	default n
	select CROS_FLASH_CUSTOM_JUMP_STRUCTURE
	help
	  This option enables backward compatibility with EC flash protection
	  data. During sysjump, flash protection information is saved in jump
	  tags. The part we've jumped to will read the data, so it will report
	  protection correctly. This includes the code for coverting the data
	  between old and new formats.

endif # CROS_FLASH

config CROS_FLASH_EM32F967
	bool "Elan EM32F967 flash driver for the Zephyr shim"
	depends on DT_HAS_ELAN_EM32F967_CROS_FLASH_ENABLED
	default y
	select PLATFORM_EC_FLASH_CROS
	help
	  This option enables the flash driver for Elan EM32F967 chip. We can
	  access the flash by read, write and erase. The flash size of EM32F967
	  is 640k byte (536k byte for firmware).

config CROS_FLASH_ANDES_XIP
	bool "Cros-flash driver using Andes flash xip driver"
	depends on DT_HAS_ANDESTECH_QSPI_NOR_XIP_CROS_FLASH_ENABLED
	select PLATFORM_EC_FLASH_CROS
	select PLATFORM_EC_SPI_FLASH_REGS
	select FLASH_EX_OP_ENABLED
	default y
	help
	  Cros-flash driver using the Andes flash xip driver.

if CROS_FLASH_ANDES_XIP

# Initialize the Andes flash driver before the cros-flash driver
config FLASH_ANDES_QSPI_INIT_PRIORITY
	default 50

endif

config CROS_FLASH_FOCALTECH
	bool "FT driver for the Zephyr shim"
	depends on SOC_SERIES_FT90
	default y
	select PLATFORM_EC_FLASH_CROS
	select PLATFORM_EC_SPI_FLASH_REGS
	help
	  This option enables the flash driver for the Focaltech FT90 chip. We can
	  access the flash by read, write and erase.

if CROS_FLASH_FOCALTECH

config CROS_FLASH_FOCALTECH_INIT_PRIORITY
	int "Generic flash driver priority for the Zephyr shim"
	default 85
	help
	  This sets the priority of the cros-flash driver for Zephyr shim.
	  This driver depends on the flash-controller driver in Zephyr.
	  Its priority must be lower than CONFIG_FLASH_INIT_PRIORITY.

endif
```

## zephyr/drivers/cros_system/Kconfig
```kconfig
# Copyright 2021 The ChromiumOS Authors
# Use of this source code is governed by a BSD-style license that can be
# found in the LICENSE file.

if PLATFORM_EC

choice CROS_SYSTEM_CHIP_SELECTION
	prompt "cros_system Chip Driver Selection"
	default CROS_SYSTEM_NPCX if SOC_FAMILY_NPCX
	default CROS_SYSTEM_IT8XXX2 if SOC_FAMILY_ITE_EC
	default CROS_SYSTEM_XEC if SOC_FAMILY_MICROCHIP_MEC
	default CROS_SYSTEM_NATIVE_POSIX if (SOC_POSIX || SOC_NSIM)
	default CROS_SYSTEM_STM32 if SOC_FAMILY_STM32
	default CROS_SYSTEM_REALTEK if SOC_FAMILY_REALTEK_EC
	default CROS_SYSTEM_ET171 if SOC_EGIS_ET171
	default CROS_SYSTEM_ELAN_EM32 if SOC_EM32F967
	default CROS_SYSTEM_FT90 if SOC_SERIES_FT90
	default CROS_SYSTEM_NONE
	help
	  Select the chip-specific cros_system driver. Only one driver can be
	  enabled at a time to prevent duplicate symbol errors.

config CROS_SYSTEM_NPCX
	bool "Nuvoton NPCX cros system driver"
	depends on SOC_FAMILY_NPCX
	select PINCTRL if DT_HAS_NUVOTON_NPCX_POWER_PSL_ENABLED
	help
	  This option enables the cros system driver for the NPCX family of
	  processors. Currently, Zephyr doesn't provide the system related API.
	  The cros system driver provides the low-level driver related to
	  chromium ec system functionality.

config CROS_SYSTEM_IT8XXX2
	bool "ITE IT8XXX2 cros system driver"
	depends on SOC_FAMILY_ITE_EC
	help
	  This option enables the cros system driver for the it8xxx2 family of
	  processors.

config CROS_SYSTEM_XEC
	bool "Microchip XEC cros system driver"
	depends on SOC_FAMILY_MICROCHIP_MEC
	help
	  This option enables the cros system driver for the MCHP XEC family of
	  processors. Currently, Zephyr doesn't provide the system related API.
	  The cros system driver provides the low-level driver related to
	  chromium ec system functionality.

config CROS_SYSTEM_NATIVE_POSIX
	bool "Native POSIX cros system driver (test only)"
	depends on (SOC_POSIX || SOC_NSIM) && CROS_EC
	help
	  This option enables the cros system driver for the native POSIX
	  testing board. Currently, Zephyr doesn't provide the system related
	  API.  The cros system driver provides fakable stubs for the low-level
	  driver related to chromium ec system functionality.

config CROS_SYSTEM_STM32
	bool "ST STM32 cros system driver"
	depends on SOC_FAMILY_STM32 && IWDG_STM32
	select HWINFO
	select REBOOT
	help
	  This option enables the cros system driver for the STM32 family of
	  processors. The cros system driver provides the low-level driver
	  related to chromium ec system functionality.

config CROS_SYSTEM_REALTEK
	bool "REALTEK RTS5915 cros system driver"
	depends on SOC_FAMILY_REALTEK_EC
	help
	  This option enables the cros system driver for the realtek family of
	  processors.

config CROS_SYSTEM_ET171
	bool "Egis ET171 cros system driver"
	depends on SOC_EGIS_ET171
	select SYSCON
	select HWINFO
	help
	  This option enables the cros system driver for the Egis ET171 SOC.
	  It uses AOSMU(Always On System Management Unit) custom Egis module.

config CROS_SYSTEM_ELAN_EM32
	bool "ELAN EM32 cros system driver"
	depends on SOC_EM32F967
	select HWINFO
	help
	  This option enables the cros system driver for the elan em32 family of
	  processors.

config CROS_SYSTEM_FT90
	bool "FT cros system driver"
	depends on SOC_SERIES_FT90
	help
	  This option enables the cros system driver for the Focaltech ft90 family of
	  processors.

config CROS_SYSTEM_NONE
	bool "No cros_system driver"
	help
	  Select this if your board does not use any of the supported
	  cros_system drivers (e.g. Intel ISH boards).

endchoice

config CROS_SYSTEM_INIT_PRIORITY
	int "cros_system initialization priority"
	default 10
	help
	  This sets the initialization priority for the cros_system driver.
	  The cros_system driver provides access to the chip reset cause and
	  must be initialized before the SYSTEM_PRE initialization.

endif # PLATFORM_EC
```

## zephyr/drivers/cse_early_rec/Kconfig
```kconfig
# Copyright 2026 The ChromiumOS Authors
# Use of this source code is governed by a BSD-style license that can be
# found in the LICENSE file.

config CSE_EARLY_RECOVERY_GPIO_DRIVER
	bool "Use a GPIO to signal when booting into Recovery Mode"
	default y
	depends on DT_HAS_CROS_EC_CSE_EARLY_REC_ENABLED && AP_PWRSEQ_DRIVER
	help
	  Set a GPIO to indicate whether the system is booting into Recovery
	  Mode. This signal is connected to Intel SoCs, where it is read by the
	  CSE firmware during early bootup.

	  Requires use of the newer Intel AP power sequencing driver
	  (CONFIG_AP_PWRSEQ_DRIVER) to configure the power state hooks.

if CSE_EARLY_RECOVERY_GPIO_DRIVER

config CSE_EARLY_RECOVERY_GPIO_DRIVER_INIT_PRIORITY
	int "CSE early recovery driver init priority"
	default 50
	help
	  CSE early recovery driver init priority. This should initialize after
	  (higher value than) CONFIG_GPIO_INIT_PRIORITY.

endif # CSE_EARLY_RECOVERY_GPIO_DRIVER
```

## zephyr/drivers/dsp_comms/Kconfig.client
```kconfig
# Copyright 2024 The ChromiumOS Authors
# Use of this source code is governed by a BSD-style license that can be
# found in the LICENSE file.

config PLATFORM_EC_DSP_CLIENT
	bool "Communication driver for DSP"
	default y
	depends on DT_HAS_CROS_DSP_CLIENT_ENABLED
	depends on NANOPB
	depends on I2C
	depends on EVENTS
	help
	  Allow proto based communication between the EC and DSP core.

	  If enabled, the core will enable a client which is used to
	  notify or request data from the EC (this should be done on the
	  DSP core).

config PLATFORM_EC_DSP_CLIENT_TIMEOUT_MS
	int "Milliseconds to timeout waiting for the service response"
	default 300
	depends on PLATFORM_EC_DSP_CLIENT
	help
	  Once a call is made to the service, we will wait for the status GPIO
	  to assert which will signal that we can read the status. This config
	  specifies the maximum duration (in milliseconds) to wait for that
	  interrupt.

config PLATFORM_EC_DSP_CLIENT_TX_RETRY_MAX
	int "Maximum number of TX retries"
	default 20
	depends on PLATFORM_EC_DSP_CLIENT
	help
	  When a TX call fails, a retry should happen up to this many times. Failures
	  on the TX could happen if the service is in low power mode and is in the
	  process of waking up as a result of this TX.

config PLATFORM_EC_DSP_CLIENT_TX_RETRY_INTERVAL_MS
	int "Milliseconds to wait between TX retries"
	default 5
	depends on PLATFORM_EC_DSP_CLIENT
	help
	  When a TX call fails a retry should happen this many milliseconds later.
	  Failures on the TX could happen if the service is in low power mode and is
	  in the process of waking up as a result of this TX.
```

## zephyr/drivers/fingerprint/Kconfig
```kconfig
# Copyright 2023 The ChromiumOS Authors
# Use of this source code is governed by a BSD-style license that can be
# found in the LICENSE file.

menuconfig FINGERPRINT_SENSOR
	bool "Fingerprint sensor drivers"
	help
	  Enable support for fingerprint sensors. The driver must implement
	  cros_fingerprint API.

if FINGERPRINT_SENSOR

config FINGERPRINT_SENSOR_INIT_PRIORITY
	int "Fingerprint sensor init priority"
	default 99
	range 0 99
	help
	  Fingerprint sensor driver device initialization priority.
	  This initialization priority is used unless the driver implementation
	  has its own initialization priority.

config FINGERPRINT_SENSOR_IMAGE_SIZE
	int
	default 26260 if FINGERPRINT_SENSOR_FPC1025
	default 35460 if FINGERPRINT_SENSOR_FPC1145
	default 26200 if FINGERPRINT_SENSOR_EGIS630
	default 9980 if FINGERPRINT_SENSOR_EGIS660
	default 12800 if FINGERPRINT_SENSOR_ELAN80SERIES
	help
	  This is a size of fingerprint image with an additional metadata.
	  This size must be at least a size of raw image. For FPC1025,
	  the size of a raw image is 25600 and the size of metadata is 660, so
	  the total data is 26260 bytes.

	  If provided, the value will be used as a size of image buffer.
	  Otherwise it will be obtained from width, height and bits per pixel
	  properties.

config FINGERPRINT_SENSOR_IMAGE_OFFSET
	int
	default 400 if FINGERPRINT_SENSOR_FPC1025
	default 2340 if FINGERPRINT_SENSOR_FPC1145
	default 0 if FINGERPRINT_SENSOR_EGIS630
	default 172 if FINGERPRINT_SENSOR_EGIS660
	default 0 if FINGERPRINT_SENSOR_ELAN80SERIES
	default 0 if FINGERPRINT_SENSOR_FT98XX
	help
	  This is an offset of the raw fingerprint image in the image data
	  buffer.

	  This option overrides the default offset (0).

# zephyr-keep-sorted-start
rsource "Kconfig.egis"
rsource "Kconfig.elan"
rsource "Kconfig.fpc"
rsource "Kconfig.ft"
rsource "Kconfig.sensor_sim"
# zephyr-keep-sorted-stop

endif # FINGERPRINT_SENSOR
```
