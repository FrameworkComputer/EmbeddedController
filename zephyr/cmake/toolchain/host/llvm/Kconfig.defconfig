## zephyr/drivers/fingerprint/Kconfig.egis
```kconfig
# Copyright 2025 The ChromiumOS Authors
# Use of this source code is governed by a BSD-style license that can be
# found in the LICENSE file.


menuconfig FINGERPRINT_SENSOR_EGIS630
	bool "Fingerprint driver for EGIS630"
	default y
	depends on DT_HAS_EGIS_EGIS630_ENABLED
	help
	  Driver for EGIS630 fingerprint sensor. It requires EGIS private library
	  to implement cros_fingerprint API. If the library is not available it
	  only supports checking sensor hardware ID.

if FINGERPRINT_SENSOR_EGIS630

config FINGERPRINT_SENSOR_EGIS630_HEAP_SIZE
	int "Size of heap for EGIS630 driver"
	default 108544
	help
	  Size of heap to be used by EGIS private library. The heap must have
	  enough size to keep finger templates during matching.
	  106KB is enough to match 3 templates at once.

config FINGERPRINT_SENSOR_EGIS630_PAL
	bool "Platform Abstraction Layer for EGIS private library"
	default y if HAVE_EGIS630_PRIVATE_DRIVER
	help
	  If enabled, Platform Abstraction Layer for EGIS private library will be
	  compiled. The PAL is used to interact with the sensor (SPI, GPIO) and
	  the system (heap allocations, printing messages, time functions).

# Enabled in private driver Kconfig
config HAVE_EGIS630_PRIVATE_DRIVER
	bool
	default n
	help
	  If enabled, it indicates that the private driver is present.

endif # FINGERPRINT_SENSOR_EGIS630

menuconfig FINGERPRINT_SENSOR_EGIS660
	bool "Fingerprint driver for EGIS660"
	default y
	depends on DT_HAS_EGIS_EGIS660_ENABLED
	help
	  Driver for EGIS660 fingerprint sensor. It requires EGIS private library
	  to implement cros_fingerprint API. If the library is not available it
	  only supports checking sensor hardware ID.

if FINGERPRINT_SENSOR_EGIS660

config FINGERPRINT_SENSOR_EGIS660_HEAP_SIZE
	int "Size of heap for EGIS660 driver"
	default 153600
	help
	  Size of heap to be used by EGIS private library. The heap must have
	  enough size to keep finger templates during matching.
	  150KB is enough to match 3 templates at once.

config FINGERPRINT_SENSOR_EGIS660_PAL
	bool "Platform Abstraction Layer for EGIS private library"
	default y if HAVE_EGIS660_PRIVATE_DRIVER
	help
	  If enabled, Platform Abstraction Layer for EGIS private library will be
	  compiled. The PAL is used to interact with the sensor (SPI, GPIO) and
	  the system (heap allocations, printing messages, time functions).

config FINGERPRINT_SENSOR_EGIS660_APNS
	bool "EGIS660 APNS storage"
	default y
	depends on $(dt_nodelabel_enabled,egis660_apns_data)
	help
	  If enabled, the APNS(Adaptive Pixel Noise Suppression) data generated
	  during the enroll and match can be stored on APNS storage.

# Enabled in private driver Kconfig
config HAVE_EGIS660_PRIVATE_DRIVER
	bool
	default n
	help
	  If enabled, it indicates that the private driver is present.

endif # FINGERPRINT_SENSOR_EGIS660
```

## zephyr/drivers/fingerprint/Kconfig.elan
```kconfig
# Copyright 2025 The ChromiumOS Authors
# Use of this source code is governed by a BSD-style license that can be
# found in the LICENSE file.


config FINGERPRINT_SENSOR_ELAN80SERIES
    bool
    help
      Enable driver for ELAN 80 series sensor.

if FINGERPRINT_SENSOR_ELAN80SERIES

config HAVE_ELAN80SERIES_PRIVATE_DRIVER
    bool
    help
      If enabled, it indicates that the elan 80 series private driver is present.

config FINGERPRINT_SENSOR_ELAN80SERIES_PAL
    bool
	default y
    help
      If enabled, Platform Abstraction Layer for ELAN private library will be compiled.
      This PAL is used by both ELAN80SG and ELANI80SA sensors.

config FINGERPRINT_SENSOR_ELAN80SERIES_HEAP_SIZE
	int
	default 36864 if FINGERPRINT_SENSOR_ELAN80SG
	default 67568 if FINGERPRINT_SENSOR_ELANI80SA
	help
	  Size of heap to be used by ELAN private library. The heap must have
	  enough space to facilitate the generation of the finger templates
	  during the enrollment process and to enable efficient runtime matching
	  operations.

choice FINGERPRINT_SENSOR_ELAN80SERIES_READ_MODE
    prompt "ELAN 80 series read mode"
	default FINGERPRINT_SENSOR_ELAN80SERIES_READ_MODE_FULL if FINGERPRINT_SENSOR_ELAN80SG
	default FINGERPRINT_SENSOR_ELAN80SERIES_READ_MODE_LINEWISE if FINGERPRINT_SENSOR_ELANI80SA
    help
      Select the data read mode for the ELAN 80 series sensors.

config FINGERPRINT_SENSOR_ELAN80SERIES_READ_MODE_FULL
    bool "Image read mode"
    help
      Reads the image in a standard block.

config FINGERPRINT_SENSOR_ELAN80SERIES_READ_MODE_LINEWISE
    bool "Line-wise read mode"
    help
      Reads the image with a line-wise approach.
endchoice
endif # FINGERPRINT_SENSOR_ELAN80SERIES

menuconfig FINGERPRINT_SENSOR_ELAN80SG
	bool "Fingerprint driver for ELAN80SG"
	default y
	depends on DT_HAS_ELAN_ELAN80SG_ENABLED
	select FINGERPRINT_SENSOR_ELAN80SERIES
	help
	  Driver for ELAN80SG fingerprint sensor. It requires ELAN private library
	  to implement cros_fingerprint API. If the library is not available it
	  only supports checking sensor hardware ID.

menuconfig FINGERPRINT_SENSOR_ELANI80SA
	bool "Fingerprint driver for ELANI80SA"
	default y
	depends on DT_HAS_ELAN_ELANI80SA_ENABLED
	select FINGERPRINT_SENSOR_ELAN80SERIES
	help
	  Driver for ELANI80SA fingerprint sensor. It requires ELAN private library
	  to implement cros_fingerprint API. If the library is not available it
	  only supports checking sensor hardware ID.
```

## zephyr/drivers/fingerprint/Kconfig.ft
```kconfig
# Copyright 2026 The ChromiumOS Authors
# Use of this source code is governed by a BSD-style license that can be
# found in the LICENSE file.

config FINGERPRINT_SENSOR_FT98XX
	bool "FT98XX sensor driver"
	default y
	depends on DT_HAS_FOCALTECH_FT98XX_ENABLED
	help
	  Enable driver for focaltech ft98 series sensor

if FINGERPRINT_SENSOR_FT98XX

config FINGERPRINT_SENSOR_FT98XX_HEAP_SIZE
	int "Size of heap for FT98XX driver"
	default 21504
	help
	  Size of heap to be used by FT98XX private library. The heap must have
	  enough space to facilitate the generation of the finger templates
	  during the enrollment process and to enable efficient runtime matching
	  operations. For these operations, a 21KB heap is sufficient, currently
	  this heap is for sensor raw data buffer, the biggest size of sensor
	  raw data buffer is 20KB, so 21KB here is sufficient.

config FINGERPRINT_SENSOR_FT98XX_PAL
	bool "Platform Abstraction Layer for Focaltech private library"
	default y
	help
	  If enabled, Platform Abstraction Layer for Focaltech private library will be
	  compiled. The PAL is used to interact with the sensor (SPI, GPIO) and
	  the system (heap allocations, printing messages, time functions).

# Enabled in private driver Kconfig
config HAVE_FT98XX_PRIVATE_DRIVER
	bool
	help
	  If enabled, it indicates that focaltech private driver is present.

endif # FINGERPRINT_SENSOR_FT98XX
```

## zephyr/drivers/imvp/Kconfig
```kconfig
# Copyright 2026 The ChromiumOS Authors
# Use of this source code is governed by a BSD-style license that can be
# found in the LICENSE file.

config IMVP_RT3645
	bool
	default y if DT_HAS_RICHTEK_RT3645_ENABLED
	help
	  Enable support for richtek RT3645 IMVP.

if IMVP_RT3645

config IMVP_RT3645_CONSOLE
	bool "Enable IMVP RT3645 console"
	help
	  Support accessing RT3645 IMVP registers through console commands.

config IMVP_FACTORY_UPDATE
	bool "Support imvp update in factory"
	depends on AP_PWRSEQ_DRIVER
	help
	  Support update of RT3645 IMVP registers during system boot.
endif
```

## zephyr/drivers/keyboard_input/Kconfig
```kconfig
# Copyright 2023 The ChromiumOS Authors
# Use of this source code is governed by a BSD-style license that can be
# found in the LICENSE file.

config CROS_EC_COL_GPIO_DRIVE
	bool "GPIO driven column keyboard matrix hook"
	depends on CROS_EC_KEYBOARD_INPUT
	depends on DT_HAS_CROS_EC_COL_GPIO_ENABLED
	default y
	select INPUT_KBD_DRIVE_COLUMN_HOOK
	help
	  Implemnt the hook to handle a keyboard matrix column using a GPIO.

config CROS_EC_SCANCODE_SET2
	bool "DT based scancode set2 table"
	depends on DT_HAS_CROS_EC_SCANCODE_SET2_ENABLED
	default y
	help
	  Define a scancode_set2 array based on the devicetree definition.
```

## zephyr/dts/bindings/ascp/cros-ec,ascp-mem-map.yaml
```yaml
# Copyright 2026 The ChromiumOS Authors
# Use of this source code is governed by a BSD-style license that can be
# found in the LICENSE file.

description: ASCP memory map.
  It holds information about location of data needed for establishing secure
  connection between EC and AP using ASCP protocol. Properties are phandles
  to the memory (mmio-sram compatible nodes) or flash regions (children of fixed-partitions node).
compatible: "cros-ec,ascp-mem-map"
properties:
  pk-m:
    type: phandle
    required: true
    description: Model public key.
  s-goog:
    type: phandle
    required: true
    description: Model public key signature.
  pk-d:
    type: phandle
    required: true
    description: Device public key.
  s-m:
    type: phandle
    required: true
    description: Device public key signature (signed using model key).
  pk-f:
    type: phandle
    required: true
    description: Ephemeral public key used in ECDH procedure.
  h-f:
    type: phandle
    required: true
    description: SHA256 hash of the firmware.
  s-d:
    type: phandle
    required: true
    description: Signature of the SHA256( 0xC001 || h_f || pk_f) using device key.
  sk-f:
    type: phandle
    required: true
    description: Ephemeral private key used in ECDH procedure.
```

## zephyr/dts/bindings/battery/atc,framework50w.yaml
```yaml
description: "ATC FRANDZG Framework Laptop"
compatible: "atc,framework50w"

include: battery-smart.yaml

properties:
   enum-name:
      type: string
      default: "atc,framework50w"

   # Fuel gauge
   manuf_name:
      default: "ATC"
   device_name:
      default: "FRANDZG"
   ship_mode_reg_addr:
      default: 0x00
   ship_mode_reg_data:
      default: [ 0x0010, 0x0010 ]
   flags:
      default: 0x04
   fet_reg_mask:
      default: 0x0002
   fet_disconnect_val:
      default: 0x0000
   fet_cfet_mask:
      default: 0x0004
   fet_cfet_off_val:
      default: 0x0000

   # Battery info
   voltage_max:
      default: 13440
   voltage_normal:
      default: 11670
   voltage_min:
      default: 9000
   precharge_current:
      default: 426
   start_charging_min_c:
      default: 0
   start_charging_max_c:
      default: 45
   charging_min_c:
      default: 0
   charging_max_c:
      default: 60
   discharging_min_c:
      default: -20
   discharging_max_c:
      default: 70
```

## zephyr/dts/bindings/battery/atc,framework75w.yaml
```yaml
description: "ATC Framework Laptop"
compatible: "atc,framework75w"

include: battery-smart.yaml

properties:
   enum-name:
      type: string
      default: "atc,framework75w"

   # Fuel gauge
   manuf_name:
      default: "ATC"
   device_name:
      default: "FRANEDA"
   ship_mode_reg_addr:
      default: 0x00
   ship_mode_reg_data:
      default: [ 0x0010, 0x0010 ]
   fet_mfgacc_support:
      default: 1
   fet_reg_mask:
      default: 0x0002
   fet_disconnect_val:
      default: 0x0000
   fet_cfet_mask:
      default: 0x0004
   fet_cfet_off_val:
      default: 0x0000

   # Battery info
   voltage_max:
      default: 18040
   voltage_normal:
      default: 15640
   voltage_min:
      default: 12000
   precharge_current:
      default: 256
   start_charging_min_c:
      default: 0
   start_charging_max_c:
      default: 45
   charging_min_c:
      default: 0
   charging_max_c:
      default: 55
   discharging_min_c:
      default: 0
   discharging_max_c:
      default: 70
```

## zephyr/dts/bindings/battery/atl,ap25aap.yaml
```yaml
description: "ATL AP25AAP"
compatible: "atl,ap25aap"

include: battery-smart.yaml

properties:
  enum-name:
    type: string
    default: "atl,ap25aap"

  # Fuel Gauge
  manuf_name:
    default: "ATL KT0040A001"
  device_name:
    default: "AP25AAP"
  ship_mode_reg_addr:
    default: 0x00
  ship_mode_reg_data:
    default: [0x0010, 0x0010]
  # Manufacturer Access 0x00
  # b15: D-FET
  # b14: C-FET
  flags:
    default: 0x00
  fet_reg_addr:
    default: 0x0
  fet_reg_mask:
    default: 0x8000
  fet_disconnect_val:
    default: 0x0000
  fet_cfet_mask:
    default: 0x4000
  fet_cfet_off_val:
    default: 0x0000

  # Battery info
  voltage_max:
    default: 17920
  voltage_normal:
    default: 15560
  voltage_min:
    default: 12000
  precharge_current:
    default: 256
  start_charging_min_c:
    default: 0
  start_charging_max_c:
    default: 50
  charging_min_c:
    default: 0
  charging_max_c:
    default: 60
  discharging_min_c:
    default: -20
  discharging_max_c:
    default: 75
```

## zephyr/dts/bindings/battery/atl,gb-s30-636076-010h.yaml
```yaml
# Copyright 2025 The ChromiumOS Authors
# Use of this source code is governed by a BSD-style license that can be
# found in the LICENSE file.

description: "ATL GB-S30-636076-010H"
compatible: "atl,gb-s30-636076-010h"

include: battery-smart.yaml

properties:
  enum-name:
    type: string
    default: "atl,gb-s30-636076-010h"

  # Fuel gauge
  manuf_name:
    default: "313-B7-38-A"
  device_name:
    default: "PM03068XL"
  ship_mode_reg_addr:
    default: 0x00
  ship_mode_reg_data:
    default: [0x0010, 0x0010]
  flags:
    default: 0
  fet_reg_addr:
    default: 0x43
  fet_reg_mask:
    default: 0x0003
  fet_disconnect_val:
    default: 0x0
  fet_cfet_mask:
    default: 0x0002
  fet_cfet_off_val:
    default: 0x0

  # Battery info
  voltage_max:
    default: 13440
  voltage_normal:
    default: 11670
  voltage_min:
    default: 9000
  precharge_current:
    default: 256
  start_charging_min_c:
    default: 0
  start_charging_max_c:
    default: 50
  charging_min_c:
    default: 0
  charging_max_c:
    default: 50
  discharging_min_c:
    default: -10
  discharging_max_c:
    default: 65
```

## zephyr/dts/bindings/battery/atl,l25n4pk5.yaml
```yaml
# Copyright 2025 The ChromiumOS Authors
# Use of this source code is governed by a BSD-style license that can be
# found in the LICENSE file.

description: "ATL L25N4PK5"
compatible: "atl,l25N4pk5"

include: battery-smart.yaml

properties:
  enum-name:
    type: string
    default: "atl,l25n4pk5"

  # Fuel gauge
  manuf_name:
    default: "atl"
  device_name:
    default: "L25n4pk5"
  ship_mode_reg_addr:
    default: 0x34
  ship_mode_reg_data:
    default: [0x0000, 0x1000]
  flags:
    default: 0
  fet_reg_addr:
    default: 0x00
  fet_reg_mask:
    default: 0x0018
  fet_disconnect_val:
    default: 0x0000

  # Battery info
  voltage_max:
    default: 17800
  voltage_normal:
    default: 15480
  voltage_min:
    default: 12000
  precharge_current:
    default: 226
  start_charging_min_c:
    default: 0
  start_charging_max_c:
    default: 50
  charging_min_c:
    default: 0
  charging_max_c:
    default: 60
  discharging_min_c:
    default: -20
  discharging_max_c:
    default: 60
```
