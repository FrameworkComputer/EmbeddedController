## zephyr/drivers/usbc/Kconfig.pdc_trace
```kconfig
# Copyright 2024 The ChromiumOS Authors
# Use of this source code is governed by a BSD-style license that can be
# found in the LICENSE file.

if USBC_PDC_TRACE_MSG

config USBC_PDC_TRACE_MSG_FIFO_SIZE
	int "PDC message tracing FIFO size"
	range 128 65536
	default 1024
	help
	  This is the byte size of the PDC message tracing FIFO. When
	  tracing is active, the FIFO needs to be deep enough to absorb
	  delays on the AP side when retrieving messages. When the FIFO
	  is full, messages are tail-dropped which effectively disables
	  tracing until the FIFO drains. The FIFO is allocated in EC
	  RAM, so some sizing judgment may be necessary on ECs with
	  limited RAM.

config USBC_PDC_TRACE_MSG_PORT
	prompt "Default PDC trace port number"
	int
	range 0 255
	default 255 # EC_PDC_TRACE_MSG_PORT_NONE
	help
	  This is the initial PDC port number to trace before tracing
	  behavior can be specified using the EC console or host
	  commands. Use this if tracing is required during early boot
	  time. By default, tracing is disabled until explicitly
	  enabled. There are two special values to keep in mind:
	    255: EC_PDC_TRACE_MSG_PORT_NONE
	         tracing is disabled
	    254: EC_PDC_TRACE_MSG_PORT_ALL
	         tracing is enabled on all ports

config USBC_PDC_TRACE_MSG_CONSOLE_CMD
	bool "Enable pdc trace console command"
	default y
	help
	  Enable console command for printing PDC communication trace
	  messages.

config USBC_PDC_TRACE_MSG_HOST_CMD
	bool "Enable PDC_TRACE host command"
	default y
	help
	  Enable host command for collecting PDC communication trace
	  messages.

module = USBC_PDC_TRACE_MSG
module-str = usbc_pdc_trace_msg
source "subsys/logging/Kconfig.template.log_config"

endif # USBC_PDC_TRACE_MSG
```

## zephyr/drivers/vivaldi_kbd/Kconfig
```kconfig
# Copyright 2024 The ChromiumOS Authors
# Use of this source code is governed by a BSD-style license that can be
# found in the LICENSE file.

config CROS_EC_VIVALDI_KBD
	bool "Vivaldi keyboard support"
	depends on PLATFORM_EC_KEYBOARD_PROTOCOL_8042
	depends on DT_HAS_CROS_EC_VIVALDI_KBD_ENABLED
	default y
	select INPUT_KBD_ACTUAL_KEY_MASK_DYNAMIC if INPUT
	help
	  Enable code for Vivaldi keyboard. A Chromium OS device is Vivaldi
	  compatible if the keyboard matrix complies with: go/vivaldi-matrix.

	  Vivaldi code enables:
	  - A response to EC_CMD_GET_KEYBD_CONFIG command.
	  - The specified row, columns in the keyboard mask
	  - Custom key codes for the top keys
	  - Set the boot keys volume up code if supported
```

## zephyr/dts/bindings/adc/named-adc-channels.yaml
```yaml
# Copyright 2021 The ChromiumOS Authors
# Use of this source code is governed by a BSD-style license that can be
# found in the LICENSE file.

description: ADC parent node

compatible: "named-adc-channels"

child-binding:
  description: Named ADCs child node
  properties:
    io-channels:
      required: true
      type: phandle-array
      description: IO channels specifiers ADC channel used
    mul:
      type: int
      default: 1
      description: Multiplication factor of ADC measurement
    div:
      type: int
      default: 1
      description: Division factor of ADC measurement
    gain:
      type: string
      description:
        Gain selection for the ADC channel. Source of valid gain settings is
        "enum adc_gain" found in <zephyr-base>/include/drivers/adc.h
      enum:
        - ADC_GAIN_1_6
        - ADC_GAIN_1_5
        - ADC_GAIN_1_4
        - ADC_GAIN_1_3
        - ADC_GAIN_1_2
        - ADC_GAIN_2_3
        - ADC_GAIN_1
        - ADC_GAIN_2
        - ADC_GAIN_3
        - ADC_GAIN_4
        - ADC_GAIN_8
        - ADC_GAIN_16
        - ADC_GAIN_32
        - ADC_GAIN_64
        - ADC_GAIN_128
      default: ADC_GAIN_1
    reference:
      type: string
      description:
        Sets the reference voltage for the ADC channel. Source of valid
        reference voltages is "enum adc_reference" found in
        <zephyr-base>/include/drivers/adc.
      enum:
        - ADC_REF_VDD_1
        - ADC_REF_VDD_1_2
        - ADC_REF_VDD_1_3
        - ADC_REF_VDD_1_4
        - ADC_REF_INTERNAL
        - ADC_REF_EXTERNAL0
        - ADC_REF_EXTERNAL1
      default: ADC_REF_INTERNAL
    acquisition-time:
      type: int
      description:
        Set the acquisition time for ADC conversion. Use the ADC_ACQ_TIME macro
        to compose this value. If the hardware doesn't support a configurable
        acquisition time, use ADC_ACQ_TIME_DEFAULT (0).
      default: 0
    differential:
      type: boolean
      description:
        Set the ADC acquisition mode to differential. Default mode is
        single-ended acquisition.
    enum-name:
      type: string
      required: true
      description:
        Enum values used in the source code to refer to the ADC channels
      enum:
        - ADC_AMON_BMON
        - ADC_BASE_DET
        - ADC_BOARD_ID_0
        - ADC_BOARD_ID_1
        - ADC_CORE_IMON1
        - ADC_ID_0
        - ADC_ID_1
        - ADC_PMON
        - ADC_PP1050_PROC
        - ADC_PP3300_S5
        - ADC_PSYS
        - ADC_SOC_IMON2
        - ADC_TEMP_SENSOR_1
        - ADC_TEMP_SENSOR_2
        - ADC_TEMP_SENSOR_3
        - ADC_TEMP_SENSOR_4
        - ADC_TEMP_SENSOR_5
        - ADC_TEMP_SENSOR_6
        - ADC_TEMP_SENSOR_CHARGER
        - ADC_TEMP_SENSOR_DDR_SOC
        - ADC_TEMP_SENSOR_FAN
        - ADC_TEMP_SENSOR_MEMORY
        - ADC_TEMP_SENSOR_PP3300_REGULATOR
        - ADC_TEMP_SENSOR_PP5000_Z1
        - ADC_TEMP_SENSOR_SOC
        - ADC_TEMP_SENSOR_1_DDR_SOC
        - ADC_TEMP_SENSOR_2_AMBIENT
        - ADC_TEMP_SENSOR_3_CHARGER
        - ADC_TEMP_SENSOR_4_WWAN
        - ADC_VBUS
        - ADC_VBUS_C0
        - ADC_VBUS_C1
        - ADC_EVB_CH_0
        - ADC_EVB_CH_1
        - ADC_EVB_CH_2
        - ADC_EVB_CH_3
        - ADC_EVB_CH_4
```

## zephyr/dts/bindings/adc/named-adc.yaml
```yaml
# Copyright 2021 The Chromium OS Authors. All rights reserved.
# Use of this source code is governed by a BSD-style license that can be
# found in the LICENSE file.

description: ADC parent node

compatible: "named-adc-channels"

child-binding:
  description: Named ADCs child node
  properties:
    label:
      required: true
      type: string
      description:
        Human-readable string describing the device (used as
        device_get_binding() argument)
    channel:
      required: true
      type: int
      description: ADC channel used
    mul:
      required: false
      type: int
      default: 1
      description: Multiplication factor of ADC measurement
    div:
      required: false
      type: int
      default: 1
      description: Division factor of ADC measurement
    enum-name:
      type: string
      required: true
      description:
        Enum values used in the source code to refer to the ADC channels
      enum:
      - ADC_AMON_BMON
      - ADC_VBUS
      - ADC_PSYS
      - ADC_TEMP_SENSOR_CHARGER
      - ADC_TEMP_SENSOR_DDR_SOC
      - ADC_TEMP_SENSOR_FAN
      - ADC_TEMP_SENSOR_PP3300_REGULATOR
```

## zephyr/dts/bindings/battery/aec,5477109.yaml
```yaml
# Copyright 2021 The ChromiumOS Authors
# Use of this source code is governed by a BSD-style license that can be
# found in the LICENSE file.

description: "AEC 5477109"
compatible: "aec,5477109"

include: battery-smart.yaml

properties:
  enum-name:
    type: string
    default: "aec,5477109"

  # Fuel gauge
  manuf_name:
    default: "AEC"
  device_name:
    default: "5477109"
  ship_mode_reg_addr:
    default: 0x00
  ship_mode_reg_data:
    default: [0x0010, 0x0010]
  # Documentation: b/182847979
  flags:
    default: 0
  fet_reg_addr:
    default: 0x0
  fet_reg_mask:
    default: 0x2000
  fet_disconnect_val:
    default: 0x2000

  # Battery info
  voltage_max:
    default: 8700
  voltage_normal:
    default: 7600
  voltage_min:
    default: 6000
  precharge_current:
    default: 100
  start_charging_min_c:
    default: 0
  start_charging_max_c:
    default: 45
  charging_min_c:
    default: 0
  charging_max_c:
    default: 50
  discharging_min_c:
    default: -20
  discharging_max_c:
    default: 60
```

## zephyr/dts/bindings/battery/as3gwrc3ka,c235-41.yaml
```yaml
description: "AS3GWRc3KA C235-41"
compatible: "as3gwrc3ka,c235-41"

include: battery-smart.yaml

properties:
   enum-name:
      type: string
      default: "as3gwrc3ka,c235-41"

   # Fuel gauge
   manuf_name:
      default: "AS3GWRc3KA"
   device_name:
      default: "C235-41"
   ship_mode_reg_addr:
      default: 0x00
   ship_mode_reg_data:
      default: [ 0x10, 0x10 ]
   # Documentation: b/150833879
   # Charging/Discharging FETs Status
   # Register SBS_PackStatus_ACCESS (0x99)
   # Bit-3: XDSG
   # Bit-2: XCHG
   fet_reg_addr:
      default: 0x99
   fet_reg_mask:
      default: 0x08
   fet_disconnect_val:
      default: 0x08
   fet_cfet_mask:
      default: 0x04
   fet_cfet_off_val:
      default: 0x04

   # Battery info
   voltage_max:
      default: 8800
   voltage_normal:
      default: 7700
   voltage_min:
      default: 6000
   precharge_current:
      default: 256
   start_charging_min_c:
      default: 0
   start_charging_max_c:
      default: 45
   charging_min_c:
      default: 0
   charging_max_c:
      default: 60
   discharging_min_c:
      default: 0
   discharging_max_c:
      default: 60
```

## zephyr/dts/bindings/battery/as3gxxe3ka,c140254.yaml
```yaml
description: "AS3GXXe3KA C140254"
compatible: "as3gxxe3ka,c140254"

include: battery-smart.yaml

properties:
   enum-name:
      type: string
      default: "as3gxxe3ka,c140254"

   # Fuel gauge
   manuf_name:
      default: "AS3GXXe3KA"
   device_name:
      default: "C140254"
   ship_mode_reg_addr:
      default: 0x00
   ship_mode_reg_data:
      default: [ 0x0010, 0x0010 ]
   # Documentation: b/150833879
   # Charging/Discharging FETs Status
   # Register SBS_PackStatus_ACCESS (0x99)
   # Bit-3: XDSG
   # Bit-2: XCHG
   fet_reg_addr:
      default: 0x99
   fet_reg_mask:
      default: 0x0C
   fet_disconnect_val:
      default: 0x0C
   fet_cfet_mask:
      default: 0x04
   fet_cfet_off_val:
      default: 0x04

   # Battery info
   voltage_max:
      default: 8900
   voltage_normal:
      default: 7970
   voltage_min:
      default: 6000
   precharge_current:
      default: 256
   start_charging_min_c:
      default: 0
   start_charging_max_c:
      default: 45
   charging_min_c:
      default: 0
   charging_max_c:
      default: 60
   discharging_min_c:
      default: -20
   discharging_max_c:
      default: 60
```

## zephyr/dts/bindings/battery/atl,framework61w.yaml
```yaml
description: "ATL NVT Framework Laptop"
compatible: "atl,framework61w"

include: battery-smart.yaml

properties:
   enum-name:
      type: string
      default: "atl,framework61w"

   # Fuel gauge
   manuf_name:
      default: "NVT"
   device_name:
      default: "FRANGWAT01"
   ship_mode_reg_addr:
      default: 0x00
   ship_mode_reg_data:
      default: [ 0x0010, 0x0010 ]
   flags:
      default: 0x04
   fet_reg_mask:
      default: 0x0002
   fet_disconnect_val:
      default: 0x0000
   fet_cfet_mask:
      default: 0x0004
   fet_cfet_off_val:
      default: 0x0000

   # Battery info
   voltage_max:
      default: 17800
   voltage_normal:
      default: 15480
   voltage_min:
      default: 12000
   precharge_current:
      default: 80
   start_charging_min_c:
      default: 0
   start_charging_max_c:
      default: 45
   charging_min_c:
      default: 0
   charging_max_c:
      default: 55
   discharging_min_c:
      default: 0
   discharging_max_c:
      default: 70
```

## zephyr/dts/bindings/battery/atl,gb-s20-4473a9.yaml
```yaml
# Copyright 2023 The ChromiumOS Authors
# Use of this source code is governed by a BSD-style license that can be
# found in the LICENSE file.

description: "ATL GB-S20-4473A9"
compatible: "atl,gb-s20-4473a9"

include: battery-smart.yaml

properties:
  enum-name:
    type: string
    default: "atl,gb-s20-4473a9"

  # Fuel gauge
  manuf_name:
    default: "313-B7-0D-A"
  device_name:
    default: "GG02047XL"
  ship_mode_reg_addr:
    default: 0x00
  ship_mode_reg_data:
    default: [0x0010, 0x0010]
  flags:
    default: 0
  fet_reg_addr:
    default: 0x43
  fet_reg_mask:
    default: 0x0003
  fet_disconnect_val:
    default: 0x0

  # Battery info
  voltage_max:
    default: 8800
  voltage_normal:
    default: 7700
  voltage_min:
    default: 6000
  precharge_current:
    default: 256
  start_charging_min_c:
    default: 0
  start_charging_max_c:
    default: 45
  charging_min_c:
    default: 0
  charging_max_c:
    default: 45
  discharging_min_c:
    default: -10
  discharging_max_c:
    default: 60
```

## zephyr/dts/bindings/battery/battery-fuel-gauge.yaml
```yaml
# Copyright 2021 The ChromiumOS Authors
# Use of this source code is governed by a BSD-style license that can be
# found in the LICENSE file.

description: |
   Battery fuel gauge parameters

properties:
  manuf_name:
    description: |
      String returned by the smart battery attribute
      ManufacturerName (0x20), which is used to help
      uniquely identify the type of battery.
    type: string
  device_name:
    description: |
      String returned by the smart battery attribute
      DeviceName (0x21), which is used to help
      uniquely identify the type of battery.
    type: string
  flags:
    description: |
      Fuel gauge flags. e.g FG_FLAG_SLEEP_MODE
    type: int
  ship_mode_reg_addr:
    description: |
       Address of register responsible for enabling ship mode.
    type: int
  ship_mode_reg_data:
    description: |
       Values written to register to enable ship mode.
    type: array
  sleep_mode_reg_addr:
    description: |
       Defines address where command will be sent to go into sleep mode.
    type: int
  sleep_mode_reg_data:
    description: |
       Defines value which will be sent to register to go into sleep mode.
    type: int
  fet_reg_addr:
    description: |
       Address of register which reports charging and discharging FETs status.
       This property is ignored if fet_mfgacc_support is true.
    type: int
  fet_reg_mask:
    description: |
       Mask which determines which bit in status value contains the
       discharge FET status.
    type: int
  fet_disconnect_val:
    description: |
       Value that describes which bits must be set to determine that
       discharge FET has disconnected the battery.
    type: int
  fet_cfet_mask:
    description: |
       Mask which determines which bit in status value contains the
       charge FET status. If this value is 0, this means there's
       no charge FET.
    type: int
  fet_cfet_off_val:
    description: |
       Value that describes which bits must be set to determine that
       charge FET has disconnected the battery.
    type: int
  imbalance_mv:
    description: |
       This property is used only if
       CONFIG_PLATFORM_EC_BATTERY_MEASURE_IMBALANCE is enabled.
       It should be an enum and its value should be a name of function
       which will be assigned to imbalance_mv pointer.
    type: string
```
