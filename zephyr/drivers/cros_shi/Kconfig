## zephyr/drivers/cros_shi/Kconfig
```kconfig
# Copyright 2021 The ChromiumOS Authors
# Use of this source code is governed by a BSD-style license that can be
# found in the LICENSE file.

if PLATFORM_EC_HOST_INTERFACE_SHI

config CROS_SHI_NPCX
	bool
	default y
	depends on !EC_HOST_CMD
	depends on DT_HAS_NUVOTON_NPCX_SHI_ENABLED || \
		   DT_HAS_NUVOTON_NPCX_SHI_ENHANCED_ENABLED
	help
	  This option enables Serial Host Interface driver for the NPCX family
	  of processors. This is used for host-command communication on the
	  platform which AP is ARM-based SoC.

if CROS_SHI_NPCX

config CROS_SHI_MAX_REQUEST
	hex "Max data size for the version 3 request packet"
	default 0x220
	help
	  This option indicates maximum data size for a version 3 request
	  packet. This must be big enough to handle a request header of host
	  command, flash write offset/size, and 512 bytes of flash data.

config CROS_SHI_MAX_RESPONSE
	hex "Max data size for the version 3 response packet"
	default 0x220
	help
	  This option indicates maximum data size for a version 3 response
	  packet. This must be big enough to handle a response header of host
	  command, flash read offset/size, and 512 bytes of flash data.

config CROS_SHI_NPCX_ENHANCED_BUF_MODE
	def_bool DT_HAS_NUVOTON_NPCX_SHI_ENHANCED_ENABLED
	help
	   In this mode, besides the original 128-bytes FIFO, an additional
	   single-byte output buffer can be selected/switched to generate a
	   response to simultaneous Read/Write transactions.

config CROS_SHI_NPCX_DEBUG
	bool "Enable SHI debug"
	help
	  print the debug messages for SHI module

endif # CROS_SHI_NPCX

config CROS_SHI_IT8XXX2
	bool
	default y
	depends on !EC_HOST_CMD
	depends on DT_HAS_ITE_IT8XXX2_SHI_ENABLED
	help
	  This option enables spi host interface driver which is required to
	  communicate with the EC when the CPU is the ARM processor.

if CROS_SHI_IT8XXX2

config CROS_SHI_IT8XXX2_INIT_PRIORITY
	int "cros_shi it8xxx2 initialization priority"
	default 54
	help
	  This sets the it8xxx2 cros_shi driver initialization priority.
	  In the GPIO shim, the alt function of SHI will be configured
	  as GPIO input pin. So the priority of cros_shi driver must be
	  lower than CONFIG_PLATFORM_EC_GPIO_INIT_PRIORITY, and
	  configuration these pins to alt function of SHI.

endif # CROS_SHI_IT8XXX2

endif # PLATFORM_EC_HOST_INTERFACE_SHI
```

## zephyr/drivers/cros_tabletmode_interrupt/Kconfig
```kconfig
# Copyright 2024 The ChromiumOS Authors
# Use of this source code is governed by a BSD-style license that can be
# found in the LICENSE file.

config CROS_TABLETMODE_INTERRUPT
	bool "Interrupt driver used to toggle tablet mode"
	default y
	depends on DT_HAS_CROS_TABLETMODE_INTERRUPT_ENABLED
	depends on PLATFORM_EC_TABLET_MODE
	help
	  Allows the EC to toggle tablet mode based on an external GPIO. This is
	  most commonly used when the ISH is running the motionsense task and
	  is responsible for notifying the EC of tablet mode changes caused by
	  lid angle changes.
```

## zephyr/drivers/dsp_comms/Kconfig
```kconfig
# Copyright 2024 The ChromiumOS Authors
# Use of this source code is governed by a BSD-style license that can be
# found in the LICENSE file.

rsource "Kconfig.service"
rsource "Kconfig.client"

config PLATFORM_EC_DSP_COMMS
	bool
	default y
	depends on PLATFORM_EC_DSP_SERVICE || PLATFORM_EC_DSP_CLIENT

if PLATFORM_EC_DSP_COMMS

module = DSP_COMMS
module-str = DSP_COMMS
source "subsys/logging/Kconfig.template.log_config"

config PLATFORM_EC_DSP_INIT_PRIORITY
	int "Initialization priority for the DSP comms drivers"
	default 80
	help
	  Initialization priority for the DSP comms drivers (service and
	  clients).

config PLATFORM_EC_DSP_REMOTE_CBI
	bool "DSP client implements local CBI read operations"
	default y if !TEST
	depends on PLATFORM_EC_CBI
	help
	  When enabled, functions such as cbi_get_board_info() will be routed
	  to the DSP client instead of their local implementation. The
	  Kconfig is needed to allow tests which implement both the
	  client and the service to function.

config PLATFORM_EC_DSP_REMOTE_LID_SWITCH
	bool "Lid switch GMR is on another MCU"
	default y if !TEST
	depends on !PLATFORM_EC_LID_SWITCH || PLATFORM_EC_DSP_SERVICE
	help
		Use the lid switch logic but the source of truth of the GMR is on another
		MCU.

config PLATFORM_EC_DSP_REMOTE_TABLET_SWITCH
	bool "Tablet switch GMR is on another MCU"
	default y if !TEST
	help
		Use the tablet switch logic but the source of truth of the GMR is on
		another MCU.

config PLATFORM_EC_DSP_REMOTE_LID_ANGLE
	bool "Lid angle based tablet/clamshell mode is done on the DSP core"
	default y if !TEST
	help
	  Handle lid angle based tablet/clamshell mode swaps from the DSP core.

config PLATFORM_EC_DSP_RESPONSE_BUFFER_SIZE
	int "Size of the response buffer"
	default 128
	help
	  When a result is generated from the DSP service, this is the buffer
	  that is used to store it until the client reads it. It must be big
	  enough for the largest encoded response.

config PLATFORM_EC_DSP_REMOTE_BODY_DETECTION
	bool "Body detection is handled on another MCU"
	default y if !TEST
	help
	  Use the body detection hooks, but the source of truth is on another
	  MCU. DSP will broadcast events, while the server will receive them.

endif # PLATFORM_EC_DSP_COMMS
```

## zephyr/drivers/dsp_comms/Kconfig.service
```kconfig
# Copyright 2023 The ChromiumOS Authors
# Use of this source code is governed by a BSD-style license that can be
# found in the LICENSE file.

config PLATFORM_EC_DSP_SERVICE
	bool "Communication driver for EC"
	default y
	depends on DT_HAS_CROS_DSP_SERVICE_ENABLED
	depends on NANOPB
	depends on I2C
	depends on I2C_TARGET
	help
	  Allow proto based communication between the EC and DSP core.

	  If enabled, the core will enable a service which is used to
	  serve the DSP core (this should be done on the EC).
```

## zephyr/drivers/fingerprint/Kconfig.fpc
```kconfig
# Copyright 2024 The ChromiumOS Authors
# Use of this source code is governed by a BSD-style license that can be
# found in the LICENSE file.

menuconfig FINGERPRINT_SENSOR_FPC1025
	bool "Fingerprint driver for FPC1025"
	default y
	depends on DT_HAS_FPC_FPC1025_ENABLED
	help
	  Driver for FPC1025 fingerprint sensor. It requires FPC private library
	  to implement cros_fingerprint API. If the library is not available it
	  only supports checking sensor hardware ID and entering low power mode.

if FINGERPRINT_SENSOR_FPC1025

config FINGERPRINT_SENSOR_FPC1025_HEAP_SIZE
	int "Size of heap for FPC1025 driver"
	default 65536
	help
	  Size of heap to be used by FPC private library. The heap must have
	  enough size to keep finger templates during matching.
	  64KB is enough to match 5 templates at once.

config FINGERPRINT_SENSOR_FPC1025_PAL
	bool "Platform Abstraction Layer for FPC private library"
	default y if HAVE_FPC1025_PRIVATE_DRIVER
	help
	  If enabled, Platform Abstraction Layer for FPC private library will be
	  compiled. The PAL is used to interact with the sensor (SPI, GPIO) and
	  the system (heap allocations, printing messages, time functions).

# Enabled in private driver Kconfig
config HAVE_FPC1025_PRIVATE_DRIVER
	bool
	default n
	help
	  If enabled, it indicates that the private driver is present.

endif # FINGERPRINT_SENSOR_FPC1025

menuconfig FINGERPRINT_SENSOR_FPC1145
	bool "Fingerprint driver for FPC1145"
	default y
	depends on DT_HAS_FPC_FPC1145_ENABLED
	help
	  Driver for FPC1145 fingerprint sensor. It requires FPC private library
	  to implement cros_fingerprint API. If the library is not available it
	  only supports checking sensor hardware ID.

if FINGERPRINT_SENSOR_FPC1145

config FINGERPRINT_SENSOR_FPC1145_PAL
	bool "Platform Abstraction Layer for FPC private library"
	default y if HAVE_FPC1145_PRIVATE_DRIVER
	help
	  If enabled, Platform Abstraction Layer for FPC private library will be
	  compiled. The PAL is used to interact with the sensor (SPI, GPIO) and
	  the system (heap allocations, printing messages, time functions).

# Enabled in private driver Kconfig
config HAVE_FPC1145_PRIVATE_DRIVER
	bool
	default n
	help
	  If enabled, it indicates that the private driver is present.

endif # FINGERPRINT_SENSOR_FPC1145
```

## zephyr/drivers/fingerprint/Kconfig.sensor_sim
```kconfig
# Copyright 2024 The ChromiumOS Authors
# Use of this source code is governed by a BSD-style license that can be
# found in the LICENSE file.

config FINGERPRINT_SENSOR_SIMULATOR
	bool "Fingerprint sensor simulator"
	depends on DT_HAS_CROS_EC_FINGERPRINT_SENSOR_SIM_ENABLED
	default y
	help
	  Fingerprint sensor simulator. This driver is useful for testing code
	  that uses fingerprint sensors.
```

## zephyr/drivers/keyboard_factory_test/Kconfig
```kconfig
# Copyright 2024 The ChromiumOS Authors
# Use of this source code is governed by a BSD-style license that can be
# found in the LICENSE file.

config CROS_EC_KEYBOARD_FACTORY_TEST
	bool "Keyboard factory test command"
	depends on DT_HAS_CROS_EC_KEYBOARD_FACTORY_TEST_ENABLED
	depends on CROS_EC_KEYBOARD_INPUT
	default y
	help
	  Enable the keyboard factory test host command.
```

## zephyr/drivers/one_wire_uart/Kconfig
```kconfig
# Copyright 2023 The ChromiumOS Authors
# Use of this source code is governed by a BSD-style license that can be
# found in the LICENSE file.

config PLATFORM_EC_ONE_WIRE_UART
	bool "One-wire uart driver"
	depends on DT_HAS_CROS_EC_ONE_WIRE_UART_ENABLED
	default y
	help
	  Enable the driver for the communication protocol  over one-wire UART.

config PLATFORM_EC_ONE_WIRE_UART_TABLET
	bool "One-wire uart tablet module"
	depends on PLATFORM_EC_ONE_WIRE_UART
	help
	  Enable the module for tablet device.

	  This module receives input events over one-wire UART from a paired
	  keyboard device, and forwards the events to AP.

config PLATFORM_EC_ONE_WIRE_UART_KEYBOARD
	bool "One-wire uart keyboard module"
	depends on PLATFORM_EC_ONE_WIRE_UART
	help
	  Enable the module for keyboard device.

	  This module processes the input events (e.g. keyboard/touchpad) and
	  send them over one-wire UART to a paired tablet device.
```

## zephyr/drivers/prochot_vcmp/Kconfig
```kconfig
# Copyright 2024 The ChromiumOS Authors
# Use of this source code is governed by a BSD-style license that can be
# found in the LICENSE file.

config PROCHOT_VCMP
	bool "Voltage comparator based PROCHOT support"
	depends on DT_HAS_CROS_EC_PROCHOT_VCMP_ENABLED
	depends on SENSOR
	default y
	help
	  Enable support for logging the PROCHOT pin state changes based on an
	  analog comparator.
```

## zephyr/drivers/runtime_keys/Kconfig
```kconfig
# Copyright 2024 The ChromiumOS Authors
# Use of this source code is governed by a BSD-style license that can be
# found in the LICENSE file.

config CROS_EC_RUNTIME_KEYS
	bool "Runtime keys support"
	depends on DT_HAS_CROS_EC_RUNTIME_KEYS_ENABLED
	depends on INPUT
	default y
	help
	  Enable support for detecting runtime keys combination to make the AP
	  reboot or enter hibernate mode.
```
