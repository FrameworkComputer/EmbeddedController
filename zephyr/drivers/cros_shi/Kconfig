## zephyr/dts/bindings/battery/battery-info.yaml
```yaml
# Copyright 2021 The Chromium OS Authors. All rights reserved.
# Use of this source code is governed by a BSD-style license that can be
# found in the LICENSE file.

description:
   Information about battery
   Voltage is in millivolts
   Current is in milliamperes
   Temperature is in Celsius degrees

compatible: "battery-info"

properties:
   voltage_max:
      description: |
         Maximum voltage that can be applied to the battery.
      type: int
   voltage_normal:
      description: |
         Nominal voltage of the battery.
      type: int
   voltage_min:
      description: |
         Minimum voltage of the battery.
         If current voltage is below this value, system will shutdown.
      type: int
   precharge_voltage:
      description: |
         Voltage used during the precharge phase. Not all chargers
         may take these into account.
      type: int
   precharge_current:
      description: |
         Maximum current used during the precharge phase.
      type: int
   start_charging_min_c:
      description: |
         Minimum temperature of battery to start charging it.
         This value is used only if
         CONFIG_PLATFORM_EC_BATTERY_CHECK_CHARGE_TEMP_LIMITS is enabled.
      type: int
   start_charging_max_c:
      description: |
         Maximum temperature of battery to start charging it.
         This value is used only if
         CONFIG_PLATFORM_EC_BATTERY_CHECK_CHARGE_TEMP_LIMITS is enabled.
      type: int
   charging_min_c:
      description: |
         Minimum temperature of battery during charging it. If the battery
         temperature falls below this value, charging will be stopped.
         This value is used only if
         CONFIG_PLATFORM_EC_BATTERY_CHECK_CHARGE_TEMP_LIMITS is enabled.
      type: int
   charging_max_c:
      description: |
         Maximum temperature of battery during charging it. If the battery
         temperature raises above this value, charging will be stopped.
         This value is used only if
         CONFIG_PLATFORM_EC_BATTERY_CHECK_CHARGE_TEMP_LIMITS is enabled.
      type: int
   discharging_min_c:
      description: |
         Minimum working temperature of battery.
         If temperature is below this value, the system will shutdown.
      type: int
   discharging_max_c:
      description: |
         Maximum working temperature of battery.
         If temperature is above this value, the system will shutdown.
      type: int
```

## zephyr/dts/bindings/battery/bms-gf,cr50.yaml
```yaml
description: "BMS-GF CR50"
compatible: "bms-gf,cr50"

include: battery-smart.yaml

properties:
  enum-name:
    type: string
    default: "bms-gf,cr50"

  # Fuel gauge
  manuf_name:
    default: "BMS-GF"
  device_name:
    default: "CR50"
  ship_mode_reg_addr:
    default: 0x00
  ship_mode_reg_data:
    default: [0x0010, 0x0010]
  flags:
    default: 0
  fet_reg_addr:
    default: 0x43
  fet_reg_mask:
    default: 0x0001
  fet_disconnect_val:
    default: 0x0000
  fet_cfet_mask:
    default: 0x0002
  fet_cfet_off_val:
    default: 0x0000

  # Battery info
  voltage_max:
    default: 17600
  voltage_normal:
    default: 15000
  voltage_min:
    default: 12000
  precharge_current:
    default: 256
  start_charging_min_c:
    default: 0
  start_charging_max_c:
    default: 50
  charging_min_c:
    default: 0
  charging_max_c:
    default: 60
  discharging_min_c:
    default: -20
  discharging_max_c:
    default: 60
```

## zephyr/dts/bindings/battery/byd,l23b2pg5.yaml
```yaml
# Copyright 2024 The ChromiumOS Authors
# Use of this source code is governed by a BSD-style license that can be
# found in the LICENSE file.

description: "BYD L23B2PG5"
compatible: "byd,l23b2pg5"

include: battery-smart.yaml

properties:
  enum-name:
    type: string
    default: "byd,l23b2pg5"

  # Fuel gauge
  manuf_name:
    default: "BYD"
  device_name:
    default: "L23B2PG5"
  ship_mode_reg_addr:
    default: 0x34
  ship_mode_reg_data:
    default: [0x0000, 0x1000]
  flags:
    default: 0x00
  fet_reg_addr:
    default: 0x34
  fet_reg_mask:
    default: 0x0100
  fet_disconnect_val:
    default: 0x0100

  # Battery info
  voltage_max:
    default: 8860
  voltage_normal:
    default: 7700
  voltage_min:
    default: 6000
  precharge_current:
    default: 377
  start_charging_min_c:
    default: 0
  start_charging_max_c:
    default: 50
  charging_min_c:
    default: 0
  charging_max_c:
    default: 60
  discharging_min_c:
    default: -20
  discharging_max_c:
    default: 70
```
