## zephyr/drivers/sm5803/Kconfig.sm5803
```kconfig
# Copyright 2023 The ChromiumOS Authors
# Use of this source code is governed by a BSD-style license that can be
# found in the LICENSE file.

menuconfig PLATFORM_EC_CHARGER_SM5803
	bool "Use the SM5803 charger"
	depends on PLATFORM_EC_I2C
	select PLATFORM_EC_CHARGER_NARROW_VDC
	help
	  Enables the driver for the SM5803.
	  The SM5803 is the Silicon Mitus SM5803 Buck-Boost Charger.

	  This charger is known to be very inefficient when operating in buck-boost
	  mode (when input voltage is close to output voltage), such that permanent
	  damage may be done to the charger. Users should exercise caution around
	  choice of supported configurations: see b:260271871, b:258754576, and
	  b:230712704 for more information.

if PLATFORM_EC_CHARGER_SM5803

config PLATFORM_EC_CHARGER_SM5803_IBAT_PHOT_SEL
	int "IBAT prochot threshold (mA)"
	range 0 37800
	default 37800
	help
	  Set the current threshold in milliamps for IBAT to trigger
	  prochot. Value is rounded to the next lowest multiple of 600
	  mA.

choice
	prompt "prochot minimum duration"
	default PLATFORM_EC_SM5803_PROCHOT_DURATION_1MS
	help
	  Set the minimum duration of prochot assertion.

config PLATFORM_EC_SM5803_PROCHOT_DURATION_100US
	bool "100 us"
	help
	  PHOT_REG1[6:4] = 000.

config PLATFORM_EC_SM5803_PROCHOT_DURATION_500US
	bool "500 us"
	help
	  PHOT_REG1[6:4] = 001.

config PLATFORM_EC_SM5803_PROCHOT_DURATION_1MS
	bool "1 ms"
	help
	  PHOT_REG1[6:4] = 010.

config PLATFORM_EC_SM5803_PROCHOT_DURATION_2MS
	bool "2 ms"
	help
	  PHOT_REG1[6:4] = 100.

config PLATFORM_EC_SM5803_PROCHOT_DURATION_5MS
	bool "5 ms"
	help
	  PHOT_REG1[6:4] = 110.

config PLATFORM_EC_SM5803_PROCHOT_DURATION_10MS
	bool "10 ms"
	help
	  PHOT_REG1[6:4] = 111.

endchoice

config PLATFORM_EC_CHARGER_SM5803_PROCHOT_DURATION
	int
	default 0 if PLATFORM_EC_SM5803_PROCHOT_DURATION_100US
	default 1 if PLATFORM_EC_SM5803_PROCHOT_DURATION_500US
	default 2 if PLATFORM_EC_SM5803_PROCHOT_DURATION_1MS
	default 4 if PLATFORM_EC_SM5803_PROCHOT_DURATION_2MS
	default 6 if PLATFORM_EC_SM5803_PROCHOT_DURATION_5MS
	default 7 if PLATFORM_EC_SM5803_PROCHOT_DURATION_10MS

choice
	prompt "VBUS monitor threshold"
	default PLATFORM_EC_CHARGER_SM5803_VBUS_MON_SEL_3P5V
	help
	  Sets the reference voltage for the VBUS comparator.
	  Set the default to 3.5 is recommended by Silicon Mitus
	  to kept it lower than min VBUS requirement of type C standard.

config PLATFORM_EC_CHARGER_SM5803_VBUS_MON_SEL_3V
	bool "3 V"
	help
	  PHOT_REG2[4:0] = 00000.

config PLATFORM_EC_CHARGER_SM5803_VBUS_MON_SEL_3P25V
	bool "3.25 V"
	help
	  PHOT_REG2[4:0] = 00001.

config PLATFORM_EC_CHARGER_SM5803_VBUS_MON_SEL_3P5V
	bool "3.5 V"
	help
	  PHOT_REG2[4:0] = 00010.

config PLATFORM_EC_CHARGER_SM5803_VBUS_MON_SEL_3P75V
	bool "3.75 V"
	help
	  PHOT_REG2[4:0] = 00011.

config PLATFORM_EC_CHARGER_SM5803_VBUS_MON_SEL_4V
	bool "4 V"
	help
	  PHOT_REG2[4:0] = 00100.

config PLATFORM_EC_CHARGER_SM5803_VBUS_MON_SEL_4P25V
	bool "4.25 V"
	help
	  PHOT_REG2[4:0] = 00101.

config PLATFORM_EC_CHARGER_SM5803_VBUS_MON_SEL_4P5V
	bool "4.5 V"
	help
	  PHOT_REG2[4:0] = 00110.

config PLATFORM_EC_CHARGER_SM5803_VBUS_MON_SEL_4P75V
	bool "4.75 V"
	help
	  PHOT_REG2[4:0] = 00111.

config PLATFORM_EC_CHARGER_SM5803_VBUS_MON_SEL_5V
	bool "5 V"
	help
	  PHOT_REG2[4:0] = 01000.

config PLATFORM_EC_CHARGER_SM5803_VBUS_MON_SEL_5P5V
	bool "5.5 V"
	help
	  PHOT_REG2[4:0] = 01001.

config PLATFORM_EC_CHARGER_SM5803_VBUS_MON_SEL_6V
	bool "6 V"
	help
	  PHOT_REG2[4:0] = 01010.

config PLATFORM_EC_CHARGER_SM5803_VBUS_MON_SEL_6P5V
	bool "6.5 V"
	help
	  PHOT_REG2[4:0] = 01011.

config PLATFORM_EC_CHARGER_SM5803_VBUS_MON_SEL_7V
	bool "7 V"
	help
	  PHOT_REG2[4:0] = 01100.

config PLATFORM_EC_CHARGER_SM5803_VBUS_MON_SEL_7P5V
	bool "7.5 V"
	help
	  PHOT_REG2[4:0] = 01101.

config PLATFORM_EC_CHARGER_SM5803_VBUS_MON_SEL_8V
	bool "8 V"
	help
	  PHOT_REG2[4:0] = 01110.

config PLATFORM_EC_CHARGER_SM5803_VBUS_MON_SEL_8P5V
	bool "8.5 V"
	help
	  PHOT_REG2[4:0] = 01111.

config PLATFORM_EC_CHARGER_SM5803_VBUS_MON_SEL_9V
	bool "9 V"
	help
	  PHOT_REG2[4:0] = 10000.

config PLATFORM_EC_CHARGER_SM5803_VBUS_MON_SEL_9P5V
	bool "9.5 V"
	help
	  PHOT_REG2[4:0] = 10001.

config PLATFORM_EC_CHARGER_SM5803_VBUS_MON_SEL_10V
	bool "10 V"
	help
	  PHOT_REG2[4:0] = 10010.

config PLATFORM_EC_CHARGER_SM5803_VBUS_MON_SEL_10P5V
	bool "10.5 V"
	help
	  PHOT_REG2[4:0] = 10011.

config PLATFORM_EC_CHARGER_SM5803_VBUS_MON_SEL_11V
	bool "11 V"
	help
	  PHOT_REG2[4:0] = 10100.

config PLATFORM_EC_CHARGER_SM5803_VBUS_MON_SEL_11P5V
	bool "11.5 V"
	help
	  PHOT_REG2[4:0] = 10101.

config PLATFORM_EC_CHARGER_SM5803_VBUS_MON_SEL_12V
	bool "12 V"
	help
	  PHOT_REG2[4:0] = 10110.

config PLATFORM_EC_CHARGER_SM5803_VBUS_MON_SEL_12P5V
	bool "12.5 V"
	help
	  PHOT_REG2[4:0] = 10111.

config PLATFORM_EC_CHARGER_SM5803_VBUS_MON_SEL_13V
	bool "13 V"
	help
	  PHOT_REG2[4:0] = 11000.

config PLATFORM_EC_CHARGER_SM5803_VBUS_MON_SEL_13P5V
	bool "13.5 V"
	help
	  PHOT_REG2[4:0] = 11001.

config PLATFORM_EC_CHARGER_SM5803_VBUS_MON_SEL_14V
	bool "14 V"
	help
	  PHOT_REG2[4:0] = 11010.

config PLATFORM_EC_CHARGER_SM5803_VBUS_MON_SEL_15V
	bool "15 V"
	help
	  PHOT_REG2[4:0] = 11011.

config PLATFORM_EC_CHARGER_SM5803_VBUS_MON_SEL_16V
	bool "16 V"
	help
	  PHOT_REG2[4:0] = 11100.

config PLATFORM_EC_CHARGER_SM5803_VBUS_MON_SEL_17V
	bool "17 V"
	help
	  PHOT_REG2[4:0] = 11101.

config PLATFORM_EC_CHARGER_SM5803_VBUS_MON_SEL_18V
	bool "18 V"
	help
	  PHOT_REG2[4:0] = 11110.

config PLATFORM_EC_CHARGER_SM5803_VBUS_MON_SEL_19V
	bool "19 V"
	help
	  PHOT_REG2[4:0] = 11111.

endchoice

config PLATFORM_EC_CHARGER_SM5803_VBUS_MON_SEL
	int
	default 0 if PLATFORM_EC_CHARGER_SM5803_VBUS_MON_SEL_3V
	default 1 if PLATFORM_EC_CHARGER_SM5803_VBUS_MON_SEL_3P25V
	default 2 if PLATFORM_EC_CHARGER_SM5803_VBUS_MON_SEL_3P5V
	default 3 if PLATFORM_EC_CHARGER_SM5803_VBUS_MON_SEL_3P75V
	default 4 if PLATFORM_EC_CHARGER_SM5803_VBUS_MON_SEL_4V
	default 5 if PLATFORM_EC_CHARGER_SM5803_VBUS_MON_SEL_4P25V
	default 6 if PLATFORM_EC_CHARGER_SM5803_VBUS_MON_SEL_4P5V
	default 7 if PLATFORM_EC_CHARGER_SM5803_VBUS_MON_SEL_4P75V
	default 8 if PLATFORM_EC_CHARGER_SM5803_VBUS_MON_SEL_5V
	default 9 if PLATFORM_EC_CHARGER_SM5803_VBUS_MON_SEL_5P5V
	default 10 if PLATFORM_EC_CHARGER_SM5803_VBUS_MON_SEL_6V
	default 11 if PLATFORM_EC_CHARGER_SM5803_VBUS_MON_SEL_6P5V
	default 12 if PLATFORM_EC_CHARGER_SM5803_VBUS_MON_SEL_7V
	default 13 if PLATFORM_EC_CHARGER_SM5803_VBUS_MON_SEL_7P5V
	default 14 if PLATFORM_EC_CHARGER_SM5803_VBUS_MON_SEL_8V
	default 15 if PLATFORM_EC_CHARGER_SM5803_VBUS_MON_SEL_8P5V
	default 16 if PLATFORM_EC_CHARGER_SM5803_VBUS_MON_SEL_9V
	default 17 if PLATFORM_EC_CHARGER_SM5803_VBUS_MON_SEL_9P5V
	default 18 if PLATFORM_EC_CHARGER_SM5803_VBUS_MON_SEL_10V
	default 19 if PLATFORM_EC_CHARGER_SM5803_VBUS_MON_SEL_10P5V
	default 20 if PLATFORM_EC_CHARGER_SM5803_VBUS_MON_SEL_11V
	default 21 if PLATFORM_EC_CHARGER_SM5803_VBUS_MON_SEL_11P5V
	default 22 if PLATFORM_EC_CHARGER_SM5803_VBUS_MON_SEL_12V
	default 23 if PLATFORM_EC_CHARGER_SM5803_VBUS_MON_SEL_12P5V
	default 24 if PLATFORM_EC_CHARGER_SM5803_VBUS_MON_SEL_13V
	default 25 if PLATFORM_EC_CHARGER_SM5803_VBUS_MON_SEL_13P5V
	default 26 if PLATFORM_EC_CHARGER_SM5803_VBUS_MON_SEL_14V
	default 27 if PLATFORM_EC_CHARGER_SM5803_VBUS_MON_SEL_15V
	default 28 if PLATFORM_EC_CHARGER_SM5803_VBUS_MON_SEL_16V
	default 29 if PLATFORM_EC_CHARGER_SM5803_VBUS_MON_SEL_17V
	default 30 if PLATFORM_EC_CHARGER_SM5803_VBUS_MON_SEL_18V
	default 31 if PLATFORM_EC_CHARGER_SM5803_VBUS_MON_SEL_19V

choice
	prompt "VSYS monitor threshold"
	default PLATFORM_EC_CHARGER_SM5803_VSYS_MON_SEL_6V
	help
	  Sets the reference voltage for the VSYS comparator.

config PLATFORM_EC_CHARGER_SM5803_VSYS_MON_SEL_3V
	bool "3 V"
	help
	  PHOT_REG3[4:0] = 00000.

config PLATFORM_EC_CHARGER_SM5803_VSYS_MON_SEL_3P25V
	bool "3.25 V"
	help
	  PHOT_REG3[4:0] = 00001.

config PLATFORM_EC_CHARGER_SM5803_VSYS_MON_SEL_3P5V
	bool "3.5 V"
	help
	  PHOT_REG3[4:0] = 00010.

config PLATFORM_EC_CHARGER_SM5803_VSYS_MON_SEL_3P75V
	bool "3.75 V"
	help
	  PHOT_REG3[4:0] = 00011.

config PLATFORM_EC_CHARGER_SM5803_VSYS_MON_SEL_4V
	bool "4 V"
	help
	  PHOT_REG3[4:0] = 00100.

config PLATFORM_EC_CHARGER_SM5803_VSYS_MON_SEL_4P25V
	bool "4.25 V"
	help
	  PHOT_REG3[4:0] = 00101.

config PLATFORM_EC_CHARGER_SM5803_VSYS_MON_SEL_4P5V
	bool "4.5 V"
	help
	  PHOT_REG3[4:0] = 00110.

config PLATFORM_EC_CHARGER_SM5803_VSYS_MON_SEL_4P75V
	bool "4.75 V"
	help
	  PHOT_REG3[4:0] = 00111.

config PLATFORM_EC_CHARGER_SM5803_VSYS_MON_SEL_5V
	bool "5 V"
	help
	  PHOT_REG3[4:0] = 01000.

config PLATFORM_EC_CHARGER_SM5803_VSYS_MON_SEL_5P5V
	bool "5.5 V"
	help
	  PHOT_REG3[4:0] = 01001.

config PLATFORM_EC_CHARGER_SM5803_VSYS_MON_SEL_6V
	bool "6 V"
	help
	  PHOT_REG3[4:0] = 01010.

config PLATFORM_EC_CHARGER_SM5803_VSYS_MON_SEL_6P5V
	bool "6.5 V"
	help
	  PHOT_REG3[4:0] = 01011.

config PLATFORM_EC_CHARGER_SM5803_VSYS_MON_SEL_7V
	bool "7 V"
	help
	  PHOT_REG3[4:0] = 01100.

config PLATFORM_EC_CHARGER_SM5803_VSYS_MON_SEL_7P5V
	bool "7.5 V"
	help
	  PHOT_REG3[4:0] = 01101.

config PLATFORM_EC_CHARGER_SM5803_VSYS_MON_SEL_8V
	bool "8 V"
	help
	  PHOT_REG3[4:0] = 01110.

config PLATFORM_EC_CHARGER_SM5803_VSYS_MON_SEL_8P5V
	bool "8.5 V"
	help
	  PHOT_REG3[4:0] = 01111.

config PLATFORM_EC_CHARGER_SM5803_VSYS_MON_SEL_9V
	bool "9 V"
	help
	  PHOT_REG3[4:0] = 10000.

config PLATFORM_EC_CHARGER_SM5803_VSYS_MON_SEL_9P5V
	bool "9.5 V"
	help
	  PHOT_REG3[4:0] = 10001.

config PLATFORM_EC_CHARGER_SM5803_VSYS_MON_SEL_10V
	bool "10 V"
	help
	  PHOT_REG3[4:0] = 10010.

config PLATFORM_EC_CHARGER_SM5803_VSYS_MON_SEL_10P5V
	bool "10.5 V"
	help
	  PHOT_REG3[4:0] = 10011.

config PLATFORM_EC_CHARGER_SM5803_VSYS_MON_SEL_11V
	bool "11 V"
	help
	  PHOT_REG3[4:0] = 10100.

config PLATFORM_EC_CHARGER_SM5803_VSYS_MON_SEL_11P5V
	bool "11.5 V"
	help
	  PHOT_REG3[4:0] = 10101.

config PLATFORM_EC_CHARGER_SM5803_VSYS_MON_SEL_12V
	bool "12 V"
	help
	  PHOT_REG3[4:0] = 10110.

config PLATFORM_EC_CHARGER_SM5803_VSYS_MON_SEL_12P5V
	bool "12.5 V"
	help
	  PHOT_REG3[4:0] = 10111.

config PLATFORM_EC_CHARGER_SM5803_VSYS_MON_SEL_13V
	bool "13 V"
	help
	  PHOT_REG3[4:0] = 11000.

config PLATFORM_EC_CHARGER_SM5803_VSYS_MON_SEL_13P5V
	bool "13.5 V"
	help
	  PHOT_REG3[4:0] = 11001.

config PLATFORM_EC_CHARGER_SM5803_VSYS_MON_SEL_14V
	bool "14 V"
	help
	  PHOT_REG3[4:0] = 11010.

config PLATFORM_EC_CHARGER_SM5803_VSYS_MON_SEL_15V
	bool "15 V"
	help
	  PHOT_REG3[4:0] = 11011.

config PLATFORM_EC_CHARGER_SM5803_VSYS_MON_SEL_16V
	bool "16 V"
	help
	  PHOT_REG3[4:0] = 11100.

config PLATFORM_EC_CHARGER_SM5803_VSYS_MON_SEL_17V
	bool "17 V"
	help
	  PHOT_REG3[4:0] = 11101.

config PLATFORM_EC_CHARGER_SM5803_VSYS_MON_SEL_18V
	bool "18 V"
	help
	  PHOT_REG3[4:0] = 11110.

config PLATFORM_EC_CHARGER_SM5803_VSYS_MON_SEL_19V
	bool "19 V"
	help
	  PHOT_REG3[4:0] = 11111.

endchoice

config PLATFORM_EC_CHARGER_SM5803_VSYS_MON_SEL
	int
	default 0 if PLATFORM_EC_CHARGER_SM5803_VSYS_MON_SEL_3V
	default 1 if PLATFORM_EC_CHARGER_SM5803_VSYS_MON_SEL_3P25V
	default 2 if PLATFORM_EC_CHARGER_SM5803_VSYS_MON_SEL_3P5V
	default 3 if PLATFORM_EC_CHARGER_SM5803_VSYS_MON_SEL_3P75V
	default 4 if PLATFORM_EC_CHARGER_SM5803_VSYS_MON_SEL_4V
	default 5 if PLATFORM_EC_CHARGER_SM5803_VSYS_MON_SEL_4P25V
	default 6 if PLATFORM_EC_CHARGER_SM5803_VSYS_MON_SEL_4P5V
	default 7 if PLATFORM_EC_CHARGER_SM5803_VSYS_MON_SEL_4P75V
	default 8 if PLATFORM_EC_CHARGER_SM5803_VSYS_MON_SEL_5V
	default 9 if PLATFORM_EC_CHARGER_SM5803_VSYS_MON_SEL_5P5V
	default 10 if PLATFORM_EC_CHARGER_SM5803_VSYS_MON_SEL_6V
	default 11 if PLATFORM_EC_CHARGER_SM5803_VSYS_MON_SEL_6P5V
	default 12 if PLATFORM_EC_CHARGER_SM5803_VSYS_MON_SEL_7V
	default 13 if PLATFORM_EC_CHARGER_SM5803_VSYS_MON_SEL_7P5V
	default 14 if PLATFORM_EC_CHARGER_SM5803_VSYS_MON_SEL_8V
	default 15 if PLATFORM_EC_CHARGER_SM5803_VSYS_MON_SEL_8P5V
	default 16 if PLATFORM_EC_CHARGER_SM5803_VSYS_MON_SEL_9V
	default 17 if PLATFORM_EC_CHARGER_SM5803_VSYS_MON_SEL_9P5V
	default 18 if PLATFORM_EC_CHARGER_SM5803_VSYS_MON_SEL_10V
	default 19 if PLATFORM_EC_CHARGER_SM5803_VSYS_MON_SEL_10P5V
	default 20 if PLATFORM_EC_CHARGER_SM5803_VSYS_MON_SEL_11V
	default 21 if PLATFORM_EC_CHARGER_SM5803_VSYS_MON_SEL_11P5V
	default 22 if PLATFORM_EC_CHARGER_SM5803_VSYS_MON_SEL_12V
	default 23 if PLATFORM_EC_CHARGER_SM5803_VSYS_MON_SEL_12P5V
	default 24 if PLATFORM_EC_CHARGER_SM5803_VSYS_MON_SEL_13V
	default 25 if PLATFORM_EC_CHARGER_SM5803_VSYS_MON_SEL_13P5V
	default 26 if PLATFORM_EC_CHARGER_SM5803_VSYS_MON_SEL_14V
	default 27 if PLATFORM_EC_CHARGER_SM5803_VSYS_MON_SEL_15V
	default 28 if PLATFORM_EC_CHARGER_SM5803_VSYS_MON_SEL_16V
	default 29 if PLATFORM_EC_CHARGER_SM5803_VSYS_MON_SEL_17V
	default 30 if PLATFORM_EC_CHARGER_SM5803_VSYS_MON_SEL_18V
	default 31 if PLATFORM_EC_CHARGER_SM5803_VSYS_MON_SEL_19V

endif
```

## zephyr/drivers/usbc/Kconfig
```kconfig
# Copyright 2023 The ChromiumOS Authors
# Use of this source code is governed by a BSD-style license that can be
# found in the LICENSE file.

if PLATFORM_EC_USBC

module = USBC
module-str = usbc
source "subsys/logging/Kconfig.template.log_config"

config USBC_INTEL_ALTMODE
	bool "USB-C Intel alternate mode configuration driver"
	default y if DT_HAS_INTEL_PD_ALTMODE_ENABLED
	help
	  This option enables a driver for communicating between the USB PD
	  chip and EC for configuring the USB-C alternate mode muxes inside
	  Intel AP.

config USBC_PDC_CCG8
	bool "Infineon CCG8 Power Delivery Controller driver"
	default y if DT_HAS_INFINEON_CCG8_ENABLED
	help
	  This option enable the Infineon CCG8 Power Delivery Controller. This
	  chip family supports both single port and multiple port
	  configurations. For multiple port configurations, each port must
	  create a separate devicetree entry.

config CONSOLE_CMD_PDC_CCG8
	bool "Console command: CCG8 read/write"
	default y if USBC_PDC_CCG8
	help
	  Enable console command to read/write to the power path registers of
	  CCG8 Power Delivery chip.

config USBC_PDC_TPS6699X
	bool "TI TPS6699X Power Deleivery Controller driver"
	default y if DT_HAS_TI_TPS6699_PDC_ENABLED
	select SMF
	select SMF_ANCESTOR_SUPPORT
	help
	  This option enables the TI TPS6699X Power Delivery Controller.

config USBC_PDC_TPS6699X_STACK_SIZE
	int "USB-C TI TPS6699X PDC thread stack size"
	default 1024
	depends on USBC_PDC_TPS6699X
	help
	  Stack size of thread created for each instance.

config USBC_PDC_TPS6699X_THREAD_PRIORITY
	int "USB-C TI TPS6699x PDC thread priority"
	default 0
	depends on USBC_PDC_TPS6699X
	help
	  Set thread priority of the USB-C PDC

config USBC_PDC_TPS6699X_FW_UPDATER
	bool "USB-C TI TPS6699x PDC FW update support"
	depends on USBC_PDC_TPS6699X
	help
	  If enabled, bundle a TI FW binary blob into the EC image and add code
	  to perform an EC-based firmware update of the PDC for development
	  purposes. Enables the `pdc fwupdate` console command.

config USBC_PDC_RTS54XX
	bool "Realtek RTS545x Power Delivery Controller driver"
	default y if DT_HAS_REALTEK_RTS54_PDC_ENABLED
	select SMF
	select SMF_ANCESTOR_SUPPORT
	help
	  This option enables the Realtek RTS545x Power Delivery Controller.

config USBC_PDC_RTS54XX_STACK_SIZE
        int "USB-C Realtek RTS545x PDC thread stack size"
        default 1024
	depends on USBC_PDC_RTS54XX
        help
          Stack size of thread created for each instance.

config USBC_PDC_RTS54XX_THREAD_PRIORITY
        int "USB-C Realtek RTS545x PDC thread priority"
        default 0
	depends on USBC_PDC_RTS54XX
        help
          Set thread priority of the USB-C PDC

config USBC_PDC_TRACE_MSG
	bool "USB-C PDC message tracing"
	depends on USBC_PDC_RTS54XX
	help
	  Enable communication tracing between the EC and the PDC.
	  Messages between the EC and PDC are saved in a pre-allocated
	  FIFO so they can be retrieved by EC host and console commands.

rsource "Kconfig.pdc_trace"

endif # PLATFORM_EC_USBC
```
