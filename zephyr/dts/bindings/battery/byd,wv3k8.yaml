## zephyr/dts/bindings/battery/dynapack,coslight_po02037xl.yaml
```yaml
# Copyright 2022 The ChromiumOS Authors
# Use of this source code is governed by a BSD-style license that can be
# found in the LICENSE file.

description: "DYNAPACK COSLIGHT_PO02037XL"
compatible: "dynapack,coslight_po02037xl"

include: battery-smart.yaml

properties:
  enum-name:
    type: string
    default: "dynapack,coslight_po02037xl"

  # Fuel gauge
  manuf_name:
    default: "333-2C-14-A"
  device_name:
    default: "PO02037XL"
  ship_mode_reg_addr:
    default: 0x00
  ship_mode_reg_data:
    default: [0x0010, 0x0010]
  flags:
    default: 0x04
  fet_reg_addr:
    default: 0x0
  fet_reg_mask:
    default: 0x0006
  fet_disconnect_val:
    default: 0x0
  fet_cfet_mask:
    default: 0x0004
  fet_cfet_off_val:
    default: 0x0

  # Battery info
  voltage_max:
    default: 8700
  voltage_normal:
    default: 7600
  voltage_min:
    default: 6000
  precharge_current:
    default: 256
  start_charging_min_c:
    default: 0
  start_charging_max_c:
    default: 45
  charging_min_c:
    default: 0
  charging_max_c:
    default: 45
  discharging_min_c:
    default: -10
  discharging_max_c:
    default: 60
```

## zephyr/dts/bindings/battery/ganfeng,sg20.yaml
```yaml
description: "Ganfeng SG20"
compatible: "ganfeng,sg20"

include: battery-smart.yaml

properties:
  enum-name:
    type: string
    default: "ganfeng,sg20"

  # Fuel gauge
  manuf_name:
    default: "Ganfeng"
  device_name:
    default: "SG20"
  ship_mode_reg_addr:
    default: 0x00
  ship_mode_reg_data:
    default: [0x0010, 0x0010]
  flags:
    default: 0
  fet_reg_addr:
    default: 0x43
  fet_reg_mask:
    default: 0x0001
  fet_disconnect_val:
    default: 0x0000
  fet_cfet_mask:
    default: 0x0002
  fet_cfet_off_val:
    default: 0x0000

  # Battery info
  voltage_max:
    default: 8700
  voltage_normal:
    default: 7600
  voltage_min:
    default: 6000
  precharge_current:
    default: 256
  start_charging_min_c:
    default: 0
  start_charging_max_c:
    default: 50
  charging_min_c:
    default: 0
  charging_max_c:
    default: 60
  discharging_min_c:
    default: -20
  discharging_max_c:
    default: 60
```

## zephyr/dts/bindings/battery/getac,bq40z50-R3-S3.yaml
```yaml
# Copyright 2022 The ChromiumOS Authors
# Use of this source code is governed by a BSD-style license that can be
# found in the LICENSE file.

description: "Getac BQ40Z50-R3 3 Cell battery"
compatible: "getac,bq40z50-R3-S3"

include: battery-smart.yaml

properties:
  enum-name:
    type: string
    default: "getac,bq40z50-R3-S3"

  # Fuel gauge
  manuf_name:
    default: "Getac"
  device_name:
    default: "BQ40Z50-R3"
  ship_mode_reg_addr:
    default: 0x00
  ship_mode_reg_data:
    default: [0x0010, 0x0010]
  flags:
    default: 0
  fet_reg_addr:
    default: 0x00
  fet_reg_mask:
    default: 0x6000
  fet_disconnect_val:
    default: 0x6000

  # Battery info
  voltage_max:
    default: 13050
  voltage_normal:
    default: 11400
  voltage_min:
    default: 9000
  precharge_current:
    default: 256
  start_charging_min_c:
    default: 0
  start_charging_max_c:
    default: 45
  charging_min_c:
    default: 0
  charging_max_c:
    default: 45
  discharging_min_c:
    default: 0
  discharging_max_c:
    default: 60
```

## zephyr/dts/bindings/battery/gfl,mfp-466894.yaml
```yaml
description: "Gfl MFP-466894"
compatible: "gfl,mfp-466894"

include: battery-smart.yaml

properties:
  enum-name:
    type: string
    default: "gfl,mfp-466894"

  # Fuel gauge
  manuf_name:
    default: "GFL"
  device_name:
    default: "MFP-466894"
  ship_mode_reg_addr:
    default: 0x00
  ship_mode_reg_data:
    default: [0x0010, 0x0010]
  flags:
    default: 0x04
  fet_reg_addr:
    default: 0x54
  fet_reg_mask:
    default: 0x0006
  fet_disconnect_val:
    default: 0x0000
  fet_cfet_mask:
    default: 0x4000
  fet_cfet_off_val:
    default: 0x4000

  # Battery info 41w
  voltage_max:
    default: 8800
  voltage_normal:
    default: 7700
  voltage_min:
    default: 6000
  precharge_current:
    default: 100
  start_charging_min_c:
    default: 0
  start_charging_max_c:
    default: 50
  charging_min_c:
    default: 0
  charging_max_c:
    default: 60
  discharging_min_c:
    default: -20
  discharging_max_c:
    default: 60
```

## zephyr/dts/bindings/battery/gfl,mfp-549358.yaml
```yaml
description: "Gfl MFP-549358"
compatible: "gfl,mfp-549358"

include: battery-smart.yaml

properties:
  enum-name:
    type: string
    default: "gfl,mfp-549358"

  # Fuel gauge
  manuf_name:
    default: "GFL"
  device_name:
    default: "MFP-549358"
  ship_mode_reg_addr:
    default: 0x00
  ship_mode_reg_data:
    default: [0x0010, 0x0010]
  flags:
    default: 0x04
  fet_reg_addr:
    default: 0x54
  fet_reg_mask:
    default: 0x0006
  fet_disconnect_val:
    default: 0x0000
  fet_cfet_mask:
    default: 0x4000
  fet_cfet_off_val:
    default: 0x4000

  # Battery info
  voltage_max:
    default: 13200
  voltage_normal:
    default: 11550
  voltage_min:
    default: 9000
  precharge_current:
    default: 100
  start_charging_min_c:
    default: 0
  start_charging_max_c:
    default: 50
  charging_min_c:
    default: 0
  charging_max_c:
    default: 60
  discharging_min_c:
    default: -20
  discharging_max_c:
    default: 60
```

## zephyr/dts/bindings/battery/gfl,nb0280-549358.yaml
```yaml
description: "Gfl NB0280-549358"
compatible: "gfl,nb0280-549358"

include: battery-smart.yaml

properties:
  enum-name:
    type: string
    default: "gfl,nb0280-549358"

  # Fuel gauge
  manuf_name:
    default: "GFL"
  device_name:
    default: "NB0280-549358"
  ship_mode_reg_addr:
    default: 0x00
  ship_mode_reg_data:
    default: [0x0010, 0x0010]
  fet_mfgacc_support:
    default: 0
  fet_reg_addr:
    default: 0x43
  fet_reg_mask:
    default: 0x0001
  fet_disconnect_val:
    default: 0x0000
  fet_cfet_mask:
    default: 0x0002
  fet_cfet_off_val:
    default: 0x0000

  # Battery info
  voltage_max:
    default: 13200
  voltage_normal:
    default: 11550
  voltage_min:
    default: 9000
  precharge_current:
    default: 100
  start_charging_min_c:
    default: 0
  start_charging_max_c:
    default: 50
  charging_min_c:
    default: 0
  charging_max_c:
    default: 60
  discharging_min_c:
    default: -20
  discharging_max_c:
    default: 60
```

## zephyr/dts/bindings/battery/gfl,nb0299-485489.yaml
```yaml
description: "GFL,NB0299-485489"
compatible: "gfl,nb0299-485489"

include: battery-smart.yaml

properties:
  enum-name:
    type: string
    default: "gfl,nb0299-485489"

  # Fuel gauge
  manuf_name:
    default: "GFL"
  device_name:
    default: "NB0299-485489"
  ship_mode_reg_addr:
    default: 0x00
  ship_mode_reg_data:
    default: [0x0010, 0x0010]
  flags:
    default: 0x04
  fet_reg_addr:
    default: 0x54
  fet_reg_mask:
    default: 0x0006
  fet_disconnect_val:
    default: 0x0000

  # Battery info
  voltage_max:
    default: 13200
  voltage_normal:
    default: 11550
  voltage_min:
    default: 9000
  precharge_current:
    default: 206
  start_charging_min_c:
    default: 0
  start_charging_max_c:
    default: 45
  charging_min_c:
    default: 0
  charging_max_c:
    default: 60
  discharging_min_c:
    default: -20
  discharging_max_c:
    default: 60
```

## zephyr/dts/bindings/battery/gfl,nb0346-427689.yaml
```yaml
description: "Gfl NB0346-427689"
compatible: "gfl,nb0346-427689"

include: battery-smart.yaml

properties:
  enum-name:
    type: string
    default: "gfl,nb0346-427689"

  # Fuel gauge
  manuf_name:
    default: "GFL"
  device_name:
    default: "NB0346-427689"
  ship_mode_reg_addr:
    default: 0x00
  ship_mode_reg_data:
    default: [0x0010, 0x0010]
  flags:
    default: 0x04
  fet_reg_addr:
    default: 0x54
  fet_reg_mask:
    default: 0x0006
  fet_disconnect_val:
    default: 0x0000
  fet_cfet_mask:
    default: 0x4000
  fet_cfet_off_val:
    default: 0x4000

  # Battery info
  voltage_max:
    default: 8800
  voltage_normal:
    default: 7700
  voltage_min:
    default: 6000
  precharge_current:
    default: 256
  start_charging_min_c:
    default: 4
  start_charging_max_c:
    default: 45
  charging_min_c:
    default: 4
  charging_max_c:
    default: 56
  discharging_min_c:
    default: -20
  discharging_max_c:
    default: 60
```

## zephyr/dts/bindings/battery/lgc,8ghcx.yaml
```yaml
# Copyright 2023 The ChromiumOS Authors
# Use of this source code is governed by a BSD-style license that can be
# found in the LICENSE file.

description: "LGC-LGC3.685 DELL 8GHCX"
compatible: "lgc,8ghcx"

include: battery-smart.yaml

properties:
  enum-name:
    type: string
    default: "lgc,8ghcx"

  manuf_name:
    default: "LGC-LGC3.65"
  device_name:
    default: "DELL 8GHCX"
  ship_mode_reg_addr:
    default: 0x44
  ship_mode_reg_data:
    default: [0x0010, 0x0010]
  flags:
    default: 0x0d
  fet_reg_addr:
    default: 0x0054
  fet_reg_mask:
    default: 0x0006
  fet_disconnect_val:
    default: 0x0000
  fet_cfet_mask:
    default: 0x0004
  fet_cfet_off_val:
    default: 0x0000

  # Battery info
  voltage_max:
    default: 13200
  voltage_normal:
    default: 11460
  voltage_min:
    default: 9000
  precharge_current:
    default: 256
  start_charging_min_c:
    default: -3
  start_charging_max_c:
    default: 50
  charging_min_c:
    default: -3
  charging_max_c:
    default: 60
  discharging_min_c:
    default: -5
  discharging_max_c:
    default: 70
```

## zephyr/dts/bindings/battery/lgc,ac17a8m.yaml
```yaml
# Copyright 2022 The ChromiumOS Authors
# Use of this source code is governed by a BSD-style license that can be
# found in the LICENSE file.

description: "LGC AC17A8M"
compatible: "lgc,ac17a8m"

include: battery-smart.yaml

properties:
  enum-name:
    type: string
    default: "lgc,ac17a8m"

  # TI BQ40Z55 Fuel Gauge
  manuf_name:
    default: "LGC"
  device_name:
    default: "AC17A8M"
  ship_mode_reg_addr:
    default: 0x00
  ship_mode_reg_data:
    default: [0x0010, 0x0010]
  flags:
    default: 0
  fet_reg_addr:
    default: 0x00
  fet_reg_mask:
    default: 0x2000
  fet_disconnect_val:
    default: 0x2000
  fet_cfet_mask:
    default: 0x4000
  fet_cfet_off_val:
    default: 0x4000

  # Battery info
  # voltage_max =13200, Calculated value with 5 tenth % error margin
  # considered is: ((13200 * 1000) / (1000 + 5)) = 13134
  voltage_max:
    default: 13134
  voltage_normal:
    default: 11550
  voltage_min:
    default: 9000
  precharge_current:
    default: 256
  start_charging_min_c:
    default: 0
  start_charging_max_c:
    default: 45
  charging_min_c:
    default: 0
  charging_max_c:
    default: 60
  discharging_min_c:
    default: 0
  discharging_max_c:
    default: 75
```

## zephyr/dts/bindings/battery/lgc,ap16l8j.yaml
```yaml
description: "LGC KT0020G010 AP16L8J"
compatible: "lgc,ap16l8j"

include: battery-smart.yaml

properties:
  enum-name:
    type: string
    default: "lgc,ap16l8j"

  # Fuel gauge
  manuf_name:
    default: "LGC KT0020G010"
  device_name:
    default: "AP16L8J"
  ship_mode_reg_addr:
    default: 0x3A
  ship_mode_reg_data:
    default: [0xC574, 0xC574]
  # Documentation: b/148625782
  # ManufacturerAccess() 0x0054 OperationStatus
  # CHG (Bit 2): CHG FET status (1 = Active 0 = Inactive)
  # DSG (Bit 1): DSG FET status (1 = Active 0 = Inactive)
  flags:
    default: 0x04
  fet_reg_mask:
    default: 0x0002
  fet_disconnect_val:
    default: 0x0000
  fet_cfet_mask:
    default: 0x0004
  fet_cfet_off_val:
    default: 0x0000

  # Battery info
  voltage_max:
    default: 8700
  voltage_normal:
    default: 7500
  voltage_min:
    default: 6000
  precharge_current:
    default: 256
  start_charging_min_c:
    default: 0
  start_charging_max_c:
    default: 50
  charging_min_c:
    default: 0
  charging_max_c:
    default: 60
  discharging_min_c:
    default: -20
  discharging_max_c:
    default: 75
```
