## zephyr/dts/bindings/battery/byd,wv3k8.yaml
```yaml
description: "BYD DELL WV3K8"
compatible: "byd,wv3k8"

include: battery-smart.yaml

properties:
  enum-name:
    type: string
    default: "byd,wv3k8"

  # Fuel gauge
  manuf_name:
    default: "BYD"
  device_name:
    default: "DELL WV3K8"
  ship_mode_reg_addr:
    default: 0x00
  ship_mode_reg_data:
    default: [0x0010, 0x0010]
  flags:
    default: 0x0c
  fet_reg_addr:
    default: 0x54
  fet_reg_mask:
    default: 0x0002
  fet_disconnect_val:
    default: 0x0000
  fet_cfet_mask:
    default: 0x0004
  fet_cfet_off_val:
    default: 0x0000

  # Battery info
  voltage_max:
    default: 17400
  voltage_normal:
    default: 15000
  voltage_min:
    default: 12000
  precharge_current:
    default: 256
  start_charging_min_c:
    default: -3
  start_charging_max_c:
    default: 45
  charging_min_c:
    default: -3
  charging_max_c:
    default: 50
  discharging_min_c:
    default: -5
  discharging_max_c:
    default: 70
```

## zephyr/dts/bindings/battery/byd,yt39x.yaml
```yaml
# Copyright 2023 The ChromiumOS Authors
# Use of this source code is governed by a BSD-style license that can be
# found in the LICENSE file.

description: "BYD YT39X"
compatible: "byd,yt39x"

include: battery-smart.yaml

properties:
  enum-name:
    type: string
    default: "byd,yt39x"

  # Fuel gauge
  manuf_name:
    default: "BYD"
  device_name:
    default: "DELL YT39X"
  ship_mode_reg_addr:
    default: 0x44
  ship_mode_reg_data:
    default: [0x0010, 0x0010]
  flags:
    default: 0x0d
  fet_reg_addr:
    default: 0x0054
  fet_reg_mask:
    default: 0x0006
  fet_disconnect_val:
    default: 0x0000

  # Battery info
  voltage_max:
    default: 13200
  voltage_normal:
    default: 11400
  voltage_min:
    default: 9000
  precharge_current:
    default: 256
  start_charging_min_c:
    default: -3
  start_charging_max_c:
    default: 50
  charging_min_c:
    default: -3
  charging_max_c:
    default: 60
  discharging_min_c:
    default: -5
  discharging_max_c:
    default: 70
```

## zephyr/dts/bindings/battery/cdt,c340152.yaml
```yaml
# CDT CosMX 5260mAh
description: "CDT CosMX 5260mAh AS3FXXD3KB C340152"
compatible: "cdt,c340152"

include: battery-smart.yaml

properties:
  enum-name:
    type: string
    default: "cdt,c340152"

  # Fuel Gauge
  manuf_name:
    default: "AS3FXXD3KB"
  device_name:
    default: "C340152"
  ship_mode_reg_addr:
    default: 0x00
  ship_mode_reg_data:
    default: [0x0010, 0x0010]
  # Charging/Discharging FETs Status
  # Register SBS_PackStatus_ACCESS (0x99)
  # Discharging disabled  Bit-3: XDSG       1 = Active
  # Charging disabled     Bit-2: XCHG       0 = Inactive
  flags:
    default: 0
  fet_reg_addr:
    default: 0x99
  fet_reg_mask:
    default: 0x000C
  fet_disconnect_val:
    default: 0x000C
  fet_cfet_mask:
    default: 0x0004
  fet_cfet_off_val:
    default: 0x0004

  # Battery info
  voltage_max:
    default: 13350
  voltage_normal:
    default: 11985
  voltage_min:
    default: 9000
  precharge_current:
    default: 256
  start_charging_min_c:
    default: 0
  start_charging_max_c:
    default: 45
  charging_min_c:
    default: 0
  charging_max_c:
    default: 60
  discharging_min_c:
    default: -20
  discharging_max_c:
    default: 60
```

## zephyr/dts/bindings/battery/celxpert,b340442.yaml
```yaml
# Copyright 2024 The ChromiumOS Authors
# Use of this source code is governed by a BSD-style license that can be
# found in the LICENSE file.

description: "Celxpert b340442"
compatible: "celxpert,b340442"

include: battery-smart.yaml

properties:
  enum-name:
    type: string
    default: "celxpert,b340442"

  # Fuel gauge
  manuf_name:
    default: "AS3GXXD3KB"
  device_name:
    default: "b340442"
  ship_mode_reg_addr:
    default: 0x00
  ship_mode_reg_data:
    default: [0x10, 0x10]
  # Charging/Discharging FETs Status
  # Register SBS_PackStatus_ACCESS (0x99)
  # Bit-3: XDSG
  # Bit-2: XCHG
  fet_reg_addr:
    default: 0x99
  fet_reg_mask:
    default: 0x08
  fet_disconnect_val:
    default: 0x08
  fet_cfet_mask:
    default: 0x04
  fet_cfet_off_val:
    default: 0x04

  # Battery info
  voltage_max:
    default: 13200
  voltage_normal:
    default: 11880
  voltage_min:
    default: 9000
  precharge_current:
    default: 256
  start_charging_min_c:
    default: 0
  start_charging_max_c:
    default: 45
  charging_min_c:
    default: 0
  charging_max_c:
    default: 60
  discharging_min_c:
    default: -20
  discharging_max_c:
    default: 60
```

## zephyr/dts/bindings/battery/celxpert_b300049.yaml
```yaml
# Copyright 2023 The ChromiumOS Authors
# Use of this source code is governed by a BSD-style license that can be
# found in the LICENSE file.

description: "Celxpert B300049"
compatible: "celxpert,b300049"

include: battery-smart.yaml

properties:
  enum-name:
    type: string
    default: "celxpert,b300049"

  # Fuel gauge
  manuf_name:
    default: "AS3FXXE3KA"
  device_name:
    default: "B300049"
  ship_mode_reg_addr:
    default: 0x00
  ship_mode_reg_data:
    default: [0x10, 0x10]
  # Charging/Discharging FETs Status
  # Register SBS_PackStatus_ACCESS (0x99)
  # Bit-3: XDSG
  # Bit-2: XCHG
  fet_reg_addr:
    default: 0x99
  fet_reg_mask:
    default: 0x08
  fet_disconnect_val:
    default: 0x08
  fet_cfet_mask:
    default: 0x04
  fet_cfet_off_val:
    default: 0x04

  # Battery info
  voltage_max:
    default: 8800
  voltage_normal:
    default: 7920
  voltage_min:
    default: 6000
  precharge_current:
    default: 256
  start_charging_min_c:
    default: 0
  start_charging_max_c:
    default: 45
  charging_min_c:
    default: 0
  charging_max_c:
    default: 60
  discharging_min_c:
    default: -20
  discharging_max_c:
    default: 60
```

## zephyr/dts/bindings/battery/cosmx,ap20cbl-2.yaml
```yaml
description: "COSMX AP20CBL-2"
compatible: "cosmx,ap20cbl-2"

include: battery-smart.yaml

properties:
  enum-name:
    type: string
    default: "cosmx,ap20cbl-2"

  # Fuel gauge
  manuf_name:
    default: "COSMX KT0030B004"
  device_name:
    default: "AP20CBL"
  ship_mode_reg_addr:
    default: 0x3A
  ship_mode_reg_data:
    default: [0xC574, 0xC574]
  # Documentation: b/257860663#comment7
  # Manufacturer Access 0x00
  # b14: Charging Disabled (0: Off, 1: On)
  # b13: Discharging Disabled (0: Off, 1: On)
  flags:
    default: 0x04
  fet_reg_addr:
    default: 0x0
  fet_reg_mask:
    default: 0x2000
  fet_disconnect_val:
    default: 0x2000
  fet_cfet_mask:
    default: 0x4000
  fet_cfet_off_val:
    default: 0x4000

  # Battery info
  voltage_max:
    default: 13200
  voltage_normal:
    default: 11550
  voltage_min:
    default: 9000
  precharge_current:
    default: 256
  start_charging_min_c:
    default: 0
  start_charging_max_c:
    default: 50
  charging_min_c:
    default: 0
  charging_max_c:
    default: 60
  discharging_min_c:
    default: -20
  discharging_max_c:
    default: 75
```

## zephyr/dts/bindings/battery/cosmx,ap20cbl-3.yaml
```yaml
description: "COSMX AP20CBL-3"
compatible: "cosmx,ap20cbl-3"

include: battery-smart.yaml

properties:
  enum-name:
    type: string
    default: "cosmx,ap20cbl-3"

  # Fuel gauge
  manuf_name:
    default: "COSMX KT0030B004"
  device_name:
    default: "AP20CBL"
  ship_mode_reg_addr:
    default: 0x3A
  ship_mode_reg_data:
    default: [0xC574, 0xC574]
  # Documentation: b/263692236#comment2
  # Manufacturer Access 0x00
  # b1: D-FET
  # b2: C-FET
  flags:
    default: 0x04
  fet_reg_addr:
    default: 0x0
  fet_reg_mask:
    default: 0x0002
  fet_disconnect_val:
    default: 0x0000
  fet_cfet_mask:
    default: 0x0004
  fet_cfet_off_val:
    default: 0x0000

  # Battery info
  voltage_max:
    default: 13200
  voltage_normal:
    default: 11550
  voltage_min:
    default: 9000
  precharge_current:
    default: 256
  start_charging_min_c:
    default: 0
  start_charging_max_c:
    default: 50
  charging_min_c:
    default: 0
  charging_max_c:
    default: 60
  discharging_min_c:
    default: -20
  discharging_max_c:
    default: 75
```

## zephyr/dts/bindings/battery/cosmx,ap20cbl-4.yaml
```yaml
description: "COSMX AP20CBL-4"
compatible: "cosmx,ap20cbl-4"

include: battery-smart.yaml

properties:
  enum-name:
    type: string
    default: "cosmx,ap20cbl-4"

  # Fuel gauge
  manuf_name:
    default: "COSMX KT0030B004"
  device_name:
    default: "AP20CBL"
  ship_mode_reg_addr:
    default: 0x3A
  ship_mode_reg_data:
    default: [0xC574, 0xC574]
  # Manufacturer Access 0x00
  # b15: D-FET
  # b14: C-FET
  flags:
    default: 0x00
  fet_reg_addr:
    default: 0x0
  fet_reg_mask:
    default: 0x8000
  fet_disconnect_val:
    default: 0x0000
  fet_cfet_mask:
    default: 0x4000
  fet_cfet_off_val:
    default: 0x0000

  # Battery info
  voltage_max:
    default: 13200
  voltage_normal:
    default: 11550
  voltage_min:
    default: 9000
  precharge_current:
    default: 256
  start_charging_min_c:
    default: 0
  start_charging_max_c:
    default: 50
  charging_min_c:
    default: 0
  charging_max_c:
    default: 60
  discharging_min_c:
    default: -20
  discharging_max_c:
    default: 75
```

## zephyr/dts/bindings/battery/cosmx,ap23abl.yaml
```yaml
description: "COSMX AP23ABL"
compatible: "cosmx,ap23abl"

include: battery-smart.yaml

properties:
  enum-name:
    type: string
    default: "cosmx,ap23abl"

  # Fuel gauge
  manuf_name:
    default: "COSMX KT0030B005"
  device_name:
    default: "AP23ABL"
  ship_mode_reg_addr:
    default: 0x3A
  ship_mode_reg_data:
    default: [0xC574, 0xC574]
  # Manufacturer Access 0x00
  # b15: D-FET
  # b14: C-FET
  flags:
    default: 0x00
  fet_reg_addr:
    default: 0x0
  fet_reg_mask:
    default: 0x8000
  fet_disconnect_val:
    default: 0x0000
  fet_cfet_mask:
    default: 0x4000
  fet_cfet_off_val:
    default: 0x0000

  # Battery info
  voltage_max:
    default: 13200
  voltage_normal:
    default: 11370
  voltage_min:
    default: 9000
  precharge_current:
    default: 466
  start_charging_min_c:
    default: 0
  start_charging_max_c:
    default: 50
  charging_min_c:
    default: 0
  charging_max_c:
    default: 60
  discharging_min_c:
    default: -20
  discharging_max_c:
    default: 75
```

## zephyr/dts/bindings/battery/cosmx,l24x3pg1.yaml
```yaml
# Copyright 2024 The ChromiumOS Authors
# Use of this source code is governed by a BSD-style license that can be
# found in the LICENSE file.

description: "COSMX L24X3PG1"
compatible: "cosmx,l24x3pg1"

include: battery-smart.yaml

properties:
  enum-name:
    type: string
    default: "cosmx,l24x3pg1"

  # Fuel gauge
  manuf_name:
    default: "COSMX"
  device_name:
    default: "L24X3PG1"
  ship_mode_reg_addr:
    default: 0x34
  ship_mode_reg_data:
    default: [0x0000, 0x1000]
  flags:
    default: 0
  fet_reg_addr:
    default: 0x00
  fet_reg_mask:
    default: 0x0018
  fet_disconnect_val:
    default: 0x0000

  # Battery info
  voltage_max:
    default: 13200
  voltage_normal:
    default: 11310
  voltage_min:
    default: 9750
  precharge_current:
    default: 226
  start_charging_min_c:
    default: 0
  start_charging_max_c:
    default: 50
  charging_min_c:
    default: 0
  charging_max_c:
    default: 60
  discharging_min_c:
    default: -20
  discharging_max_c:
    default: 60
```

## zephyr/dts/bindings/battery/cosmx,pg01lj3353.yaml
```yaml
# Copyright 2024 The ChromiumOS Authors
# Use of this source code is governed by a BSD-style license that can be
# found in the LICENSE file.

description: "COSMX PG01LJ3353"
compatible: "cosmx,pg01lj3353"

include: battery-smart.yaml

properties:
  enum-name:
    type: string
    default: "cosmx,pg01lj3353"

  # Fuel gauge
  manuf_name:
    default: "PG01LJ3353"
  device_name:
    default: "CA24A42"
  ship_mode_reg_addr:
    default: 0x00
  ship_mode_reg_data:
    default: [0x0010, 0x0010]
  flags:
    default: 0x04
  fet_reg_addr:
    default: 0x0
  fet_reg_mask:
    default: 0x2000
  fet_disconnect_val:
    default: 0x2000
  fet_cfet_mask:
    default: 0x4000
  fet_cfet_off_val:
    default: 0x4000

  # Battery info
  voltage_max:
    default: 13350
  voltage_normal:
    default: 11610
  voltage_min:
    default: 9000
  precharge_current:
    default: 256
  start_charging_min_c:
    default: 0
  start_charging_max_c:
    default: 45
  charging_min_c:
    default: 0
  charging_max_c:
    default: 60
  discharging_min_c:
    default: -20
  discharging_max_c:
    default: 70
```

## zephyr/dts/bindings/battery/cosmx,si03058xl.yaml
```yaml
# Copyright 2022 The Chromium OS Authors. All rights reserved.
# Use of this source code is governed by a BSD-style license that can be
# found in the LICENSE file.

description: "COSMX SI03058XL"
compatible: "cosmx,si03058xl"

include: battery-smart.yaml

properties:
  enum-name:
    type: string
    default: "cosmx,si03058xl"

  # Fuel gauge
  manuf_name:
    default: "333-AC-11-A"
  device_name:
    default: "SI03058XL"
  ship_mode_reg_addr:
    default: 0x00
  ship_mode_reg_data:
    default: [0x0010, 0x0010]
  flags:
    default: 0x04
  fet_reg_addr:
    default: 0x0
  fet_reg_mask:
    default: 0x0006
  fet_disconnect_val:
    default: 0x0
  fet_cfet_mask:
    default: 0x0004
  fet_cfet_off_val:
    default: 0x0

  # Battery info
  voltage_max:
    default: 13200
  voltage_normal:
    default: 11550
  voltage_min:
    default: 9000
  precharge_current:
    default: 256
  start_charging_min_c:
    default: 0
  start_charging_max_c:
    default: 45
  charging_min_c:
    default: 0
  charging_max_c:
    default: 45
  discharging_min_c:
    default: -10
  discharging_max_c:
    default: 60
```

## zephyr/dts/bindings/battery/dynapack,313-2d-32-a.yaml
```yaml
# Copyright 2024 The ChromiumOS Authors
# Use of this source code is governed by a BSD-style license that can be
# found in the LICENSE file.

description: "Dynapack 313-2D-32-A"
compatible: "dynapack,313-2d-32-a"

include: battery-smart.yaml

properties:
  enum-name:
    type: string
    default: "dynapack,313-2d-32-a"

  # Fuel gauge
  manuf_name:
    default: "313-2D-32-A"
  device_name:
    default: "AE03041XL"
  ship_mode_reg_addr:
    default: 0x00
  ship_mode_reg_data:
    default: [0x0010, 0x0010]
  flags:
    default: 0
  fet_reg_addr:
    default: 0x43
  fet_reg_mask:
    default: 0x0003
  fet_disconnect_val:
    default: 0x0000
  fet_cfet_mask:
    default: 0x0002
  fet_cfet_off_val:
    default: 0x0000


  # Battery info
  voltage_max:
    default: 13200
  voltage_normal:
    default: 11250
  voltage_min:
    default: 9000
  precharge_current:
    default: 256
  start_charging_min_c:
    default: 0
  start_charging_max_c:
    default: 45
  charging_min_c:
    default: 0
  charging_max_c:
    default: 46
  discharging_min_c:
    default: -10
  discharging_max_c:
    default: 60
```

## zephyr/dts/bindings/battery/dynapack,b140435.yaml
```yaml
description: "DYNAPACK AS3GXXD3KB B140435"
compatible: "dynapack,b140435"

include: battery-smart.yaml

properties:
  enum-name:
    type: string
    default: "dynapack,b140435"

  # Fuel gauge
  manuf_name:
    default: "AS3GXXD3KB"
  device_name:
    default: "B140435"
  ship_mode_reg_addr:
    default: 0x00
  ship_mode_reg_data:
    default: [0x0010, 0x0010]
  # Documentation: b/150833879
  # Charging/Discharging FETs Status
  # Register SBS_PackStatus_ACCESS (0x99)
  # Bit-3: XDSG
  # Bit-2: XCHG
  fet_reg_addr:
    default: 0x99
  fet_reg_mask:
    default: 0x8
  fet_disconnect_val:
    default: 0x8
  fet_cfet_mask:
    default: 0x4
  fet_cfet_off_val:
    default: 0x4

  # Battery info
  voltage_max:
    default: 13200
  voltage_normal:
    default: 11850
  voltage_min:
    default: 9000
  precharge_current:
    default: 256
  start_charging_min_c:
    default: 0
  start_charging_max_c:
    default: 45
  charging_min_c:
    default: 0
  charging_max_c:
    default: 60
  discharging_min_c:
    default: -20
  discharging_max_c:
    default: 60
```
