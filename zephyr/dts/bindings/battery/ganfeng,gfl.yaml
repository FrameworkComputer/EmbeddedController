## zephyr/dts/bindings/fingerprint/elan.elan80sg.yaml
```yaml
# Copyright 2025 The Chromium OS Authors. All rights reserved.
# Use of this source code is governed by a BSD-style license that can be
# found in the LICENSE file.

description: ELAN80SG fingerprint sensor

compatible: "elan,elan80sg"

include: [spi-device.yaml]

properties:
  irq-gpios:
    type: phandle-array
    required: true
    description: |
      This property specifies the connection for sensor interrupt.

  reset-gpios:
    type: phandle-array
    required: true
    description: |
      This property specifies the connection for sensor reset.
```
