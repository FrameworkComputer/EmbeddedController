## zephyr/dts/bindings/battery/ganfeng,gfl.yaml
```yaml
# Copyright 2026 The ChromiumOS Authors
# Use of this source code is governed by a BSD-style license that can be
# found in the LICENSE file.

description: "GANFENG GFL"
compatible: "ganfeng,gfl"

include: battery-smart.yaml

properties:
  enum-name:
    type: string
    default: "ganfeng,gfl"

  # Fuel gauge
  manuf_name:
    default: "GFL"
  device_name:
    default: "MQC30"
  ship_mode_reg_addr:
    default: 0x00
  ship_mode_reg_data:
    default: [0x10, 0x10]
  flags:
    default: 0x0004
  fet_reg_addr:
    default: 0x54
  fet_reg_mask:
    default: 0x0006
  fet_disconnect_val:
    default: 0x0000
  fet_cfet_mask:
    default: 0x0004
  fet_cfet_off_val:
    default: 0x0000

  # Battery info
  voltage_max:
    default: 8800
  voltage_normal:
    default: 7700
  voltage_min:
    default: 6000
  precharge_current:
    default: 256
  start_charging_min_c:
    default: 0
  start_charging_max_c:
    default: 50
  charging_min_c:
    default: 0
  charging_max_c:
    default: 60
  discharging_min_c:
    default: -20
  discharging_max_c:
    default: 60
```

## zephyr/dts/bindings/battery/smp,333-1D-2D-A.yaml
```yaml
# Copyright 2025 The ChromiumOS Authors
# Use of this source code is governed by a BSD-style license that can be
# found in the LICENSE file.

description: "SMP 333-1D-2D-A"
compatible: "smp,333-1d-2d-a"

include: battery-smart.yaml

properties:
  enum-name:
    type: string
    default: "smp,333-1d-2d-a"

  # Fuel gauge
  manuf_name:
    default: "333-1D-2D-A"
  device_name:
    default: "GM04070XL"
  ship_mode_reg_addr:
    default: 0x00
  ship_mode_reg_data:
    default: [0x0010, 0x0010]
  flags:
    default: 0x04
  fet_reg_addr:
    default: 0x0
  fet_reg_mask:
    default: 0x0006
  fet_disconnect_val:
    default: 0x0
  fet_cfet_mask:
    default: 0x0004
  fet_cfet_off_val:
    default: 0x0

  # Battery info
  voltage_max:
    default: 9020
  voltage_normal:
    default: 7800
  voltage_min:
    default: 6000
  precharge_current:
    default: 256
  start_charging_min_c:
    default: 0
  start_charging_max_c:
    default: 45
  charging_min_c:
    default: 0
  charging_max_c:
    default: 50
  discharging_min_c:
    default: -10
  discharging_max_c:
    default: 65
```

## zephyr/dts/bindings/battery/smp,l26m2pk1.yaml
```yaml
# Copyright 2026 The ChromiumOS Authors
# Use of this source code is governed by a BSD-style license that can be
# found in the LICENSE file.

description: "SMP L26M2PK1"
compatible: "smp,l26m2pk1"

include: battery-smart.yaml

properties:
  enum-name:
    type: string
    default: "smp,l26m2pk1"

  # Fuel gauge
  manuf_name:
    default: "SMP"
  device_name:
    default: "L26M2PK1"
  ship_mode_reg_addr:
    default: 0x34
  ship_mode_reg_data:
    default: [0x0000, 0x1000]
  flags:
    default: 0
  fet_reg_addr:
    default: 0x00
  fet_reg_mask:
    default: 0x0010
  fet_disconnect_val:
    default: 0x0000
  fet_cfet_mask:
    default: 0x0008
  fet_cfet_off_val:
    default: 0x0000

  # Battery info
  voltage_max:
    default: 8800
  voltage_normal:
    default: 7540
  voltage_min:
    default: 6000
  precharge_current:
    default: 223
  start_charging_min_c:
    default: 0
  start_charging_max_c:
    default: 50
  charging_min_c:
    default: 0
  charging_max_c:
    default: 60
  discharging_min_c:
    default: -20
  discharging_max_c:
    default: 60
```

## zephyr/dts/bindings/battery/smp,smp-atl-4.550.yaml
```yaml
# Copyright 2026 The ChromiumOS Authors
# Use of this source code is governed by a BSD-style license that can be
# found in the LICENSE file.

description: "SMP SMP-ATL-4.550"
compatible: "smp,smp-atl-4-550"

include: battery-smart.yaml

properties:
  enum-name:
    type: string
    default: "smp,smp-atl-4-550"

  # TI BQ41390 Fuel gauge
  manuf_name:
    default: "SMP-ATL4.550"
  device_name:
    default: "DELL RG0NJYMD"
  ship_mode_reg_addr:
    default: 0x00
  ship_mode_reg_data:
    default: [0x0010, 0x0010]
  flags:
    default: 0x0000
  fet_reg_addr:
    default: 0x0000
  fet_reg_mask:
    default: 0xC000
  fet_disconnect_val:
    default: 0x8000
  fet_cfet_mask:
    default: 0xC000
  fet_cfet_off_val:
    default: 0x4000


  # Battery info
  voltage_max:
    default: 13440
  voltage_normal:
    default: 12240
  voltage_min:
    default: 9000
  precharge_current:
    default: 256
  start_charging_min_c:
    default: 0
  start_charging_max_c:
    default: 50
  charging_min_c:
    default: 0
  charging_max_c:
    default: 50
  discharging_min_c:
    default: -17
  discharging_max_c:
    default: 70
```

## zephyr/dts/bindings/cbi/cros-ec,cbi-ufsc-pdc-selector.yaml
```yaml
# Copyright 2026 The ChromiumOS Authors
# Use of this source code is governed by a BSD-style license that can be
# found in the LICENSE file.

include: base.yaml

description: UFSC-based PDC Driver Selector
compatible: "cros-ec,cbi-ufsc-pdc-selector"

properties:
  "#address-cells":
    const: 1
  "#size-cells":
    const: 0

child-binding:
  description: Configuration for a specific USB-C port slot
  properties:
    reg:
      type: int
      required: true
      description: The USB-C port number (0, 1, etc.)
    selections:
      type: phandles
      required: true
      description: >
        Alternating list of <&ufsc_value &pdc_driver_node>.
        If UFSC matches the value, the paired driver is returned.

        To represent an ABSENT port, simply OMIT the UFSC value for
        the absent state from this list. If no match is found, the
        selector returns NULL, disabling the port.
```

## zephyr/dts/bindings/cbi/cros-ec,cbi-ufsc-value.yaml
```yaml
# Copyright 2025 The ChromiumOS Authors
# Use of this source code is governed by a BSD-style license that can be
# found in the LICENSE file.

include: base.yaml

description: |
  A possible value for a CBI UFSC field.
  It must be defined as a child of a UFSC field node (which is itself
  a child of the "cros-ec,cbi-ufsc" node).

compatible: "cros-ec,cbi-ufsc-value"

properties:
  value:
    type: int
    required: true
    description:
      The integer value that represents this component choice. This value
      is compared against the bits read from the CBI. Must fit within the
      size defined by the parent field.
  enum-name:
    type: string
    required: false
    description:
      Optional name used to generate a descriptive C enum for this specific
      value.
  default:
    type: boolean
    required: false
    description:
      If set, this value will be the default for its parent field if the
      UFSC data is invalid or unavailable. Only one default is allowed
      per field.
```

## zephyr/dts/bindings/cbi/cros-ec,cbi-ufsc.yaml
```yaml
# Copyright 2025 The ChromiumOS Authors
# Use of this source code is governed by a BSD-style license that can be
# found in the LICENSE file.

include: base.yaml

description: |
  CBI Unified Firmware and Second-source Config fields (UFSC).

  This node defines a collection of bit fields within the 5-DWORD (20-byte)
  UFSC region of the Cros Board Info (CBI). It unifies the functionality
  of the legacy fw-config and ssfc nodes.

compatible: "cros-ec,cbi-ufsc"

child-binding:
  description:
    Each child node represents a single logical field within the UFSC data.
    A field can be composed of discontiguous bit segments.
  properties:
    enum-name:
      type: string
      required: true
      description:
        Name of the field used to generate a C enum for access.
    start:
      type: array
      required: true
      description: |
        Array of starting bit positions for each segment of the field.
        Positions are 0-indexed from the start of the 5-DWORD UFSC block
        (valid range: 0-159).
    size:
      type: array
      required: true
      description: |
        Array of sizes in bits for each corresponding segment in the 'start'
        array. The length must match the length of the 'start' array.
        Each size element must be <= 8.

# Example:
#
# cbi-ufsc {
#     compatible = "cros-ec,cbi-ufsc";
#
#     fan {
#         enum-name = "UFSC_FAN";
#         start = <0 4>;
#         size = <1 1>;
#         absent {
#             compatible = "cros-ec,cbi-ufsc-value";
#             status = "okay";
#             value = <0>;
#             default;
#         };
#         present {
#             compatible = "cros-ec,cbi-ufsc-value";
#             status = "okay";
#             value = <1>;
#         };
#     };
#     base-sensor {
#         enum-name = "UFSC_BASE_SENSOR";
#         start = <1>;
#         size = <3>;
#         bmi160 {
#             compatible = "cros-ec,cbi-ufsc-value";
#             status = "okay";
#             value = <1>;
#         };
#     };
# };
```

## zephyr/dts/bindings/charger/hpb-charger.yaml
```yaml
# Copyright 2025 The ChromiumOS Authors
# SPDX-License-Identifier: Apache-2.0

description: |
  Properties common to all Hybrid Power Boost (HBP) charger chips

properties:
  minimum-charging-mv:
    type: int
    description: |
      Minimum voltage (in millivolts) required to charge battery for hybrid
      boost chargers.
```

## zephyr/dts/bindings/cros_flash/andestech,qspi-nor-xip-cros-flash.yaml
```yaml
# Copyright 2025 Google LLC
# SPDX-License-Identifier: Apache-2.0

description: Andestech, QSPI NOR XIP cros-flash node

compatible: "andestech,qspi-nor-xip-cros-flash"

include: cros-flash-controller.yaml
```

## zephyr/dts/bindings/cros_flash/elan,em32f967-cros-flash.yaml
```yaml
# Copyright 2025 Google LLC
# SPDX-License-Identifier: Apache-2.0

description: Elan cros flash

compatible: "elan,em32f967-cros-flash"

include: cros-flash-controller.yaml
```

## zephyr/dts/bindings/cros_flash/ft,ft9001-cros-flash.yaml
```yaml
# Copyright 2026 Google LLC
# SPDX-License-Identifier: Apache-2.0

description: Focaltech, ft9001-cros-flash node

compatible: "ft,ft9001-cros-flash"

include: cros-flash-controller.yaml
```

## zephyr/dts/bindings/cros_flash/microchip,write-protect.yaml
```yaml
# Copyright 2025 The ChromiumOS Authors
# Use of this source code is governed by a BSD-style license that can be
# found in the LICENSE file.

description: Microchip Internal Write Protect gpios

compatible: "microchip,write-protect"

properties:
  wp-gpios:
    type: phandle-array
    required: true
    description: |
      Internal GPIO that controls WP status for the internal EC SPI Flash.
      For MEC1727 this should be MCHP_GPIO_DECODE_076 and configured to
      Active Low.

  wp-ex-gpios:
    type: phandle-array
    required: true
    description: |
      External GPIO that connects to the write protect signal from the GSC.
```

## zephyr/dts/bindings/cros_pwr_signal/amd,fwk-phoenix-fp7r2-power-signal-list.yaml
```yaml
# Copyright 2024 Google LLC
# SPDX-License-Identifier: Apache-2.0

description: AMD Phoenix FP7r2, Power Signal List
compatible: "amd,fwk-phoenix-fp7r2-power-signal-list"

include: power-signal-list.yaml

properties:
  power-signals-required:
    default: 4

child-binding:
  properties:
    power-enum-name:
      enum:
        - X86_3VALW_PG
        - X86_SLP_S3_N
        - X86_SLP_S5_N
        - X86_VR_PG
```

## zephyr/dts/bindings/cros_pwr_signal/amd,fwk-strix-halo-fp11-power-signal-list.yaml
```yaml
# Copyright 2024 Google LLC
# SPDX-License-Identifier: Apache-2.0

description: AMD Strix Halo FP11, Power Signal List
compatible: "amd,fwk-strix-halo-fp11-power-signal-list.yaml"

include: power-signal-list.yaml

properties:
  power-signals-required:
    default: 5

child-binding:
  properties:
    power-enum-name:
      enum:
        - X86_3VALW_PG
        - X86_SLP_S3_N
        - X86_SLP_S5_N
        - X86_VR_PG
        - X86_VS_POWER
```

## zephyr/dts/bindings/cros_pwr_signal/intel,fwk-mtl-power-signal-list.yaml
```yaml
# Copyright 2024 Google LLC
# SPDX-License-Identifier: Apache-2.0

description: Intel-MTL, Power Signal List
compatible: "intel,fwk-mtl-power-signal-list"

include: power-signal-list.yaml

properties:
  power-signals-required:
    default: 6

child-binding:
  properties:
    power-enum-name:
      enum:
        - X86_3VALW_PG
        - X86_SLP_S3_N
        - X86_SLP_S5_N
        - X86_VR_PG
        - X86_PRIM_PWR
        - X86_SLP_S4_N
```

## zephyr/dts/bindings/cros_pwr_signal/intel,fwk-rpl-power-signal-list.yaml
```yaml
# Copyright 2026 Google LLC
# SPDX-License-Identifier: Apache-2.0

description: Intel-RPL, Power Signal List
compatible: "intel,fwk-rpl-power-signal-list"

include: power-signal-list.yaml

properties:
  power-signals-required:
    default: 6

child-binding:
  properties:
    power-enum-name:
      enum:
        - X86_3VALW_PG
        - X86_SLP_S3_N
        - X86_VR_PG
        - X86_SLP_S4_N
        - X86_SLP_SUS
        - X86_VCCIN_AUX_VR_PG
```

## zephyr/dts/bindings/cros_pwr_signal/intel,fwk-wildcat-lake-u-power-signal-list.yaml
```yaml
# Copyright 2026 Google LLC
# SPDX-License-Identifier: Apache-2.0

description: Intel-wildcat-lake-u, Power Signal List
compatible: "intel,fwk-wildcat-lake-u-power-signal-list"

include: power-signal-list.yaml

properties:
  power-signals-required:
    default: 7

child-binding:
  properties:
    power-enum-name:
      enum:
        - X86_3VALW_PG
        - X86_1P25V_PRIM_PG
        - X86_SLP_S5_N
        - X86_SLP_S4_N
        - X86_SLP_S3_N
        - X86_DRAM_PG
        - X86_VR_PG
```

## zephyr/dts/bindings/cse_early_rec/cros-ec,cse-early-rec.yaml
```yaml
# Copyright 2025 The ChromiumOS Authors
# Use of this source code is governed by a BSD-style license that can be
# found in the LICENSE file.

description: |
  Driver code to set the CSE early recovery GPIO. This signal is read by AP FW
  on Intel systems during early boot phases to anticipate recovery mode entry.

compatible: "cros-ec,cse-early-rec"

include: base.yaml

properties:
  cse-early-rec-gpios:
    type: phandle-array
    required: true
    description: |
      GPIO pin connected to the EC_SOC_REC_SWITCH_OD (aka CSE_EARLY_REC_SW)
      signal on the platform. Board should configure the active level such that
      logically asserting the GPIO indicates recovery mode.
```

## zephyr/dts/bindings/fan/cros-ec,fans.yaml
```yaml
# Copyright 2021 The ChromiumOS Authors
# Use of this source code is governed by a BSD-style license that can be
# found in the LICENSE file.

description: Fan parent node

compatible: "cros-ec,fans"

child-binding:
  description: Fan's child node
  properties:
    rpm-min:
      required: true
      type: int
      description:
        Minimum fan speed (in RPM) to keep turning
    rpm-start:
      required: true
      type: int
      description:
        Fan speed (in RPM) to begin turning
    rpm-max:
      required: true
      type: int
      description:
        Maximum fan speed (in RPM)
    rpm-deviation:
      default: 7
      type: int
      description:
        Percentage of fan rpm deviation
    pwms:
      type: phandle-array
      required: true
      description:
        PWM channel to control the fan
    tach:
      type: phandle
      description:
        Tachometer to measure the fan speed
    not-use-rpm-mode:
      type: boolean
      description:
        Disable automatic RPM control using tachometer input
    use-fast-start:
      type: boolean
      description:
        Fan requires a higher duty cycle to start up than to keep
        running
    pgood-gpio:
      type: phandle
      description:
        Active high input GPIO which signals the power is good
    enable-gpio:
      type: phandle
      description:
        Active high output GPIO to enable the power
    fan-force-off:
      type: boolean
      description:
        fan-force-off is need to set for fans which keep spinning with
        minimum rpm at dutycycle 0 due to specs limitation
```
