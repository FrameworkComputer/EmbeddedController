## zephyr/dts/bindings/battery/lgc,ap19a8k.yaml
```yaml
description: "LGC KT0030G023 AP19A8K"
compatible: "lgc,ap19a8k"

include: battery-smart.yaml

properties:
  enum-name:
    type: string
    default: "lgc,ap19a8k"

  # Fuel gauge
  manuf_name:
    default: "LGC KT0030G023"
  device_name:
    default: "AP19A8K"
  ship_mode_reg_addr:
    default: 0x3A
  ship_mode_reg_data:
    default: [0xC574, 0xC574]
  # Documentation: b/135496272
  flags:
    default: 0
  fet_reg_addr:
    default: 0x43
  fet_reg_mask:
    default: 0x0001
  fet_disconnect_val:
    default: 0x0000
  fet_cfet_mask:
    default: 0x0002
  fet_cfet_off_val:
    default: 0x0000

  # Battery info
  voltage_max:
    default: 13200
  voltage_normal:
    default: 11550
  voltage_min:
    default: 9000
  precharge_current:
    default: 256
  start_charging_min_c:
    default: 0
  start_charging_max_c:
    default: 50
  charging_min_c:
    default: 0
  charging_max_c:
    default: 60
  discharging_min_c:
    default: -20
  discharging_max_c:
    default: 75
```

## zephyr/dts/bindings/battery/lgc,ap19b8m.yaml
```yaml
description: "LGC KT0030G024 AP19B8M"
compatible: "lgc,ap19b8m"

include: battery-smart.yaml

properties:
  enum-name:
    type: string
    default: "lgc,ap19b8m"

  # Fuel gauge
  manuf_name:
    default: "LGC KT0030G024"
  device_name:
    default: "AP19B8M"
  ship_mode_reg_addr:
    default: 0x3A
  ship_mode_reg_data:
    default: [0xC574, 0xC574]
  # Documentation: b/135496272
  flags:
    default: 0
  fet_reg_addr:
    default: 0x43
  fet_reg_mask:
    default: 0x0001
  fet_disconnect_val:
    default: 0x0000
  fet_cfet_mask:
    default: 0x0002
  fet_cfet_off_val:
    default: 0x0000

  # Battery info
  voltage_max:
    default: 13350
  voltage_normal:
    default: 11610
  voltage_min:
    default: 9000
  precharge_current:
    default: 256
  start_charging_min_c:
    default: 0
  start_charging_max_c:
    default: 50
  charging_min_c:
    default: 0
  charging_max_c:
    default: 60
  discharging_min_c:
    default: -20
  discharging_max_c:
    default: 75
```

## zephyr/dts/bindings/battery/lgc,l20l3pg2.yaml
```yaml
# Copyright 2021 The ChromiumOS Authors
# Use of this source code is governed by a BSD-style license that can be
# found in the LICENSE file.

description: "LGC L20L3PG2"
compatible: "lgc,l20l3pg2"

include: battery-smart.yaml

properties:
  enum-name:
    type: string
    default: "lgc,l20l3pg2"

  # Fuel gauge
  manuf_name:
    default: "LGC"
  device_name:
    default: "L20L3PG2"
  ship_mode_reg_addr:
    default: 0x34
  ship_mode_reg_data:
    default: [0x0000, 0x1000]
  flags:
    default: 0
  fet_reg_addr:
    default: 0x34
  fet_reg_mask:
    default: 0x0100
  fet_disconnect_val:
    default: 0x0100

  # Battery info
  voltage_max:
    default: 13050
  voltage_normal:
    default: 11400
  voltage_min:
    default: 9000
  precharge_current:
    default: 256
  start_charging_min_c:
    default: 0
  start_charging_max_c:
    default: 50
  charging_min_c:
    default: 0
  charging_max_c:
    default: 60
  discharging_min_c:
    default: -20
  discharging_max_c:
    default: 73
```

## zephyr/dts/bindings/battery/lgc,xphx8.yaml
```yaml
# Copyright 2022 The ChromiumOS Authors
# Use of this source code is governed by a BSD-style license that can be
# found in the LICENSE file.

description: "LGC-LGC3.600 DELL_XPHX8"
compatible: "lgc,xphx8"

include: battery-smart.yaml

properties:
  enum-name:
    type: string
    default: "lgc,xphx8"

  # Fuel Gauge
  manuf_name:
    default: "LGC-LGC3.600"
  device_name:
    default: "DELL XPHX8"
  ship_mode_reg_addr:
    default: 0x00
  ship_mode_reg_data:
    default: [0x0010, 0x0010]
  flags:
    default: 0
  fet_reg_addr:
    default: 0x43
  fet_reg_mask:
    default: 0x0001
  fet_disconnect_val:
    default: 0x0000
  fet_cfet_mask:
    default: 0x0002
  fet_cfet_off_val:
    default: 0x0000

  # Battery info
  voltage_max:
    default: 17600
  voltage_normal:
    default: 15000
  voltage_min:
    default: 12000
  precharge_current:
    default: 256
  start_charging_min_c:
    default: -3
  start_charging_max_c:
    default: 45
  charging_min_c:
    default: -3
  charging_max_c:
    default: 50
  discharging_min_c:
    default: -20
  discharging_max_c:
    default: 70
```

## zephyr/dts/bindings/battery/lges,ap22a8n.yaml
```yaml
# Copyright 2025 The ChromiumOS Authors
# Use of this source code is governed by a BSD-style license that can be
# found in the LICENSE file.

description: "LGES KT0040G016 AP22A8N"
compatible: "lges,ap22a8n"

include: battery-smart.yaml

properties:
  enum-name:
    type: string
    default: "lges,ap22a8n"

  # Fuel gauge
  manuf_name:
    default: "LGES KT0040G016"
  device_name:
    default: "AP22A8N"
  ship_mode_reg_addr:
    default: 0x3A
  ship_mode_reg_data:
    default: [0xC574, 0xC574]
  flags:
    default: 0
  fet_reg_addr:
    default: 0x0
  fet_reg_mask:
    default: 0x8000
  fet_disconnect_val:
    default: 0x0000
  fet_cfet_mask:
    default: 0x4000
  fet_cfet_off_val:
    default: 0x0000

  # Battery info
  voltage_max:
    default: 17880
  voltage_normal:
    default: 15520
  voltage_min:
    default: 12000
  precharge_current:
    default: 256
  start_charging_min_c:
    default: 0
  start_charging_max_c:
    default: 50
  charging_min_c:
    default: 0
  charging_max_c:
    default: 60
  discharging_min_c:
    default: -20
  discharging_max_c:
    default: 75
```

## zephyr/dts/bindings/battery/lges,ap23a8l.yaml
```yaml
# Copyright 2023 The ChromiumOS Authors
# Use of this source code is governed by a BSD-style license that can be
# found in the LICENSE file.

description: "LGES AP23A8L"
compatible: "lges,ap23a8l"

include: battery-smart.yaml

properties:
  enum-name:
    type: string
    default: "lges,ap23a8l"

  # Fuel Gauge
  manuf_name:
    default: "LGES KT0030G025"
  device_name:
    default: "AP23A8L"
  ship_mode_reg_addr:
    default: 0x3A
  ship_mode_reg_data:
    default: [0xC574, 0xC574]
  flags:
    default: 0x0
  fet_reg_addr:
    default: 0x00
  fet_reg_mask:
    default: 0x8000
  fet_disconnect_val:
    default: 0x0000
  fet_cfet_mask:
    default: 0x4000
  fet_cfet_off_val:
    default: 0x0000

  # Battery info
  voltage_max:
    default: 13200
  voltage_normal:
    default: 11280
  voltage_min:
    default: 9000
  precharge_current:
    default: 256
  start_charging_min_c:
    default: 0
  start_charging_max_c:
    default: 50
  charging_min_c:
    default: 0
  charging_max_c:
    default: 60
  discharging_min_c:
    default: -20
  discharging_max_c:
    default: 75
```

## zephyr/dts/bindings/battery/named-batteries.yaml
```yaml
description: Named Batteries parent node

compatible: "named-batteries"

# TODO(b/218888909): Delete this file after all boards have been converted to
# use the "batteries" node

# This file is deprecated.  Do not additional enum-name.  Instead create
# a new battery descriptor file matching the battery-info.yaml format.

child-binding:
    description: Named batteries child node
    properties:
       enum-name:
          type: string
          required: true
          enum:
            - "aec,5477109"
            - "ap16l5j"
            - "ap16l5j_009"
            - "ap16l8j"
            - "c235"
            - "lgc011"
            - "lgc_ap18c8k"
            - "lgc_l20l3pg2"
            - "murata_ap18c4k"
            - "smp_l20m3pg0"
            - "smp,l20m3pg1"
            - "smp_l20m3pg2"
```

## zephyr/dts/bindings/battery/panasonic,ap16l5j-009.yaml
```yaml
description: "Panasonic KT00205009 AP16L5J"
compatible: "panasonic,ap16l5j-009"

include: battery-smart.yaml

properties:
  enum-name:
    type: string
    default: "panasonic,ap16l5j-009"

  # Fuel gauge
  manuf_name:
    default: "PANASONIC KT00205009"
  device_name:
    default: "AP16L5J"
  ship_mode_reg_addr:
    default: 0x3A
  ship_mode_reg_data:
    default: [0xC574, 0xC574]
  # Documentation: b/144674480
  # ManufacturerAccess() 0x00
  # Bit14 Discharge FET status
  # Set - Discharge FET is ON, Reset - Discharge FET is OFF
  # Bit15 Charge FET status
  # Set - Charge FET is ON, Reset - Charge FET is OFF
  flags:
    default: 0
  fet_reg_addr:
    default: 0x0
  fet_reg_mask:
    default: 0x4000
  fet_disconnect_val:
    default: 0x0000
  fet_cfet_mask:
    default: 0x8000
  fet_cfet_off_val:
    default: 0x0000

  # Battery info
  voltage_max:
    default: 8800
  voltage_normal:
    default: 7700
  voltage_min:
    default: 6000
  precharge_current:
    default: 256
  start_charging_min_c:
    default: 0
  start_charging_max_c:
    default: 50
  charging_min_c:
    default: 0
  charging_max_c:
    default: 60
  discharging_min_c:
    default: -20
  discharging_max_c:
    default: 75
```

## zephyr/dts/bindings/battery/panasonic,ap19a5k.yaml
```yaml
description: "Panasonic KT00305012 AP19A5K"
compatible: "panasonic,ap19a5k"

include: battery-smart.yaml

properties:
  enum-name:
    type: string
    default: "panasonic,ap19a5k"

  # Fuel gauge
  manuf_name:
    default: "PANASONIC KT00305012"
  device_name:
    default: "AP19A5K"
  ship_mode_reg_addr:
    default: 0x3A
  ship_mode_reg_data:
    default: [0xC574, 0xC574]
  # Documentation: b/224888442
  # ManufacturerAccess() 0x00
  # Bit14 Discharge FET status
  # Set - Discharge FET is ON, Reset - Discharge FET is OFF
  # Bit15 Charge FET status
  # Set - Charge FET is ON, Reset - Charge FET is OFF
  flags:
    default: 0
  fet_reg_addr:
    default: 0x0
  fet_reg_mask:
    default: 0x4000
  fet_disconnect_val:
    default: 0x0000
  fet_cfet_mask:
    default: 0x8000
  fet_cfet_off_val:
    default: 0x0000

  # Battery info
  voltage_max:
    default: 13200
  voltage_normal:
    default: 7700
  voltage_min:
    default: 6000
  precharge_current:
    default: 256
  start_charging_min_c:
    default: 0
  start_charging_max_c:
    default: 50
  charging_min_c:
    default: 0
  charging_max_c:
    default: 60
  discharging_min_c:
    default: -20
  discharging_max_c:
    default: 75
```

## zephyr/dts/bindings/battery/panasonic,ap19b5k.yaml
```yaml
# Copyright 2022 The ChromiumOS Authors
# Use of this source code is governed by a BSD-style license that can be
# found in the LICENSE file.

description: "Panasonic KT00305011 AP19B5K"
compatible: "panasonic,ap19b5k"

include: battery-smart.yaml

properties:
  enum-name:
    type: string
    default: "panasonic,ap19b5k"

  # Fuel gauge
  manuf_name:
    default: "PANASONIC KT00305011"
  device_name:
    default: "AP19B5K"
  ship_mode_reg_addr:
    default: 0x3A
  ship_mode_reg_data:
    default: [0xC574, 0xC574]
  # Documentation: b/259913834
  flags:
    default: 0
  fet_reg_addr:
    default: 0x0
  fet_reg_mask:
    default: 0x4000
  fet_disconnect_val:
    default: 0x0000
  fet_cfet_mask:
    default: 0x8000
  fet_cfet_off_val:
    default: 0x0000

  # Battery info
  voltage_max:
    default: 13200
  voltage_normal:
    default: 11550
  voltage_min:
    default: 9000
  precharge_current:
    default: 256
  start_charging_min_c:
    default: 0
  start_charging_max_c:
    default: 50
  charging_min_c:
    default: 0
  charging_max_c:
    default: 60
  discharging_min_c:
    default: -20
  discharging_max_c:
    default: 75
```

## zephyr/dts/bindings/battery/pow-tech,sg20qt1c.yaml
```yaml
# Copyright 2022 The ChromiumOS Authors
# Use of this source code is governed by a BSD-style license that can be
# found in the LICENSE file.

description: "POW-TECH SG20QT1C"
compatible: "pow-tech,sg20qt1c"

include: battery-smart.yaml

properties:
  enum-name:
    type: string
    default: "pow-tech,sg20qt1c"

  # TI BQ40Z50 Fuel Gauge
  manuf_name:
    default: "POW-TECH"
  device_name:
    default: "SG20QT1C"
  ship_mode_reg_addr:
    default: 0x00
  ship_mode_reg_data:
    default: [0x0010, 0x0010]
  flags:
    default: 0x04
  fet_reg_addr:
    default: 0x54
  fet_reg_mask:
    default: 0x0006
  fet_disconnect_val:
    default: 0x0000
  fet_cfet_mask:
    default: 0x4000
  fet_cfet_off_val:
    default: 0x4000

  # Battery info
  voltage_max:
    default: 8700
  voltage_normal:
    default: 7600
  voltage_min:
    default: 6000
  precharge_current:
    default: 256
  start_charging_min_c:
    default: 0
  start_charging_max_c:
    default: 45
  charging_min_c:
    default: 0
  charging_max_c:
    default: 53
  discharging_min_c:
    default: -23
  discharging_max_c:
    default: 63
```

## zephyr/dts/bindings/battery/powertech,batgqa05l22.yaml
```yaml
# Copyright 2022 The ChromiumOS Authors
# Use of this source code is governed by a BSD-style license that can be
# found in the LICENSE file.

description: "POWERTECH BATGQA05L22"
compatible: "powertech,batgqa05l22"

include: battery-smart.yaml

properties:
  enum-name:
    type: string
    default: "powertech,batgqa05l22"

  # TI BQ40Z50 Fuel Gauge
  manuf_name:
    default: "POW-TECH"
  device_name:
    default: "BATGQA05L22"
  ship_mode_reg_addr:
    default: 0x00
  ship_mode_reg_data:
    default: [0x0010, 0x0010]
  flags:
    default: 0x04
  fet_reg_addr:
    default: 0x00
  fet_reg_mask:
    default: 0x2000
  fet_disconnect_val:
    default: 0x2000
  fet_cfet_mask:
    default: 0x4000
  fet_cfet_off_val:
    default: 0x4000

  # Battery info
  # voltage_max = 13050, Calculated value with 5 tenth % error margin
  # considered is: ((13050 * 1000) / (1000 + 5)) = 12985
  voltage_max:
    default: 12985
  voltage_normal:
    default: 11400
  voltage_min:
    default: 9000
  precharge_current:
    default: 280
  start_charging_min_c:
    default: 0
  start_charging_max_c:
    default: 45
  charging_min_c:
    default: 0
  charging_max_c:
    default: 45
  discharging_min_c:
    default: -10
  discharging_max_c:
    default: 60
```

## zephyr/dts/bindings/battery/sdi,4404d57.yaml
```yaml
# Copyright 2023 The ChromiumOS Authors
# Use of this source code is governed by a BSD-style license that can be
# found in the LICENSE file.

description: "SDI battery"
compatible: "sdi,4404d57"

include: battery-smart.yaml

properties:
  enum-name:
    type: string
    default: "sdi,4404d57"

  # Fuel gauge
  manuf_name:
    default: "SDI"
  device_name:
    default: "4404D57"
  ship_mode_reg_addr:
    default: 0x00
  ship_mode_reg_data:
    default: [0x0010, 0x0010]

  flags:
    default: 0
  fet_reg_addr:
    default: 0x00
  fet_reg_mask:
    default: 0xC000
  fet_disconnect_val:
    default: 0x8000
  fet_cfet_mask:
    default: 0xC000
  fet_cfet_off_val:
    default: 0x4000

  # Battery info
  voltage_max:
    default: 8700
  voltage_normal:
    default: 7700
  voltage_min:
    default: 6000
  precharge_current:
    default: 200
  start_charging_min_c:
    default: 0
  start_charging_max_c:
    default: 45
  charging_min_c:
    default: 0
  charging_max_c:
    default: 55
  discharging_min_c:
    default: -20
  discharging_max_c:
    default: 70
```

## zephyr/dts/bindings/battery/smp,ap23a7l-2.yaml
```yaml
# Copyright 2023 The ChromiumOS Authors
# Use of this source code is governed by a BSD-style license that can be
# found in the LICENSE file.

description: "SMP KT00307014 AP23A7L"
compatible: "smp,ap23a7l-2"

include: battery-smart.yaml

properties:
  enum-name:
    type: string
    default: "smp,ap23a7l-2"

  # Fuel gauge
  manuf_name:
    default: "SMP KT00307014"
  device_name:
    default: "AP23A7L"
  ship_mode_reg_addr:
    default: 0x3A
  ship_mode_reg_data:
    default: [0xC574, 0xC574]
  # Documentation: b/296354925
  flags:
    default: 0
  fet_reg_addr:
    default: 0x0
  fet_reg_mask:
    default: 0x8000
  fet_disconnect_val:
    default: 0x0000
  fet_cfet_mask:
    default: 0x4000
  fet_cfet_off_val:
    default: 0x0000

  # Battery info
  voltage_max:
    default: 13200
  voltage_normal:
    default: 11250
  voltage_min:
    default: 9000
  precharge_current:
    default: 256
  start_charging_min_c:
    default: 0
  start_charging_max_c:
    default: 50
  charging_min_c:
    default: 0
  charging_max_c:
    default: 60
  discharging_min_c:
    default: -20
  discharging_max_c:
    default: 60
```
