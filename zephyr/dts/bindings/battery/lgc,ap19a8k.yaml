## zephyr/dts/bindings/battery/smp,ap23b7q.yaml
```yaml
# Copyright 2025 The ChromiumOS Authors
# Use of this source code is governed by a BSD-style license that can be
# found in the LICENSE file.

description: "SMP KT00307013 AP23B7Q"
compatible: "smp,ap23b7q"

include: battery-smart.yaml

properties:
  enum-name:
    type: string
    default: "smp,ap23b7q"

  # Fuel gauge
  manuf_name:
    default: "SMP KT00307013"
  device_name:
    default: "AP23B7Q"
  ship_mode_reg_addr:
    default: 0x3A
  ship_mode_reg_data:
    default: [0xC574, 0xC574]
  flags:
    default: 0
  fet_reg_addr:
    default: 0x0
  fet_reg_mask:
    default: 0x8000
  fet_disconnect_val:
    default: 0x0000
  fet_cfet_mask:
    default: 0x4000
  fet_cfet_off_val:
    default: 0x0000

  # Battery info
  voltage_max:
    default: 13440
  voltage_normal:
    default: 11670
  voltage_min:
    default: 9000
  precharge_current:
    default: 256
  start_charging_min_c:
    default: 0
  start_charging_max_c:
    default: 50
  charging_min_c:
    default: 0
  charging_max_c:
    default: 60
  discharging_min_c:
    default: -20
  discharging_max_c:
    default: 60
```

## zephyr/dts/bindings/battery/smp,atl26jgk.yaml
```yaml
# Copyright 2023 The ChromiumOS Authors
# Use of this source code is governed by a BSD-style license that can be
# found in the LICENSE file.

description: "SMP-ATL3.61 DELL 26JGK"
compatible: "smp,atl26jgk"

include: battery-smart.yaml

properties:
  enum-name:
    type: string
    default: "smp,atl26jgk"

  # Fuel gauge
  manuf_name:
    default: "SMP-ATL-3.61"
  device_name:
    default: "DELL 26JGK"
  ship_mode_reg_addr:
    default: 0x44
  ship_mode_reg_data:
    default: [0x0010, 0x0010]
  flags:
    default: 0x0d
  fet_reg_addr:
    default: 0x0054
  fet_reg_mask:
    default: 0x0006
  fet_disconnect_val:
    default: 0x0000
  fet_cfet_mask:
    default: 0x0004
  fet_cfet_off_val:
    default: 0x0000

  # Battery info
  voltage_max:
    default: 13200
  voltage_normal:
    default: 11400
  voltage_min:
    default: 9000
  precharge_current:
    default: 256
  start_charging_min_c:
    default: -3
  start_charging_max_c:
    default: 50
  charging_min_c:
    default: -3
  charging_max_c:
    default: 60
  discharging_min_c:
    default: -5
  discharging_max_c:
    default: 70
```

## zephyr/dts/bindings/battery/smp,atlxdy9k.yaml
```yaml
description: "SMP-ATL SMP-ATL3.66 "
compatible: "smp,atlxdy9k"

include: battery-smart.yaml

properties:
  enum-name:
    type: string
    default: "smp,atlxdy9k"

  # Fuel gauge
  manuf_name:
    default: "SMP-ATL3.66"
  device_name:
    default: "DELL XDY9K"
  ship_mode_reg_addr:
    default: 0x00
  ship_mode_reg_data:
    default: [0x0010, 0x0010]
  flags:
    default: 0
  fet_reg_addr:
    default: 0x43
  fet_reg_mask:
    default: 0x0001
  fet_disconnect_val:
    default: 0x0000
  fet_cfet_mask:
    default: 0x0002
  fet_cfet_off_val:
    default: 0x0000

  # Battery info
  voltage_max:
    default: 17600
  voltage_normal:
    default: 15000
  voltage_min:
    default: 12000
  precharge_current:
    default: 256
  start_charging_min_c:
    default: -3
  start_charging_max_c:
    default: 45
  charging_min_c:
    default: -3
  charging_max_c:
    default: 50
  discharging_min_c:
    default: -17
  discharging_max_c:
    default: 70
```

## zephyr/dts/bindings/battery/smp,c223-50.yaml
```yaml
description: "SMP AS1GTBFE3KA"
compatible: "smp,c223-50"

include: battery-smart.yaml

properties:
  enum-name:
    type: string
    default: "smp,c223-50"

  # Fuel gauge
  manuf_name:
    default: "AS1GTBFE3KA"
  device_name:
    default: "C223-50"
  ship_mode_reg_addr:
    default: 0x00
  ship_mode_reg_data:
    default: [0x0010, 0x0010]
  # Charging/Discharging FETs Status
  # Register SBS_PackStatus_ACCESS (0x99)
  # Bit-3: XDSG
  # Bit-2: XCHG
  fet_reg_addr:
    default: 0x99
  fet_reg_mask:
    default: 0x0C
  fet_disconnect_val:
    default: 0x0C
  fet_cfet_mask:
    default: 0x04
  fet_cfet_off_val:
    default: 0x04

  # Battery info
  voltage_max:
    default: 8000
  voltage_normal:
    default: 7920
  voltage_min:
    default: 6000
  precharge_current:
    default: 256
  start_charging_min_c:
    default: 0
  start_charging_max_c:
    default: 45
  charging_min_c:
    default: 0
  charging_max_c:
    default: 60
  discharging_min_c:
    default: -20
  discharging_max_c:
    default: 60
```

## zephyr/dts/bindings/battery/smp,c31n1915.yaml
```yaml
description: "SMP Rechargeable Li-Polymer Battery Pack 3640mAh"
compatible: "smp,c31n1915"

include: battery-smart.yaml

properties:
   enum-name:
      type: string
      default: "smp,c31n1915"

   # Fuel gauge
   manuf_name:
      default: "AS3GWND3jB"
   device_name:
      default: "B340035"
   ship_mode_reg_addr:
      default: 0x00
   ship_mode_reg_data:
      default: [ 0x0010, 0x0010 ]
   fet_reg_addr:
      default: 0x99
   fet_reg_mask:
      default: 0x000c
   fet_disconnect_val:
      default: 0x000c

   # Battery info
   voltage_max:
      default: 13200
   voltage_normal:
      default: 11850
   voltage_min:
      default: 9000
   precharge_current:
      default: 256
   start_charging_min_c:
      default: 0
   start_charging_max_c:
      default: 45
   charging_min_c:
      default: 0
   charging_max_c:
      default: 60
   discharging_min_c:
      default: -20
   discharging_max_c:
      default: 60
```

## zephyr/dts/bindings/battery/smp,c31n2313.yaml
```yaml
# Copyright 2024 The ChromiumOS Authors
# Use of this source code is governed by a BSD-style license that can be
# found in the LICENSE file.

# SMP 5427mAh
description: "SMP 5427mAh AS3GXXD3KB B54052"
compatible: "smp,c31n2313"

include: battery-smart.yaml

properties:
  enum-name:
    type: string
    default: "smp,c31n2313"

  # Fuel gauge
  manuf_name:
    default: "AS3GXXD3KB"
  device_name:
    default: "B54052"
  ship_mode_reg_addr:
    default: 0x00
  ship_mode_reg_data:
    default: [0x0010, 0x0010]
  # Charging/Discharging FETs Status
  # Register SBS_PackStatus_ACCESS (0x99)
  # Bit-3: XDSG
  # Bit-2: XCHG
  fet_reg_addr:
    default: 0x99
  fet_reg_mask:
    default: 0x0008
  fet_disconnect_val:
    default: 0x0008
  fet_cfet_mask:
    default: 0x04
  fet_cfet_off_val:
    default: 0x04

  # Battery info
  voltage_max:
    default: 13350
  voltage_normal:
    default: 11985
  voltage_min:
    default: 9000
  precharge_current:
    default: 256
  start_charging_min_c:
    default: 0
  start_charging_max_c:
    default: 45
  charging_min_c:
    default: 0
  charging_max_c:
    default: 60
  discharging_min_c:
    default: -20
  discharging_max_c:
    default: 60
```

## zephyr/dts/bindings/battery/smp,coslight_gh02047xl.yaml
```yaml
# Copyright 2022 The ChromiumOS Authors
# Use of this source code is governed by a BSD-style license that can be
# found in the LICENSE file.

description: "SMP COSLIGHT_GH02047XL"
compatible: "smp,coslight_gh02047xl"

include: battery-smart.yaml

properties:
  enum-name:
    type: string
    default: "smp,coslight_gh02047xl"

  # Fuel gauge
  manuf_name:
    default: "333-1C-DA-A"
  device_name:
    default: "GH02047XL"
  ship_mode_reg_addr:
    default: 0x00
  ship_mode_reg_data:
    default: [0x0010, 0x0010]
  flags:
    default: 0x04
  fet_reg_addr:
    default: 0x0
  fet_reg_mask:
    default: 0x0006
  fet_disconnect_val:
    default: 0x0
  fet_cfet_mask:
    default: 0x0004
  fet_cfet_off_val:
    default: 0x0

  # Battery info
  voltage_max:
    default: 8800
  voltage_normal:
    default: 7700
  voltage_min:
    default: 6000
  precharge_current:
    default: 256
  start_charging_min_c:
    default: 0
  start_charging_max_c:
    default: 45
  charging_min_c:
    default: 0
  charging_max_c:
    default: 45
  discharging_min_c:
    default: -10
  discharging_max_c:
    default: 60
```

## zephyr/dts/bindings/battery/smp,hptrf9h3.yaml
```yaml
# Copyright 2023 The ChromiumOS Authors
# Use of this source code is governed by a BSD-style license that can be
# found in the LICENSE file.

description: "SMP-HPT-3.65 DELL RF9H3"
compatible: "smp,hptrf9h3"

include: battery-smart.yaml

properties:
  enum-name:
    type: string
    default: "smp,hptrf9h3"

  # Fuel gauge
  manuf_name:
    default: "SMP-HPT-3.65"
  device_name:
    default: "DELL RF9H3"
  ship_mode_reg_addr:
    default: 0x00
  ship_mode_reg_data:
    default: [0x0010, 0x0010]
  fet_reg_addr:
    default: 0x43
  fet_reg_mask:
    default: 0x0003
  fet_disconnect_val:
    default: 0x0000
  fet_cfet_mask:
    default: 0x0002
  fet_cfet_off_val:
    default: 0x0000

  # Battery info
  voltage_max:
    default: 13200
  voltage_normal:
    default: 11400
  voltage_min:
    default: 9000
  precharge_current:
    default: 256
  start_charging_min_c:
    default: -3
  start_charging_max_c:
    default: 50
  charging_min_c:
    default: -3
  charging_max_c:
    default: 60
  discharging_min_c:
    default: -17
  discharging_max_c:
    default: 70
```

## zephyr/dts/bindings/battery/smp,kyogre3S.yaml
```yaml
# Copyright 2024 The ChromiumOS Authors
# Use of this source code is governed by a BSD-style license that can be
# found in the LICENSE file.

description: "SMP KYOGRE2S"
compatible: "smp,kyogre2s"

include: battery-smart.yaml

properties:
  enum-name:
    type: string
    default: "smp,kyogre2s"

  # Fuel gauge
  manuf_name:
    default: "SMP"
  device_name:
    default: "KYOGRE2S"
  ship_mode_reg_addr:
    default: 0x3A
  ship_mode_reg_data:
    default: [0xC574, 0xC574]
  flags:
    default: 0
  fet_reg_addr:
    default: 0x00
  fet_reg_mask:
    default: 0x4000
  fet_disconnect_val:
    default: 0x0000
  fet_cfet_mask:
    default: 0x8000
  fet_cfet_off_val:
    default: 0x0000

  # Battery info
  voltage_max:
    default: 9000
  voltage_normal:
    default: 7800
  voltage_min:
    default: 6000
  precharge_current:
    default: 204
  start_charging_min_c:
    default: 0
  start_charging_max_c:
    default: 45
  charging_min_c:
    default: 0
  charging_max_c:
    default: 60
  discharging_min_c:
    default: -20
  discharging_max_c:
    default: 60
```

## zephyr/dts/bindings/battery/smp,l20m3pg0.yaml
```yaml
# Copyright 2022 The ChromiumOS Authors
# Use of this source code is governed by a BSD-style license that can be
# found in the LICENSE file.

description: "SMP L20M3PG0"
compatible: "smp,l20m3pg0"

include: battery-smart.yaml

properties:
  enum-name:
    type: string
    default: "smp,l20m3pg0"

  # Fuel gauge
  manuf_name:
    default: "SMP"
  device_name:
    default: "L20M3PG0"
  ship_mode_reg_addr:
    default: 0x34
  ship_mode_reg_data:
    default: [0x0000, 0x1000]
  flags:
    default: 0
  fet_reg_addr:
    default: 0x34
  fet_reg_mask:
    default: 0x0100
  fet_disconnect_val:
    default: 0x0100

  # Battery info
  voltage_max:
    default: 13200
  voltage_normal:
    default: 11520
  voltage_min:
    default: 9000
  precharge_current:
    default: 256
  start_charging_min_c:
    default: 0
  start_charging_max_c:
    default: 45
  charging_min_c:
    default: 0
  charging_max_c:
    default: 60
  discharging_min_c:
    default: -20
  discharging_max_c:
    default: 50
```

## zephyr/dts/bindings/battery/smp,l20m3pg1.yaml
```yaml
# Copyright 2022 The ChromiumOS Authors
# Use of this source code is governed by a BSD-style license that can be
# found in the LICENSE file.

description: "SMP L20M30PG1"
compatible: "smp,l20m3pg1"

include: battery-smart.yaml

properties:
  enum-name:
    type: string
    default: "smp,l20m3pg1"

  # TI L20M3PG1 Fuel Gauge
  manuf_name:
    default: "SMP"
  device_name:
    default: "L20M3PG1"
  ship_mode_reg_addr:
    default: 0x00
  ship_mode_reg_data:
    default: [0x0010, 0x0010]
  flags:
    default: 0x04
  fet_reg_addr:
    default: 0x0054
  fet_reg_mask:
    default: 0x2000
  fet_disconnect_val:
    default: 0x2000
  fet_cfet_mask:
    default: 0x6000
  fet_cfet_off_val:
    default: 0x6000

  # Battery info
  voltage_max:
    default: 13200
  voltage_normal:
    default: 11520
  voltage_min:
    default: 9000
  precharge_current:
    default: 247
  start_charging_min_c:
    default: 0
  start_charging_max_c:
    default: 50
  charging_min_c:
    default: 0
  charging_max_c:
    default: 60
  discharging_min_c:
    default: -40
  discharging_max_c:
    default: 73
```
