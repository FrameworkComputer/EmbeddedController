## zephyr/dts/bindings/button/cros-ec,button-cfg.yaml
```yaml
# Copyright 2022 The Chromium OS Authors.
# Use of this source code is governed by a BSD-style license that can be
# found in the LICENSE file.
#
description: |
  Button config.
   - Name
   - Type
   - GPIO handle
   - Debounce time (us)
   - Flags

compatible: "cros-ec,button-cfg"

child-binding:
  description: Button configuration
  properties:
    button_name:
      type: string
      required: true
      description: Button name
    button_type:
      type: int
      required: false
      description: Keyboard button type
    spec:
      type: phandle
      required: true
    gpio_int:
      type: phandle
      required: false
    debounce_us:
      type: int
      required: true
      description: Debounce time in microseconds
    flags:
      type: int
      required: true
      description: The zephyr gpio interrupt config flags.
```

## zephyr/dts/bindings/cbi/cros-ec,cbi-fw-config.yaml
```yaml
# Copyright 2021 The Chromium OS Authors. All rights reserved.
# Use of this source code is governed by a BSD-style license that can be
# found in the LICENSE file.

description: CBI Firmware Config fields (FW_CONFIG)

compatible: "cros-ec,cbi-fw-config"

child-binding:
    description:
        ChromeOS CBI Firmware Config fields definition.
        Each field is defined via a start bit (from LSB) and a size.
        The total size of all FW_CONFIG bit fields must not exceed 32 bits.
        One default value for each field may be indicated.
    properties:
        enum-name:
            type: string
            required: true
            description:
              Name of field used for description purposes
        start:
            type: int
            required: true
            description: The starting bit of the field (LSB = 0)
        size:
            type: int
            required: true
            description: The size of the field in bits.

# Example:
#
# cbi-fw-config {
#     compatible = "cros-ec,cbi-fw-config";
#
#     fan {
#         enum-name = "FAN";
#         start = <0>
#         size = <1>;
#         fan_absent {
#             enum-name = "ABSENT"
#             compatible = "cros-ec,cbi-fw-config-value";
#             value = <0>;
#         fan_present {
#             enum-name = "PRESENT"
#             compatible = "cros-ec,cbi-fw-config-value";
#             value = <1>;
#             default;
#         };
#     };
# };
#
# This will generate an enum field id for CBI_FW_CONFIG_FIELD_FAN,
# and separate values for CBI_FW_CONFIG_FIELD_FAN_ABSENT = 0 and
# CBI_FW_CONFIG_FIELD_FAN_PRESENT = 1
```

## zephyr/dts/bindings/cbi/cros-ec,cbi-ssfc-value.yaml
```yaml
# Copyright 2021 The ChromiumOS Authors
# Use of this source code is governed by a BSD-style license that can be
# found in the LICENSE file.

description:
  Possible CBI SSFC field values.
  It has to be defined as grandchild on the "cros-ec,cbi-ssfc"

compatible: "cros-ec,cbi-ssfc-value"

properties:
  value:
    type: int
    required: true
    description:
      Unique value of CBI SSFC field
  default:
    type: boolean
    description:
      Indicates that the specified value is default for the parent
      CBI SSFC field node. It should appear only once for the CBI SSFC
      definition.
```

## zephyr/dts/bindings/cbi/cros-ec,cbi-ssfc.yaml
```yaml
# Copyright 2021 The ChromiumOS Authors
# Use of this source code is governed by a BSD-style license that can be
# found in the LICENSE file.

description: CBI Second Source Factory Cache (SSFC)

compatible: "cros-ec,cbi-ssfc"

child-binding:
  description:
    CBI SSFC fields definition.
    The order of the children in this node define the order
    of the SSFC bit fields from least significant bit to most
    significant bit. The total size of all SSFC bit fields
    must not exceed 32 bits.
  properties:
    enum-name:
      type: string
      required: true
      description:
        Enum values used only for description purposes
      enum:
      - AUDIO_CODEC
      - BASE_SENSOR
      - LID_SENSOR
      - LIGHTBAR
      - USB_SS_MUX
    size:
      type: int
      required: true
      description: The size of the field in bits.

# Example:
#
# cbi-ssfc {
#     compatible = "cros-ec,cbi-ssfc";
#
#     base_sensor {
#         enum-name = "BASE_SENSOR";
#         size = <3>;
#         bmi160 {
#             compatible = "cros-ec,cbi-ssfc-value";
#             status = "okay";
#
#             value = <1>;
#             devices = <&alt_base_accel &alt_base_gyro>;
#         };
#         kx022 {
#             compatible = "cros-ec,cbi-ssfc-value";
#             status = "okay";
#
#             value = <3>;
#             devices = <&base_accel_kx022>;
#         };
#     };
# };
```

## zephyr/dts/bindings/cbi/cros-ec-cbi-fw-config-value.yaml
```yaml
# Copyright 2021 The Chromium OS Authors. All rights reserved.
# Use of this source code is governed by a BSD-style license that can be
# found in the LICENSE file.

description:
    Possible CBI FW_CONFIG individual field values.
    It has to be defined as a grandchild on the "cros-ec,cbi-fw-config" nodes

compatible: "cros-ec,cbi-fw-config-value"

properties:
    enum-name:
        type: string
        required: true
        description:
            Name of the value used for description purposes
    value:
        type: int
        required: true
        description:
          Unique value within the parent CBI FW_CONFIG field
    default:
        type: boolean
        description:
          If set, this value will be the default value of this field
          if the FW_CONFIG data is invalid or unavailable. It must
          appear only once for any single field.
```

## zephyr/dts/bindings/cbi/named-cbi-ssfc-value.yaml
```yaml
# Copyright 2021 The Chromium OS Authors. All rights reserved.
# Use of this source code is governed by a BSD-style license that can be
# found in the LICENSE file.

description:
    Possible CBI SSFC field values.
    It has to be defied as grandchild on the "named-cbi-ssfc"

compatible: "named-cbi-ssfc-value"

properties:
    value:
        type: int
        required: true
        description:
          Unique value of CBI SSFC field
    default:
        type: boolean
        description:
          Indicates that the specified value is default for the parent
          CBI SSFC field node. It should appear only once for the CBI SSFC
          definition.
```

## zephyr/dts/bindings/cec/cros-ec,cec-bitbang.yaml
```yaml
# Copyright 2023 The ChromiumOS Authors
# Use of this source code is governed by a BSD-style license that can be
# found in the LICENSE file.

description: CEC port using the CrOS EC bitbang driver

compatible: "cros-ec,cec-bitbang"

include: base.yaml

properties:
  gpio-out:
    type: phandle
    required: true

  gpio-in:
    type: phandle
    required: true

  gpio-pull-up:
    type: phandle
    required: true
```

## zephyr/dts/bindings/cec/cros-ec,cec-it83xx.yaml
```yaml
# Copyright 2023 The ChromiumOS Authors
# Use of this source code is governed by a BSD-style license that can be
# found in the LICENSE file.

description: CEC port using the CrOS EC it83xx driver

compatible: "cros-ec,cec-it83xx"

include: base.yaml
```

## zephyr/dts/bindings/cec/cros-ec,cec-policy.yaml
```yaml
# Copyright 2025 The ChromiumOS Authors
# Use of this source code is governed by a BSD-style license that can be
# found in the LICENSE file.

description: CEC policy parent node

compatible: "cros-ec,cec-policy"

child-binding:
  description:
    CEC policy nodes to describe the policy combination a node depends on.
  properties:
    command:
      type: string
      required: true
      enum:
        - CEC_MSG_IMAGE_VIEW_ON
        - CEC_MSG_TEXT_VIEW_ON
        - CEC_MSG_ACTIVE_SOURCE
        - CEC_MSG_REPORT_PHYSICAL_ADDRESS
        - CEC_MSG_DEVICE_VENDOR_ID
        - CEC_MSG_REQUEST_ACTIVE_SOURCE
        - CEC_MSG_SET_STREAM_PATH
    action:
      type: string
      required: true
      description:
        Source of valid reference actions is "enum cec_action” found in
        include/cec.
      enum:
        - CEC_ACTION_NONE
        - CEC_ACTION_POWER_BUTTON
```

## zephyr/dts/bindings/cec/cros-ec,cec.yaml
```yaml
# Copyright 2023 The ChromiumOS Authors
# Use of this source code is governed by a BSD-style license that can be
# found in the LICENSE file.

description: CEC port

compatible: "cros-ec,cec"

include: base.yaml

properties:
  drv:
    type: string
    description:
      CrOS EC driver used for this CEC port
    enum:
      - "it83xx_cec_drv"
```
