## zephyr/dts/bindings/battery/smp,l21m4pg0.yaml
```yaml
# Copyright 2023 The ChromiumOS Authors
# Use of this source code is governed by a BSD-style license that can be
# found in the LICENSE file.

description: "SMP L21M4PG0"
compatible: "smp,l21m4pg0"

include: battery-smart.yaml

properties:
  enum-name:
    type: string
    default: "smp,l21m4pg0"

  # Fuel gauge
  manuf_name:
    default: "SMP"
  device_name:
    default: "L21M4PG0"
  ship_mode_reg_addr:
    default: 0x34
  ship_mode_reg_data:
    default: [0x0000, 0x1000]
  flags:
    default: 0
  fet_reg_addr:
    default: 0x34
  fet_reg_mask:
    default: 0x0100
  fet_disconnect_val:
    default: 0x0100

  # Battery info
  voltage_max:
    default: 8900
  voltage_normal:
    default: 7720
  voltage_min:
    default: 6000
  precharge_current:
    default: 274
  start_charging_min_c:
    default: 0
  start_charging_max_c:
    default: 50
  charging_min_c:
    default: 0
  charging_max_c:
    default: 60
  discharging_min_c:
    default: -20
  discharging_max_c:
    default: 60
```

## zephyr/dts/bindings/battery/smp,l22m3pg0.yaml
```yaml
# Copyright 2022 The ChromiumOS Authors
# Use of this source code is governed by a BSD-style license that can be
# found in the LICENSE file.

description: "SMP L22M3PG0"
compatible: "smp,l22m3pg0"

include: battery-smart.yaml

properties:
  enum-name:
    type: string
    default: "smp,l22m3pg0"

  # Fuel gauge
  manuf_name:
    default: "SMP"
  device_name:
    default: "L22M3PG0"
  ship_mode_reg_addr:
    default: 0x34
  ship_mode_reg_data:
    default: [0x0000, 0x1000]
  flags:
    default: 0
  fet_reg_addr:
    default: 0x00
  fet_reg_mask:
    default: 0x0018
  fet_disconnect_val:
    default: 0x0000

  # Battery info
  voltage_max:
    default: 13200
  voltage_normal:
    default: 11310
  voltage_min:
    default: 9000
  precharge_current:
    default: 208
  start_charging_min_c:
    default: 0
  start_charging_max_c:
    default: 50
  charging_min_c:
    default: 0
  charging_max_c:
    default: 60
  discharging_min_c:
    default: -20
  discharging_max_c:
    default: 60
```

## zephyr/dts/bindings/battery/smp,l23m4pg4.yaml
```yaml
# Copyright 2024 The ChromiumOS Authors
# Use of this source code is governed by a BSD-style license that can be
# found in the LICENSE file.

description: "SMP L23M4PG4"
compatible: "smp,l23m4pg4"

include: battery-smart.yaml

properties:
  enum-name:
    type: string
    default: "smp,l23m4pg4"

  # Fuel gauge
  manuf_name:
    default: "SMP"
  device_name:
    default: "L23M4PG4"
  ship_mode_reg_addr:
    default: 0x34
  ship_mode_reg_data:
    default: [0x0000, 0x1000]
  flags:
    default: 0
  fet_reg_addr:
    default: 0x00
  fet_reg_mask:
    default: 0x0018
  fet_disconnect_val:
    default: 0x0000

  # Battery info
  voltage_max:
    default: 8800
  voltage_normal:
    default: 7720
  voltage_min:
    default: 6000
  precharge_current:
    default: 790
  start_charging_min_c:
    default: 0
  start_charging_max_c:
    default: 50
  charging_min_c:
    default: 0
  charging_max_c:
    default: 60
  discharging_min_c:
    default: -20
  discharging_max_c:
    default: 60
```

## zephyr/dts/bindings/battery/smp,pc-vp-bp153.yaml
```yaml
# Copyright 2022 The ChromiumOS Authors
# Use of this source code is governed by a BSD-style license that can be
# found in the LICENSE file.

description: "SMP PC-VP-BP153"
compatible: "smp,pc-vp-bp153"

include: battery-smart.yaml

properties:
  enum-name:
    type: string
    default: "smp,pc-vp-bp153"

  # Fuel gauge
  manuf_name:
    default: "SIMPLO"
  device_name:
    default: "PC-VP-BP153"
  ship_mode_reg_addr:
    default: 0x34
  ship_mode_reg_data:
    default: [0x0000, 0x1000]
  flags:
    default: 0
  fet_reg_addr:
    default: 0x00
  fet_reg_mask:
    default: 0x10
  fet_disconnect_val:
    default: 0x00

  # Battery info
  voltage_max:
    default: 8800
  voltage_normal:
    default: 7680
  voltage_min:
    default: 6000
  precharge_current:
    default: 128
  start_charging_min_c:
    default: 0
  start_charging_max_c:
    default: 50
  charging_min_c:
    default: 0
  charging_max_c:
    default: 60
  discharging_min_c:
    default: -20
  discharging_max_c:
    default: 70
```

## zephyr/dts/bindings/battery/smp,pg01nl3353.yaml
```yaml
# Copyright 2024 The ChromiumOS Authors
# Use of this source code is governed by a BSD-style license that can be
# found in the LICENSE file.

description: "SMP PG01NL3353"
compatible: "smp,pg01nl3353"

include: battery-smart.yaml

properties:
  enum-name:
    type: string
    default: "smp,pg01nl3353"

  # Fuel gauge
  manuf_name:
    default: "PG01NL3353"
  device_name:
    default: "CA11J58"
  ship_mode_reg_addr:
    default: 0x00
  ship_mode_reg_data:
    default: [0x0010, 0x0010]
  flags:
    default: 0x04
  fet_reg_addr:
    default: 0x0
  fet_reg_mask:
    default: 0x2000
  fet_disconnect_val:
    default: 0x2000
  fet_cfet_mask:
    default: 0x4000
  fet_cfet_off_val:
    default: 0x4000

  # Battery info
  voltage_max:
    default: 8800
  voltage_normal:
    default: 7700
  voltage_min:
    default: 6000
  precharge_current:
    default: 128
  start_charging_min_c:
    default: 0
  start_charging_max_c:
    default: 45
  charging_min_c:
    default: 0
  charging_max_c:
    default: 60
  discharging_min_c:
    default: -20
  discharging_max_c:
    default: 70
```

## zephyr/dts/bindings/battery/smp,smp-hpt-4.122.yaml
```yaml
# Copyright 2024 The ChromiumOS Authors
# Use of this source code is governed by a BSD-style license that can be
# found in the LICENSE file.

description: "SMP SMP-HPT-4.122"
compatible: "smp,smp-hpt-4-122"

include: battery-smart.yaml

properties:
  enum-name:
    type: string
    default: "smp,smp-hpt-4-122"

  # Fuel gauge
  manuf_name:
    default: "SMP-HPT4.122"
  device_name:
    default: "DELL X95KV"
  ship_mode_reg_addr:
    default: 0x00
  ship_mode_reg_data:
    default: [0x0010, 0x0010]
  flags:
    default: 0x000c
  fet_reg_addr:
    default: 0x0054
  fet_reg_mask:
    default: 0x0006
  fet_disconnect_val:
    default: 0x0000
  fet_cfet_mask:
    default: 0x0004
  fet_cfet_off_val:
    default: 0x0000


  # Battery info
  voltage_max:
    default: 13200
  voltage_normal:
    default: 11250
  voltage_min:
    default: 9000
  precharge_current:
    default: 256
  start_charging_min_c:
    default: -3
  start_charging_max_c:
    default: 50
  charging_min_c:
    default: -3
  charging_max_c:
    default: 50
  discharging_min_c:
    default: -17
  discharging_max_c:
    default: 70
```

## zephyr/dts/bindings/battery/sunwoda,333-cf-32-a.yaml
```yaml
# Copyright 2024 The ChromiumOS Authors
# Use of this source code is governed by a BSD-style license that can be
# found in the LICENSE file.

description: "Sunwoda 333-CF-32-A"
compatible: "sunwoda,333-cf-32-a"

include: battery-smart.yaml

properties:
  enum-name:
    type: string
    default: "sunwoda,333-cf-32-a"

  # Fuel gauge
  manuf_name:
    default: "333-CF-32-A"
  device_name:
    default: "AE03041XL"
  ship_mode_reg_addr:
    default: 0x00
  ship_mode_reg_data:
    default: [0x0010, 0x0010]
  flags:
    default: 0x04
  fet_reg_addr:
    default: 0x00
  fet_reg_mask:
    default: 0x0006
  fet_disconnect_val:
    default: 0x0000
  fet_cfet_mask:
    default: 0x0004
  fet_cfet_off_val:
    default: 0x0000


  # Battery info
  voltage_max:
    default: 13200
  voltage_normal:
    default: 11250
  voltage_min:
    default: 9000
  precharge_current:
    default: 256
  start_charging_min_c:
    default: 0
  start_charging_max_c:
    default: 45
  charging_min_c:
    default: 0
  charging_max_c:
    default: 46
  discharging_min_c:
    default: -10
  discharging_max_c:
    default: 60
```

## zephyr/dts/bindings/battery/sunwoda,atl3rr09.yaml
```yaml
description: "SUNWODA SWD-ATL4.242"
compatible: "sunwoda,atl3rr09"

include: battery-smart.yaml

properties:
   enum-name:
      type: string
      default: "sunwoda,atl3rr09"

   # Fuel Gauge
   manuf_name:
      default: "SWD-ATL4.242"
   device_name:
      default: "DELL 3RR09"
   ship_mode_reg_addr:
      default: 0x00
   ship_mode_reg_data:
      default: [ 0x0010, 0x0010 ]
   fet_mfgacc_support:
      default: 0
   fet_reg_addr:
      default: 0x54
   fet_reg_mask:
      default: 0x0002
   fet_disconnect_val:
      default: 0x0000
   fet_cfet_mask:
      default: 0x0004
   fet_cfet_off_val:
      default: 0x0000

   # Battery info
   voltage_max:
      default: 17800
   voltage_normal:
      default: 15200
   voltage_min:
      default: 12000
   precharge_current:
      default: 256
   start_charging_min_c:
      default: 0
   start_charging_max_c:
      default: 45
   charging_min_c:
      default: -3
   charging_max_c:
      default: 50
   discharging_min_c:
      default: -5
   discharging_max_c:
      default: 70
```

## zephyr/dts/bindings/battery/sunwoda,cosvkyjx.yaml
```yaml
description: "SUNWODA SWD-COS3.661"
compatible: "sunwoda,cosvkyjx"

include: battery-smart.yaml

properties:
  enum-name:
    type: string
    default: "sunwoda,cosvkyjx"

  # Fuel Gauge
  manuf_name:
    default: "SWD-COS3.661"
  device_name:
    default: "DELL VKYJX"
  ship_mode_reg_addr:
    default: 0x00
  ship_mode_reg_data:
    default: [0x0010, 0x0010]
  flags:
    default: 0x0c
  fet_reg_addr:
    default: 0x54
  fet_reg_mask:
    default: 0x0002
  fet_disconnect_val:
    default: 0x0000
  fet_cfet_mask:
    default: 0x0004
  fet_cfet_off_val:
    default: 0x0000

  # Battery info
  voltage_max:
    default: 17600
  voltage_normal:
    default: 15000
  voltage_min:
    default: 12000
  precharge_current:
    default: 256
  start_charging_min_c:
    default: 0
  start_charging_max_c:
    default: 45
  charging_min_c:
    default: -3
  charging_max_c:
    default: 50
  discharging_min_c:
    default: -5
  discharging_max_c:
    default: 70
```

## zephyr/dts/bindings/battery/sunwoda,ctgkt.yaml
```yaml
# Copyright 2023 The ChromiumOS Authors
# Use of this source code is governed by a BSD-style license that can be
# found in the LICENSE file.

description: "SWD-ATL3.618 DELL CTGKT"
compatible: "sunwoda,ctgkt"

include: battery-smart.yaml

properties:
  enum-name:
    type: string
    default: "sunwoda,ctgkt"

  # Fuel Gauge
  manuf_name:
    default: "SWD-ATL3.618"
  device_name:
    default: "DELL CTGKT"
  ship_mode_reg_addr:
    default: 0x44
  ship_mode_reg_data:
    default: [0x0010, 0x0010]
  flags:
    default: 0x0d
  fet_reg_addr:
    default: 0x0054
  fet_reg_mask:
    default: 0x0006
  fet_disconnect_val:
    default: 0x0000
  fet_cfet_mask:
    default: 0x0004
  fet_cfet_off_val:
    default: 0x0000

  # Battery info
  voltage_max:
    default: 13200
  voltage_normal:
    default: 11400
  voltage_min:
    default: 9000
  precharge_current:
    default: 256
  start_charging_min_c:
    default: 0
  start_charging_max_c:
    default: 50
  charging_min_c:
    default: -3
  charging_max_c:
    default: 60
  discharging_min_c:
    default: -5
  discharging_max_c:
    default: 70
```

## zephyr/dts/bindings/battery/sunwoda,l21d2pg2.yaml
```yaml
# Copyright 2023 The ChromiumOS Authors
# Use of this source code is governed by a BSD-style license that can be
# found in the LICENSE file.

description: "SUNWODA L21D2PG2"
compatible: "sunwoda,l21d2pg2"

include: battery-smart.yaml

properties:
  enum-name:
    type: string
    default: "sunwoda,l21d2pg2"

  # Fuel gauge
  manuf_name:
    default: "Sunwoda"
  device_name:
    default: "L21D2PG2"
  ship_mode_reg_addr:
    default: 0x34
  ship_mode_reg_data:
    default: [0x0000, 0x1000]
  flags:
    default: 0x04
  fet_reg_addr:
    default: 0x34
  fet_reg_mask:
    default: 0x0100
  fet_disconnect_val:
    default: 0x0000

  # Battery info
  voltage_max:
    default: 8860
  voltage_normal:
    default: 7700
  voltage_min:
    default: 6000
  precharge_current:
    default: 200
  start_charging_min_c:
    default: 0
  start_charging_max_c:
    default: 50
  charging_min_c:
    default: 0
  charging_max_c:
    default: 63
  discharging_min_c:
    default: -20
  discharging_max_c:
    default: 63
```

## zephyr/dts/bindings/battery/sunwoda,l22d3pg0.yaml
```yaml
# Copyright 2022 The ChromiumOS Authors
# Use of this source code is governed by a BSD-style license that can be
# found in the LICENSE file.

description: "SUNWODA L22D3PG0"
compatible: "sunwoda,l22d3pg0"

include: battery-smart.yaml

properties:
  enum-name:
    type: string
    default: "sunwoda,l22d3pg0"

  # Fuel gauge
  manuf_name:
    default: "Sunwoda"
  device_name:
    default: "L22D3PG0"
  ship_mode_reg_addr:
    default: 0x34
  ship_mode_reg_data:
    default: [0x0000, 0x1000]
  flags:
    default: 0
  fet_reg_addr:
    default: 0x00
  fet_reg_mask:
    default: 0x0018
  fet_disconnect_val:
    default: 0x0000

  # Battery info
  voltage_max:
    default: 13200
  voltage_normal:
    default: 11310
  voltage_min:
    default: 9000
  precharge_current:
    default: 209
  start_charging_min_c:
    default: 0
  start_charging_max_c:
    default: 50
  charging_min_c:
    default: 0
  charging_max_c:
    default: 60
  discharging_min_c:
    default: -20
  discharging_max_c:
    default: 60
```

## zephyr/dts/bindings/battery/utl,hq24u2s1p3l.yaml
```yaml
# Copyright 2025 The ChromiumOS Authors
# Use of this source code is governed by a BSD-style license that can be
# found in the LICENSE file.

description: "UTL HQ24U2S1P3L"
compatible: "utl,hq24u2s1p3l"

include: battery-smart.yaml

properties:
  enum-name:
    type: string
    default: "utl,hq24u2s1p3l"

  # Fuel gauge
  manuf_name:
    default: "UTL"
  device_name:
    default: "HQ24U2S1P3L"
  ship_mode_reg_addr:
    default: 0x00
  ship_mode_reg_data:
    default: [0x0010, 0x0010]

  flags:
    default: 0x0c
  fet_reg_addr:
    default: 0x0054
  fet_reg_mask:
    default: 0x0002
  fet_disconnect_val:
    default: 0x0000
  fet_cfet_mask:
    default: 0x0004
  fet_cfet_off_val:
    default: 0x0000

  # Battery info
  voltage_max:
    default: 8800
  voltage_normal:
    default: 7700
  voltage_min:
    default: 6000
  precharge_current:
    default: 193
  start_charging_min_c:
    default: 0
  start_charging_max_c:
    default: 45
  charging_min_c:
    default: 0
  charging_max_c:
    default: 45
  discharging_min_c:
    default: -20
  discharging_max_c:
    default: 60
```

## zephyr/dts/bindings/battery/utl,hq24u3s1p3i.yaml
```yaml
# Copyright 2025 The ChromiumOS Authors
# Use of this source code is governed by a BSD-style license that can be
# found in the LICENSE file.

description: "UTL,HQ24U3S1P3I"
compatible: "utl,hq24u3s1p3i"

include: battery-smart.yaml

properties:
  enum-name:
    type: string
    default: "utl,hq24u3s1p3i"

  # Fuel gauge
  manuf_name:
    default: "UTL"
  device_name:
    default: "HQ24U3S1P3I"
  ship_mode_reg_addr:
    default: 0x00
  ship_mode_reg_data:
    default: [0x0010, 0x0010]
  flags:
    default: 0x04
  fet_reg_addr:
    default: 0x0054
  fet_reg_mask:
    default: 0x0002
  fet_disconnect_val:
    default: 0x0000
  fet_cfet_mask:
    default: 0x0004
  fet_cfet_off_val:
    default: 0x0000

  # Battery info
  voltage_max:
    default: 12600
  voltage_normal:
    default: 11100
  voltage_min:
    default: 9000
  precharge_current:
    default: 178
  start_charging_min_c:
    default: 0
  start_charging_max_c:
    default: 60
  charging_min_c:
    default: 0
  charging_max_c:
    default: 60
  discharging_min_c:
    default: -20
  discharging_max_c:
    default: 60
```

## zephyr/dts/bindings/bridge/analogix,anx7510.yaml
```yaml
# Copyright 2024 The ChromiumOS Authors
# Use of this source code is governed by a BSD-style license that can be
# found in the LICENSE file.

description: Analogix ANX7510 DP to HDMI Bridge

compatible: "analogix,anx7510"

include: i2c-device.yaml
```
