## zephyr/dts/bindings/charger/chg-chip.yaml
```yaml
# Copyright 2022 The ChromiumOS Authors
# SPDX-License-Identifier: Apache-2.0

description: Charger chip

include: i2c-device.yaml

# Example
# The charger chips nodes have to be placed under the USB-C
# nodes(named-usbc-port).If the OCPC(on-charger per type-c port) config is
# enabled, the charger chips has to be defiend per USB-C port, with the primary
# one defined under port 0. If the CHARGER_SINGLE_CHIP config is enabled, only
# one charger chip must be defined. It has to be done under the port 0.
# For OCPC:
#	usbc {
#		#address-cells = <1>;
#		#size-cells = <0>;
#
#		port0@0 {
#			compatible = "named-usbc-port";
#			reg = <0>;
#			bc12 = <&bc12_port0>;
#			chg = <&chg_port0>;
#		};
#		port1@1 {
#			compatible = "named-usbc-port";
#			reg = <1>;
#			bc12 = <&bc12_port1>;
#			chg = <&chg_port1>;
#		};
#	};
#
#	&i2c5 {
#		chg_port0: sm5803@32 {
#			compatible = "siliconmitus,sm5803";
#			status = "okay";
#			reg = <0x32>;
#		};
#	};
#
#	&i2c4 {
#		chg_port1: sm5803@32 {
#			compatible = "siliconmitus,sm5803";
#			status = "okay";
#			reg = <0x32>;
#		};
#	};
#
# For CHARGER_SINGLE_CHIP:
#	usbc {
#		#address-cells = <1>;
#		#size-cells = <0>;
#
#		port0@0 {
#			compatible = "named-usbc-port";
#			reg = <0>;
#			chg = <&charger>;
#		};
#		port1@1 {
#			compatible = "named-usbc-port";
#			reg = <1>;
#			bc12 = <&bc12_port1>;
#		};
#	};
#
#	&i2c5 {
#		charger: sm5803@32 {
#			compatible = "siliconmitus,sm5803";
#			status = "okay";
#			reg = <0x32>;
#		};
#	};
```

## zephyr/dts/bindings/charger/intersil,isl9238.yaml
```yaml
# Copyright 2021 The Chromium OS Authors. All rights reserved.
# Use of this source code is governed by a BSD-style license that can be
# found in the LICENSE file.

description: Intersil ISL9238 Charger IC

compatible: "intersil,isl9238"

include: i2c-device.yaml
```

## zephyr/dts/bindings/charger/intersil,isl923x.yaml
```yaml
# Copyright 2021 The Chromium OS Authors. All rights reserved.
# Use of this source code is governed by a BSD-style license that can be
# found in the LICENSE file.

description: Intersil ISL923x Charger IC

compatible: "intersil,isl923x"

include: chg-chip.yaml
```

## zephyr/dts/bindings/charger/intersil,isl9241.yaml
```yaml
# Copyright 2021 The ChromiumOS Authors
# Use of this source code is governed by a BSD-style license that can be
# found in the LICENSE file.

description: Intersil ISL9241 Charger IC

compatible: "intersil,isl9241"

include: chg-chip.yaml
```

## zephyr/dts/bindings/charger/richtek,rt9490.yaml
```yaml
# Copyright 2022 The ChromiumOS Authors
# Use of this source code is governed by a BSD-style license that can be
# found in the LICENSE file.

description: Richtek RT9490 Charger

compatible: "richtek,rt9490"

include: chg-chip.yaml

properties:
  irq:
    type: phandles
    description: |
        GPIO interrupt from BC1.2

  thermistor:
    type: phandle
    description: Underlying thermistor device to measure temperature

  eoc-current:
    type: int
    default: 240
    description: End-of-charge current in mA, between 40 to 1000.

  mivr:
    type: int
    default: 3800
    description: Minimum input voltage regulation in mV, between 3600 to 22000.

  boost-voltage:
    type: int
    default: 5050
    description: OTG voltage limit regulation in mV, between 2800 to 22000.

  boost-current:
    type: int
    default: 1500
    description: OTG current limit regulation in mA, between 120 to 3320.
```

## zephyr/dts/bindings/charger/siliconmitus,sm5803.yaml
```yaml
# Copyright 2022 The ChromiumOS Authors
# Use of this source code is governed by a BSD-style license that can be
# found in the LICENSE file.

description: Silicon Mitus SM5803 Charger

compatible: "siliconmitus,sm5803"

include: chg-chip.yaml
```

## zephyr/dts/bindings/charger/ti,bq25710.yaml
```yaml
# Copyright 2022 The ChromiumOS Authors
# Use of this source code is governed by a BSD-style license that can be
# found in the LICENSE file.

description: TI BQ25710 Charger

compatible: "ti,bq25710"

include: chg-chip.yaml
```

## zephyr/dts/bindings/console/ec-console.yaml
```yaml
# Copyright 2021 The ChromiumOS Authors
# Use of this source code is governed by a BSD-style license that can be
# found in the LICENSE file.

description: EC Console node

compatible: "ec-console"

properties:
  disabled:
    type: string-array
    description:
      List of EC channel names that are disabled in the output by default.
```

## zephyr/dts/bindings/cros_bbram/named-bbram-regions.yaml
```yaml
# Copyright 2021 Google LLC
# SPDX-License-Identifier: Apache-2.0
description: Named battery-backed RAM parent node

compatible: "named-bbram-regions"

child-binding:
    description: Named battery-backed RAM child node
    properties:
        offset:
            type: int
            required: true
        size:
            type: int
            required: true
```

## zephyr/dts/bindings/cros_dbg/nuvoton,npcx-cros-dbg.yaml
```yaml
# Copyright 2021 Google LLC
# SPDX-License-Identifier: Apache-2.0

description: Nuvoton, NPCX Debug Interface

compatible: "nuvoton,npcx-cros-dbg"

include: [base.yaml, pinctrl-device.yaml]


properties:
    reg:
        required: true

    pinctrl-0:
        required: true

    pinctrl-names:
        required: true
```

## zephyr/dts/bindings/cros_displight/cros-ec,displight.yaml
```yaml
# Copyright 2022 The ChromiumOS Authors
# Use of this source code is governed by a BSD-style license that can be
# found in the LICENSE file.

description: Display backlight configuration

compatible: "cros-ec,displight"

include: base.yaml

properties:
  pwms:
    type: phandle-array
    required: true
    description: PWM controlling the display backlight level.

  generic-pwm-channel:
    type: int
    description: Generic PWM channel number for legacy compatibility.
```

## zephyr/dts/bindings/cros_flash/cros-ec,cros-flash.yaml
```yaml
# Copyright 2023 Google LLC
# SPDX-License-Identifier: Apache-2.0

description: Generic cros-flash node

compatible: "cros-ec,cros-flash"

include: cros-flash-controller.yaml
```

## zephyr/dts/bindings/cros_flash/cros-ec,flash-layout.yaml
```yaml
# Copyright 2021 The ChromiumOS Authors
# Use of this source code is governed by a BSD-style license that can be
# found in the LICENSE file.

description: Describes the size and offset of the RO and RW regions

compatible: "cros-ec,flash-layout"

include: base.yaml

properties:
  type:
    type: string
    required: true
    description: >-
      A property required by the binman utility, defined here only to
      prevent Zephyr's binding generator from erroring about
      additional properties.

      The property should be set to the value "section" (done by
      binman.dtsi) and should not be used anywhere in C code.

      See README.entries in binman for a description of what binman
      uses this for.
  offset:
    type: int
    description: >-
      The offset of the flash region from the base of the flash.
  offset-from-elf:
    type: compound
    description: >-
      The offset of an entry based on a symbol value in an another entry.
      The format is <&phandle>, "sym_name", <offset> where phandle is the entry
      containing the blob (with associated ELF file providing symbols), <sym_name>
      is the symbol to lookup (relative to elf-base-sym) and <offset> is an offset
      to add to that value.

      Note that this format is not a supported pattern in Zephyr. Use the type
      "compound" which a dummy type for properties that don't fit any of the
      supported patterns.
  size:
    type: int
    required: true
    description: >-
      The size of the flash region, in bytes.
  read-only:
    type: boolean
    description: >-
      Set if the section should be read-only.
  preserve:
    type: boolean
    description: >-
      Set if the section should be preserved when updating firmware. This is
      just a signal. Enforcement of this is upto the updater.
  overlap:
    type: boolean
    description: >-
      Indicates that this entry overlaps with others in the same section. These
      entries should appear at the end of the section. Overlapping entries are not
      packed with other entries, but their contents are written over other entries
      in the section. Overlapping entries must have an explicit offset and size.
  fill-byte:
    type: uint8-array
    description: >-
      Set if the section bytes should be filled with configured byte value.
  pad-byte:
    type: int
    description: >-
      Set the pad byte to use when padding in the region. It
      defaults to 0. To use 0xff, you would add 'pad-byte = <0xff>'.
  filename:
    type: string
    description: >-
      This allows the contents of the section to be written to a file in the
      output directory. This can sometimes be useful to use the data in one
      section in different image, since there is currently no way to share data
      beteen images other than through files.
  image-size:
    type: int
    description: >-
      Set the image size to use when preforming read and write to the region
      through drivers, in bytes.
```

## zephyr/dts/bindings/cros_flash/cros-flash-controller.yaml
```yaml
# Copyright 2020 Google LLC
# SPDX-License-Identifier: Apache-2.0

# Common fields for Chrome OS flash devices

include: base.yaml

bus: crosflash

properties:
    label:
      required: true
```

## zephyr/dts/bindings/cros_flash/microchip,xec-cros-flash.yaml
```yaml
# Copyright 2022 The Chromium OS Authors. All rights reserved.
# Use of this source code is governed by a BSD-style license that can be
# found in the LICENSE file.

description: Microchip, XEC-cros-flash node

compatible: "microchip,xec-cros-flash"

include: cros-flash-controller.yaml
```

## zephyr/dts/bindings/cros_flash/nuvoton,npcx-cros-flash.yaml
```yaml
# Copyright 2020 Google LLC
# SPDX-License-Identifier: Apache-2.0

description: Nuvoton, NPCX-cros-flash node

compatible: "nuvoton,npcx-cros-flash"

include: cros-flash-controller.yaml
```

## zephyr/dts/bindings/cros_kb_raw/cros-kb-raw-controller.yaml
```yaml
# Copyright 2020 Google LLC
# SPDX-License-Identifier: Apache-2.0

# Common fields for Chrome OS raw keyboard devices

include: base.yaml

bus: croskb

properties:
    label:
      required: true
```

## zephyr/dts/bindings/cros_kb_raw/ite,it8xxx2-cros-kb-raw.yaml
```yaml
# Copyright 2022 Google LLC
# SPDX-License-Identifier: Apache-2.0

description: ITE, it8xxx2-cros-kb-raw node

compatible: "ite,it8xxx2-cros-kb-raw"

include: cros-kb-raw-controller.yaml

properties:
    reg:
      required: true

    interrupts:
      required: true

    wucctrl:
      type: phandles
      description: |
        Configure wakeup controller, this controller is used to set that
        when the interrupt is triggered in EC low power mode, it can wakeup
        EC or not. Via this controller, we set the wakeup trigger edge,
        enable, disable, and clear wakeup status for the specific pin which
        may be gpio pins or alternate pins.
```

## zephyr/dts/bindings/cros_kb_raw/microchip,xec-cros-kb-raw.yaml
```yaml
# Copyright 2022 The Chromium OS Authors. All rights reserved.
# Use of this source code is governed by a BSD-style license that can be
# found in the LICENSE file.

description: Microchip, xec-cros-kb-raw node

compatible: "microchip,xec-cros-kb-raw"

include: [cros-kb-raw-controller.yaml, pinctrl-device.yaml]

properties:
    reg:
        required: true

    pinctrl-0:
      required: true

    pinctrl-names:
      required: true
```

## zephyr/dts/bindings/cros_kb_raw/nuvoton,npcx-cros-kb-raw.yaml
```yaml
# Copyright 2020 Google LLC
# SPDX-License-Identifier: Apache-2.0

description: Nuvoton, NPCX-cros-kb-raw node

compatible: "nuvoton,npcx-cros-kb-raw"

include: cros-kb-raw-controller.yaml

properties:
    reg:
        required: true

    clocks:
        required: true

    pinctrl-0:
        type: phandles
        required: true
        description: configurations of pinmux controllers

    wui_maps:
        type: phandles
        required: true
        description: |
            Mapping table between Wake-Up Input (WUI) and 8 IOs belong to this device.
            Please notice not all IOs connect to WUIs.

            In this case, it will be presented by wui_none.
            For example the WUI mapping on NPCX7 KSI pads would be
               wui_maps = <&wui_io30 &wui_io31 &wui_io27 &wui_io26
                           &wui_io25 &wui_io24 &wui_io23 &wui_io22>;
```

## zephyr/dts/bindings/cros_mkbp_event/cros-ec,mkbp-event-wakeup-mask.yaml
```yaml
# Copyright 2022 Google LLC
# Use of this source code is governed by a BSD-style license that can be
# found in the LICENSE file.

description: EC MKBP event wakeup node

compatible: "cros-ec,mkbp-event-wakeup-mask"

include: ["ec-event-wakeup-mask-base.yaml"]
```

## zephyr/dts/bindings/cros_mkbp_event/cros-ec,mkbp-host-event-wakeup-mask.yaml
```yaml
# Copyright 2022 Google LLC
# Use of this source code is governed by a BSD-style license that can be
# found in the LICENSE file.

description: EC MKBP host event wakeup node

compatible: "cros-ec,mkbp-host-event-wakeup-mask"

include: ["ec-event-wakeup-mask-base.yaml"]
```

## zephyr/dts/bindings/cros_mkbp_event/ec-event-wakeup-mask-base.yaml
```yaml
# Copyright 2021 The ChromiumOS Authors
# Use of this source code is governed by a BSD-style license that can be
# found in the LICENSE file.

# Common fields for EC MKBP event nodes

properties:
  wakeup-mask:
    type: int
    default: 0
    description:
      Define the MKBP or host events that will wake up the application
      processor from suspend mode.
      e.g.
      ec-mkbp-host-event-wakeup-mask {
        compatible = "cros-ec,mkbp-host-event-wakeup-mask";
        wakeup-mask = <(
          HOST_EVENT_LID_OPEN |
          HOST_EVENT_POWER_BUTTON |
          HOST_EVENT_AC_CONNECTED |
          HOST_EVENT_AC_DISCONNECTED |
          HOST_EVENT_HANG_DETECT |
          HOST_EVENT_RTC |
          HOST_EVENT_MODE_CHANGE |
          HOST_EVENT_DEVICE)>;
      };
```

## zephyr/dts/bindings/cros_mkbp_event/ec-mkbp-event.yaml
```yaml
# Copyright 2021 The Chromium OS Authors. All rights reserved.
# Use of this source code is governed by a BSD-style license that can be
# found in the LICENSE file.

description: EC MKBP Event node

compatible: "ec-wake-mask-event"

properties:
  wakeup-mask:
    required: false
    type: int
    default: 0
    description:
      Define the MKBP or host events that will wake up the application
      processor from suspend mode.
```

## zephyr/dts/bindings/cros_pwr_signal/mediatek,mt8188-power-signal-list.yaml
```yaml
# Copyright 2023 Google LLC
# SPDX-License-Identifier: Apache-2.0

description: MediaTek MT8188, Power Signal List
compatible: "mediatek,mt8188-power-signal-list"

include: power-signal-list.yaml

properties:
  power-signals-required:
    default: 5

child-binding:
  properties:
    power-enum-name:
      enum:
        - AP_IN_RST
        - AP_IN_S3
        - AP_WDT_ASSERTED
        - AP_WARM_RST_REQ
        - PG_PP4200_S5
```
