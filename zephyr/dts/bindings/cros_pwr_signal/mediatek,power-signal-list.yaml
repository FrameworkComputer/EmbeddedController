## zephyr/dts/bindings/cros_pwr_signal/mediatek,power-signal-list.yaml
```yaml
# Copyright 2021 Google LLC
# SPDX-License-Identifier: Apache-2.0

description: MediaTek, Power Signal List
compatible: "mediatek,power-signal-list"

include: power-signal-list.yaml

properties:
  power-signals-required:
    default: 3

child-binding:
  properties:
    power-enum-name:
      enum:
        - AP_IN_S3_L
        - AP_WDT_ASSERTED
        - PMIC_PWR_GOOD
```

## zephyr/dts/bindings/cros_pwr_signal/mt8186,power-signal-list.yaml
```yaml
# Copyright 2021 Google LLC
# SPDX-License-Identifier: Apache-2.0

description: MediaTek MT8186, Power Signal List
compatible: "mt8186,power-signal-list"

include: power-signal-list.yaml

properties:
  power-signals-required:
    default: 4

child-binding:
  properties:
    power-enum-name:
      enum:
        - AP_IN_RST
        - AP_IN_S3
        - AP_WDT_ASSERTED
        - AP_WARM_RST_REQ
```

## zephyr/dts/bindings/cros_pwr_signal/power-signal-list.yaml
```yaml
# Copyright 2021 Google LLC
# SPDX-License-Identifier: Apache-2.0

description: Power Signal List

properties:
  power-signals-required:
    description:
      Number of power-signal children there should be for the current AP
    type: int

child-binding:
  description: Power Signal List child node
  properties:
    power-gpio-pin:
      description:
        PHandle to the associated GPIO
      type: phandle
      required: true
    power-enum-name:
      description:
        Enumeration values for power-signal-list
      type: string
      required: true
```

## zephyr/dts/bindings/cros_rtc/cros-rtc.yaml
```yaml
# Copyright 2021 Google LLC
# SPDX-License-Identifier: Apache-2.0

# Common fields for Chrome OS RTC devices

include: base.yaml

bus: crosrtc

properties:
    label:
      required: true
```

## zephyr/dts/bindings/cros_rtc/microchip,xec-cros-rtc.yaml
```yaml
# Copyright 2022 The Chromium OS Authors. All rights reserved.
# Use of this source code is governed by a BSD-style license that can be
# found in the LICENSE file.

description: Microchip, XEC Real time clock (RTC) node

compatible: "microchip,xec-cros-rtc"

include: base.yaml

properties:
    reg:
      required: true
```

## zephyr/dts/bindings/cros_rtc/nuvoton,npcx-cros-mtc.yaml
```yaml
# Copyright 2021 Google LLC
# SPDX-License-Identifier: Apache-2.0

description: Nuvoton, NPCX Monotonic Counter (MTC) node

compatible: "nuvoton,npcx-cros-mtc"

include: base.yaml

properties:
    reg:
      required: true

    label:
      required: true

    mtc-alarm:
      type: phandle
      required: true
      description: |
        Mapping table between Wake-Up Input (WUI) and monotonic counter alarm
        signal.

        For example, the WUI mapping on NPCX7 monotonic counter alarm would be
           mtc-alarm = <&wui_mtc>;
```

## zephyr/dts/bindings/cros_rtc/nxp,rtc-pcf85063a.yaml
```yaml
# Copyright 2021 Google LLC
# SPDX-License-Identifier: Apache-2.0

description: NXP, Real-Time Clock

compatible: "nxp,rtc-pcf85063a"

include: [base.yaml, i2c-device.yaml]

properties:
    label:
      required: true

    int-gpios:
      type: phandle-array
      required: true
      description: Interrupt from RTC
```

## zephyr/dts/bindings/cros_rtc/renesas,rtc-idt1337ag.yaml
```yaml
# Copyright 2021 Google LLC
# SPDX-License-Identifier: Apache-2.0

description: RENESAS, Real-Time Clock

compatible: "renesas,rtc-idt1337ag"

include: [base.yaml, i2c-device.yaml]

properties:
    label:
      required: true

    int-pin:
      type: phandle
      required: true
      description: Interrupt from RTC
```

## zephyr/dts/bindings/cros_shi/ite,it8xxx2-cros-shi.yaml
```yaml
# Copyright 2021 The Chromium OS Authors. All rights reserved.
# Use of this source code is governed by a BSD-style license that can be
# found in the LICENSE file.

description: ITE, IT8XXX2 Serial Host Interface (SHI) node

compatible: "ite,it8xxx2-cros-shi"

include: [base.yaml, pinctrl-device.yaml]

properties:
    reg:
      required: true

    pinctrl-0:
      required: true

    pinctrl-names:
      required: true
```

## zephyr/dts/bindings/cros_shi/nuvoton,npcx-cros-shi.yaml
```yaml
# Copyright 2021 Google LLC
# SPDX-License-Identifier: Apache-2.0

description: Nuvoton, NPCX Serial Host Interface (SHI) node

compatible: "nuvoton,npcx-cros-shi"

include: [base.yaml, pinctrl-device.yaml]

properties:
    reg:
      description: mmio register space
      required: true

    clocks:
        required: true
        description: configurations of device source clock controller

    pinctrl-0:
        required: true

    pinctrl-1:
        required: false

    pinctrl-names:
        required: true

    shi-cs-wui:
        type: phandle
        required: true
        description: |
            Mapping table between Wake-Up Input (WUI) and SHI_CS signal.

            For example the WUI mapping on NPCX7 would be
               shi-cs-wui = <&wui_io53>;
```

## zephyr/dts/bindings/cros_tabletmode_interrupt/cros,tabletmode-interrupt.yaml
```yaml
# Copyright 2024 The ChromiumOS Authors
# Use of this source code is governed by a BSD-style license that can be
# found in the LICENSE file.

description: Interrupt driver for changing in/out of tablet mode

compatible: "cros,tabletmode-interrupt"

properties:
  irq-gpios:
    type: phandle-array
    description: |
      The GPIO configuration (device, pin, and flags) to use for determining
      if the device is in laptop or tablet mode.
```

## zephyr/dts/bindings/dsp_comms/cros,dsp_client.yaml
```yaml
# Copyright 2024 Google LLC
# SPDX-License-Identifier: Apache-2.0

description: Client binding for EC/DSP cores

compatible: "cros,dsp-client"

include:
  - dsp_comms_common.yaml
```

## zephyr/dts/bindings/dsp_comms/cros,dsp_service.yaml
```yaml
# Copyright 2024 Google LLC
# SPDX-License-Identifier: Apache-2.0

description: Service binding for EC/DSP cores

compatible: "cros,dsp-service"

include:
  - dsp_comms_common.yaml
```

## zephyr/dts/bindings/dsp_comms/dsp_comms_common.yaml
```yaml
# Copyright 2024 Google LLC
# SPDX-License-Identifier: Apache-2.0

include:
  - "base.yaml"

properties:
  reg:
    required: true
  int-gpios:
    type: phandle-array
    description: |
      For the client, this will be the input GPIO used to know when the service
      has new information for us. For the service, this will be used as an
      output to notify the client.
```

## zephyr/dts/bindings/emul/cros,anx7447-tcpc-emul.yaml
```yaml
# Copyright 2022 The ChromiumOS Authors
# Use of this source code is governed by a BSD-style license that can be
# found in the LICENSE file.
#
description: Zephyr ANX7447 emulator

compatible: "cros,anx7447-tcpc-emul"

include: i2c-device.yaml

properties:
  tcpc-flags:
    type: int
    default: 0
    description: |
      TCPC configuration flags
  rst-gpios:
    type: phandle-array
    description: |
      TCPC reset line
  spi-addr:
    type: int
    default: 0x3f
    description:
      The hidden SPI address.
```

## zephyr/dts/bindings/emul/cros,bb-retimer-emul.yaml
```yaml
# Copyright 2021 The Chromium OS Authors. All rights reserved.
# Use of this source code is governed by a BSD-style license that can be
# found in the LICENSE file.

description: Zephyr BB retimer Emulator

compatible: "cros,bb-retimer-emul"

include: base.yaml

properties:
    vendor:
        type: string
        required: true
        enum:
          - BB_RETIMER_VENDOR_ID_1
          - BB_RETIMER_VENDOR_ID_2
        description: Vendor ID used by device that is emulated.

    error-on-ro-write:
        type: boolean
        description:
          Flag indicating if error should be generated when read only register
          is being written.

    error-on-reserved-bit-write:
        type: boolean
        description:
          Flag indicating if error should be generated when reserved bit
          is being written.
```

## zephyr/dts/bindings/emul/cros,bma4xx-emul.yaml
```yaml
# Copyright 2023 The ChromiumOS Authors
# Use of this source code is governed by a BSD-style license that can be
# found in the LICENSE file.

description: Emulator for the BMA4xx family of accelerometers.

compatible: "cros,bma4xx-emul"

include: base.yaml

properties:
  reg:
    required: true
  motionsense-sensor:
    required: true
    type: phandle
    description: |
      Reference to the /motionsense-sensor node representing the sensor
      associated with this emulator.
```

## zephyr/dts/bindings/emul/cros,clock-control-emul.yaml
```yaml
# Copyright 2021 The ChromiumOS Authors
# Use of this source code is governed by a BSD-style license that can be
# found in the LICENSE file.

description: Emulated clock

compatible: "cros,clock-control-emul"

include: base.yaml
properties:
   clock-frequency:
     type: int
     required: true
     description: |
       Default frequency in Hz for the output clock.
```

## zephyr/dts/bindings/emul/cros,gpio-controller-mock.yaml
```yaml
# Copyright 2023 The ChromiumOS Authors
# Use of this source code is governed by a BSD-style license that can be
# found in the LICENSE file.

description: A generic GPIO controller  mock

compatible: "cros,gpio-controller-mock"

include: gpio-controller.yaml

properties:
  "#gpio-cells":
    const: 2

gpio-cells:
  - pin
  - flags
```

## zephyr/dts/bindings/emul/cros,i2c-mock.yaml
```yaml
# Copyright 2021 The ChromiumOS Authors
# Use of this source code is governed by a BSD-style license that can be
# found in the LICENSE file.

description: A generic I2C mock

compatible: "cros,i2c-mock"

include: base.yaml

properties:
   reg:
     required: true
```

## zephyr/dts/bindings/emul/cros,isl923x-emul.yaml
```yaml
# Copyright 2021 The ChromiumOS Authors
# Use of this source code is governed by a BSD-style license that can be
# found in the LICENSE file.

description: ISL923X Charger emulator

compatible: "cros,isl923x-emul"

include: base.yaml

properties:
  reg:
    required: true
  battery:
    type: phandle
    description:
      Reference to battery emulator.
```

## zephyr/dts/bindings/emul/cros,lis2dw12-emul.yaml
```yaml
# Copyright 2021 The chromium OS Authors. All rights reserved.
# Use of this source code is governed by a BSD-style license that can be
# found in the LICENSE file.

description: CROS implementation of the LIS2DW12 emulator

compatible: "cros,lis2dw12-emul"

# TODO(b/239165779): Reduce or remove the usage of label properties
include:
  - name: base.yaml
    property-blocklist:
      - label

properties:
  reg:
    required: true
  label:
    type: string
    required: false
```

## zephyr/dts/bindings/emul/cros,ln9310-emul.yaml
```yaml
# Copyright 2021 The Chromium OS Authors. All rights reserved.
# Use of this source code is governed by a BSD-style license that can be
# found in the LICENSE file.

description: Cros LN9310 Emulator

compatible: "cros,ln9310-emul"

# TODO(b/239165779): Reduce or remove the usage of label properties
include:
  - name: base.yaml
    property-blocklist:
      - label

properties:
  reg:
    required: true
  pg-int-pin:
    type: phandle
    description:
      GPIO that receives interrupt signal from this device.
    required: true
  label:
      type: string
      required: false
```

## zephyr/dts/bindings/emul/cros,lsm6dso-emul.yaml
```yaml
# Copyright 2024 The ChromiumOS Authors
# Use of this source code is governed by a BSD-style license that can be
# found in the LICENSE file.

description: CROS implementation of the LSM6DSO emulator

compatible: "cros,lsm6dso-emul"

include: base.yaml

properties:
  reg:
    required: true
```

## zephyr/dts/bindings/emul/cros,ps8811-emul.yaml
```yaml
# Copyright 2023 The ChromiumOS Authors
# Use of this source code is governed by a BSD-style license that can be
# found in the LICENSE file.

description: Zephyr PS8811 emulator

compatible: "cros,ps8811-emul"

include: base.yaml
```
