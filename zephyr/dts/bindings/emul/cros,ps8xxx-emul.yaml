## zephyr/dts/bindings/emul/zephyr,smbus-ara-emul.yaml
```yaml
# Copyright 2023 The ChromiumOS Authors
# Use of this source code is governed by a BSD-style license that can be
# found in the LICENSE file.

description: Zephyr SMBUS Alert Response Address Emulator

compatible: "zephyr,smbus-ara-emul"

include: base.yaml

properties:
  device-address:
    type: int
    description: Default address of device in ARA response
```

## zephyr/dts/bindings/emul/zephyr,syv682x-emul.yaml
```yaml
# Copyright 2021 The ChromiumOS Authors
# Use of this source code is governed by a BSD-style license that can be
# found in the LICENSE file.

description: Zephyr SYV682X Emulator

compatible: "zephyr,syv682x-emul"

include: base.yaml

properties:
  frs_en_gpio:
    type: phandle
    description: The GPIO that controls FRS enable on this device
    required: true
  alert_gpio:
    type: phandle
    description: The GPIO that receives the alert signal from this device
    required: true
  irq-gpios:
    type: phandle-array
    description: |
      Interrupt from PPC using shim driver
  is-alt:
    type: boolean
    description: |
      If present, this node refers to an altnerate PPC device. The PPC device
      is not used by default, and must be manually enabled at runtime.
```
