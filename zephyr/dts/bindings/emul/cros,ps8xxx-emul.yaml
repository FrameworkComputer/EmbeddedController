## zephyr/dts/bindings/emul/cros,ps8xxx-emul.yaml
```yaml
# Copyright 2021 The ChromiumOS Authors
# Use of this source code is governed by a BSD-style license that can be
# found in the LICENSE file.

description: Zephyr PS8xxx emulator

compatible: "cros,ps8xxx-emul"

include: tcpci.yaml

properties:
  p0-i2c-addr:
    type: int
    required: true
    description:
      First hidden I2C address (PS8xxx emulator will register device with
      that address)

  p1-i2c-addr:
    type: int
    required: true
    description:
      Second hidden I2C address (PS8xxx emulator will register device with
      that address)

  gpio-i2c-addr:
    type: int
    default: 0
    description:
      GPIO I2C address. When set to zero GPIO I2C device is not registered
      by PS8xxx emulator.
```

## zephyr/dts/bindings/emul/cros,pwm-mock.yaml
```yaml
# Copyright 2022 The ChromiumOS Authors
# Use of this source code is governed by a BSD-style license that can be
# found in the LICENSE file.

description: A generic PWM mock
compatible: "cros,pwm-mock"
include: [pwm-controller.yaml, base.yaml]
properties:
   reg:
     required: true

pwm-cells:
    - channel
    - period
```

## zephyr/dts/bindings/emul/cros,rt1715-tcpc-emul.yaml
```yaml
# Copyright 2024 The ChromiumOS Authors
# Use of this source code is governed by a BSD-style license that can be
# found in the LICENSE file.

description: Zephyr RT1715 Emulator

compatible: "cros,rt1715-tcpc-emul"

include: i2c-device.yaml

properties:
  tcpc-flags:
    type: int
    default: 0
    description: |
      TCPC configuration flags
  irq-gpios:
    type: phandle-array
    description: |
      Interrupt from TCPC
  is-alt:
    type: boolean
    description: |
      If present, this node refers to an alternate TCPC device. The TCPC device
      is not used by default, and must be manually enabled at runtime.
```

## zephyr/dts/bindings/emul/cros,rt1718s-tcpc-emul.yaml
```yaml
# Copyright 2023 The ChromiumOS Authors
# Use of this source code is governed by a BSD-style license that can be
# found in the LICENSE file.

description: Zephyr RT1718S Emulator

compatible: "cros,rt1718s-tcpc-emul"

include: i2c-device.yaml

properties:
  tcpc-flags:
    type: int
    default: 0
    description: |
      TCPC configuration flags
  irq-gpios:
    type: phandle-array
    description: |
      Interrupt from TCPC
```

## zephyr/dts/bindings/emul/cros,sm5803-emul.yaml
```yaml
# Copyright 2023 The ChromiumOS Authors
# Use of this source code is governed by a BSD-style license that can be
# found in the LICENSE file.

description: SM5803 charger emulator

compatible: "cros,sm5803-emul"

include: base.yaml

properties:
  main-addr:
    type: int
    default: 0x30
    description: |
      I2C address of the charger base registers. This is always 0x30 on
      hardware.
  meas-addr:
    type: int
    default: 0x31
    description: |
      I2C address of the charger measurement registers. This is always 0x31 on
      hardware.
  test-addr:
    type: int
    default: 0x37
    description: |
      I2C address of the charger test registers. This is always 0x37 on
      hardware.
  interrupt-gpios:
    type: phandle-array
    description: |
      Emulated GPIO pin acting as the active-low interrupt input from the
      charger.
```

## zephyr/dts/bindings/emul/cros,sn5s330-emul.yaml
```yaml
# Copyright 2021 The ChromiumOS Authors
# Use of this source code is governed by a BSD-style license that can be
# found in the LICENSE file.

description: sn5s330 emulator

compatible: "cros,sn5s330-emul"

include: base.yaml
properties:
  reg:
    required: true
  int-pin:
    type: phandle
    description: The GPIO that receives an interrupt signal from this device
    required: true
  irq-gpios:
    type: phandle-array
    description: |
      Interrupt from PPC using shim driver
```

## zephyr/dts/bindings/emul/cros,sn5s330.yaml
```yaml
# Copyright 2021 The chromium OS Authors. All rights reserved.
# Use of this source code is governed by a BSD-style license that can be
# found in the LICENSE file.

description: sn5s330 emulator

compatible: "cros,sn5s330"

include: base.yaml
properties:
    reg:
      required: true
```

## zephyr/dts/bindings/emul/cros,tcpci-emul.yaml
```yaml
# Copyright 2021 The Chromium OS Authors. All rights reserved.
# Use of this source code is governed by a BSD-style license that can be
# found in the LICENSE file.

description: Zephyr TCPCI Emulator

compatible: "cros,tcpci-emul"

include: base.yaml

properties:
    alert_gpio:
      type: phandle
      required: false
      description:
        Reference to Alert# GPIO.
```

## zephyr/dts/bindings/emul/cros,tcpci-generic-emul.yaml
```yaml
# Copyright 2022 The ChromiumOS Authors
# Use of this source code is governed by a BSD-style license that can be
# found in the LICENSE file.

description: Zephyr TCPCI Generic Emulator

compatible: "cros,tcpci-generic-emul"

include: tcpci.yaml
```

## zephyr/dts/bindings/emul/cros,vcmp-mock.yaml
```yaml
# Copyright Google LLC
# SPDX-License-Identifier: Apache-2.0

description: Generic voltage comparator device mock implementation

compatible: "cros,vcmp-mock"

include: sensor-device.yaml

properties:
  io-channels:
    type: phandle-array
    required: true

  threshold-mv:
    type: int
    required: true
```

## zephyr/dts/bindings/emul/cros-ec,flash-emul.yaml
```yaml
# Copyright 2022 The Chromium OS Authors. All rights reserved.
# Use of this source code is governed by a BSD-style license that can be
# found in the LICENSE file.

description: Emulator for Chromiumos EC flash driver.

compatible: "cros-ec,flash-emul"

include: cros-flash-controller.yaml
```

## zephyr/dts/bindings/emul/cros-ec,kb-raw-emul.yaml
```yaml
# Copyright 2022 The ChromiumOS Authors
# Use of this source code is governed by a BSD-style license that can be
# found in the LICENSE file.

description: Emulator for Chromiumos EC raw keyboard driver.

compatible: "cros-ec,kb-raw-emul"

include: base.yaml

properties:
  rows:
    type: int
    default: 8
    description: Number of keyboard scan rows
  cols:
    type: int
    default: 18
    description: Number of keyboard scan columns
```

## zephyr/dts/bindings/emul/realtek,rts5453p-emul.yaml
```yaml
# Copyright 2023 The ChromiumOS Authors
# Use of this source code is governed by a BSD-style license that can be
# found in the LICENSE file.

description: Realtek RTS5453P Type-C Power Delivery Controller Emulator

compatible: "realtek,rts5453p-emul"

include: base.yaml
```

## zephyr/dts/bindings/emul/tcpci.yaml
```yaml
# Copyright 2022 The ChromiumOS Authors
# Use of this source code is governed by a BSD-style license that can be
# found in the LICENSE file.

description: Common TCPCI properties

include: base.yaml

properties:
  irq-gpios:
    type: phandle-array
    description: |
      Interrupt from TCPC using shim driver

  rst-gpios:
    type: phandle-array
    description: |
      TCPC reset line using shim driver

  int-pin:
    type: phandles
    description: |
      Interrupt from TCPC using gpio-int
```

## zephyr/dts/bindings/emul/zephyr,bma255.yaml
```yaml
# Copyright 2021 The Chromium OS Authors. All rights reserved.
# Use of this source code is governed by a BSD-style license that can be
# found in the LICENSE file.

description: Zephyr BMA255 Emulator

compatible: "zephyr,bma255"

include: base.yaml

properties:
    nvm-off-x:
        type: int
        required: false
        default: 0
        description: Accelerometer offset of x axis stored in NVM.

    nvm-off-y:
        type: int
        required: false
        default: 0
        description: Accelerometer offset of y axis stored in NVM.

    nvm-off-z:
        type: int
        required: false
        default: 0
        description: Accelerometer offset of z axis stored in NVM.

    nvm-gp0:
        type: int
        required: false
        default: 0
        description: GP0 value stored in NVM.

    nvm-gp1:
        type: int
        required: false
        default: 0
        description: GP1 value stored in NVM.

    nvm-acc-x:
        type: int
        required: false
        default: 0
        description: Accelerometer value of x axis used until new value is set.

    nvm-acc-y:
        type: int
        required: false
        default: 0
        description: Accelerometer value of y axis used until new value is set.

    nvm-acc-z:
        type: int
        required: false
        default: 0
        description: Accelerometer value of z axis used until new value is set.

    error-on-compensation-not-ready:
        type: boolean
        description:
          Flag indicating if error should be generated when fast compensation
          is started when not ready bit is set.

    error-on-ro-write:
        type: boolean
        description:
          Flag indicating if error should be generated when read only register
          is being written.

    error-on-reserved-bit-write:
        type: boolean
        description:
          Flag indicating if error should be generated when reserved bit
          is being written.

    error-on-msb-first-access:
        type: boolean
        description:
          Flag indicating if error should be generated when MSB register of
          accelerometer value is accessed before LSB and shadowing is enabled
          at the same time.
```

## zephyr/dts/bindings/emul/zephyr,bmi-emul.yaml
```yaml
# Copyright 2021 The ChromiumOS Authors
# Use of this source code is governed by a BSD-style license that can be
# found in the LICENSE file.

description: Zephyr BMI Emulator

compatible: "zephyr,bmi-emul"

include: base.yaml

properties:
  device-model:
    type: string
    required: true
    enum:
      - BMI_EMUL_160
      - BMI_EMUL_260
      - BMI_EMUL_3XX
    description: Model of device that is emulated.

  error-on-ro-write:
    type: boolean
    description:
      Flag indicating if error should be generated when read only register
      is being written.

  error-on-wo-read:
    type: boolean
    description:
      Flag indicating if error should be generated when write only register
      is being read.

  error-on-reserved-bit-write:
    type: boolean
    description:
      Flag indicating if error should be generated when reserved bit
      is being written.

  simulate-command-exec-time:
    type: boolean
    description:
      Flag indicating if emulator should wait the same amount of time before
      finishing command as real device would.
```

## zephyr/dts/bindings/emul/zephyr,icm42607-emul.yaml
```yaml
# Copyright 2023 The ChromiumOS Authors
# Use of this source code is governed by a BSD-style license that can be
# found in the LICENSE file.

description: Zephyr ICM42607 Emulator

compatible: "zephyr,icm42607-emul"

include: base.yaml
```

## zephyr/dts/bindings/emul/zephyr,kb8010-emul.yaml
```yaml
# Copyright 2024 The ChromiumOS Authors
# Use of this source code is governed by a BSD-style license that can be
# found in the LICENSE file.

description: Zephyr kb8010 Emulator

compatible: "zephyr,kb8010-emul"

include: ["i2c-device.yaml", "cros-ec,usbc-mux.yaml"]

properties:
  dp-en-pin:
    type: phandle
    required: true

  reset-pin:
    type: phandle
    required: true

  emul-reset-gpios:
    type: phandle-array
    required: true
```

## zephyr/dts/bindings/emul/zephyr,ktu1125-emul.yaml
```yaml
# Copyright 2024 The ChromiumOS Authors
# Use of this source code is governed by a BSD-style license that can be
# found in the LICENSE file.

description: Zephyr ktu1125 Emulator

compatible: "zephyr,ktu1125-emul"

include: ["i2c-device.yaml", "ppc-chip.yaml"]
```

## zephyr/dts/bindings/emul/zephyr,ps8743-emul.yaml
```yaml
# Copyright 2023 The ChromiumOS Authors
# Use of this source code is governed by a BSD-style license that can be
# found in the LICENSE file.
#
description: Zephyr PS8743 Emulator

compatible: "zephyr,ps8743-emul"

include: "parade,ps8743.yaml"
```

## zephyr/dts/bindings/emul/zephyr,rt1739-emul.yaml
```yaml
# Copyright 2023 The ChromiumOS Authors
# Use of this source code is governed by a BSD-style license that can be
# found in the LICENSE file.

description: Zephyr rt1739 Emulator

compatible: "zephyr,rt1739-emul"

include: base.yaml
```

## zephyr/dts/bindings/emul/zephyr,rt9490-emul.yaml
```yaml
# Copyright 2022 The ChromiumOS Authors
# Use of this source code is governed by a BSD-style license that can be
# found in the LICENSE file.

description: Zephyr rt9490 Emulator

compatible: "zephyr,rt9490-emul"

include: base.yaml
```

## zephyr/dts/bindings/emul/zephyr,smart-battery-emul.yaml
```yaml
# Copyright 2021 The ChromiumOS Authors
# Use of this source code is governed by a BSD-style license that can be
# found in the LICENSE file.

description: Zephyr Smart Battery Emulator

compatible: "zephyr,smart-battery-emul"

include: base.yaml

properties:
  mf-access:
    type: int
    default: 0
    description: Word returned on manufacturer access command.

  at-rate-full-mw-support:
    type: boolean
    description:
      Flag indicating if AT_RATE_TIME_TO_FULL command supports mW capacity
      mode.

  version:
    type: string
    enum:
      - BATTERY_SPEC_VER_1_0
      - BATTERY_SPEC_VER_1_1
      - BATTERY_SPEC_VER_1_1_WITH_PEC
    default: BATTERY_SPEC_VER_1_1_WITH_PEC
    description: Version of Smart Battery.

  vscale:
    type: int
    default: 0
    description: Scaling of voltage.

  ipscale:
    type: int
    default: 0
    description: Scaling of current.

  int-charge-controller:
    type: boolean
    description: Flag indicating if internal charge controller is supported.

  primary-battery:
    type: boolean
    description:
      Flag indicating if primary battery role selection is supported.

  design-mv:
    type: int
    default: 5000
    description: Design battery voltage in mV.

  design-cap:
    type: int
    default: 5000
    description: Design battery capacity in mAh.

  temperature:
    type: int
    default: 2930
    description: Battery temperature in 0.1 Kelvins.

  volt:
    type: int
    default: 5000
    description: Battery voltage in mV.

  cur:
    type: int
    default: 1000
    description: Current charging (> 0) or discharging (< 0) battery in mA.

  avg-cur:
    type: int
    default: 1000
    description: Average current from 1 minute.

  max-error:
    type: int
    default: 0
    description: Maximum error of commands return value in percent.

  cap:
    type: int
    default: 2000
    description: Capacity of the battery in mAh.

  full-cap:
    type: int
    default: 4000
    description: Full capacity of the battery in mAh.

  desired-charg-cur:
    type: int
    default: 2000
    description: Charging current requested by battery.

  desired-charg-volt:
    type: int
    default: 7000
    description: Charging voltage requested by battery.

  cycle-count:
    type: int
    default: 125
    description: Number of cycles.

  serial-number:
    type: int
    default: 7
    description: Serial number of battery.

  mf-name:
    type: string
    default: "zephyr"
    description: Manufacturer name. Length has to be smaller than 32 bytes.

  dev-name:
    type: string
    default: "smartbat"
    description: Device name. Length has to be smaller than 32 bytes.

  dev-chem:
    type: string
    default: "LION"
    description: Device chemistry. Length has to be smaller than 32 bytes.

  mf-data:
    type: string
    default: "LION"
    description: Manufacturer data. Length has to be smaller than 32 bytes.

  mf-info:
    type: string
    default: "LION"
    description: Manufacturer info. Length has to be smaller than 32 bytes.
```
