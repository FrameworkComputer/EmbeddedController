## zephyr/dts/bindings/gpio/gpio-enum-name.yaml
```yaml
description: Named GPIOs parent node
properties:
  enum-name:
    type: string
    description:
      Enum used in code.
      These names MUST ONLY be referenced by legacy code that is
      included with Zephyr projects.

      Some development boards like trogdor, volteer etc. shim in
      the older baseboard/board headers and code, so they
      are also using most of these names. When these
      boards get removed, these names can be removed

      Do not add any more names to this list. Please remove
      any names that are not referenced by Zephyr projects (or
      are not in included common legacy code)
    enum:
      - GPIO_AC_PRESENT
      - GPIO_AP_EC_SYSRST_ODL
      - GPIO_AP_EC_WARM_RST_REQ
      - GPIO_AP_EC_WATCHDOG_L
      - GPIO_AP_EC_WDTRST_L
      - GPIO_AP_IN_SLEEP_L
      - GPIO_AP_RST_L
      - GPIO_AP_SUSPEND
      - GPIO_BATT_PRES_ODL
      - GPIO_BC12_DET_EN
      - GPIO_BOARD_VERSION1
      - GPIO_BOARD_VERSION2
      - GPIO_BOARD_VERSION3
      - GPIO_CCD_MODE_ODL
      - GPIO_CPU_PROCHOT
      - GPIO_DA9313_GPIO0
      - GPIO_DC_JACK_PRESENT
      - GPIO_DEPRECATED_AP_RST_REQ
      - GPIO_EC_INT_L
      - GPIO_EC_KB_BL_EN_L
      - GPIO_EC_PCH_SYS_PWROK
      - GPIO_EC_PMIC_EN_ODL
      - GPIO_EC_PMIC_WATCHDOG_L
      - GPIO_EC_PROCHOT_IN_L
      - GPIO_ENABLE_BACKLIGHT
      - GPIO_ENABLE_BACKLIGHT_L
      - GPIO_ENTERING_RW
      - GPIO_EN_KEYBOARD_BACKLIGHT
      - GPIO_EN_PP3300_A
      - GPIO_EN_PP5000
      - GPIO_EN_PP5000_A
      - GPIO_EN_PP5000_USBA
      - GPIO_EN_PP5000_USBA_R
      - GPIO_EN_PPVAR_VCCIN
      - GPIO_EN_PWR_A
      - GPIO_EN_S5_RAILS
      - GPIO_EN_USB_A_5V
      - GPIO_IMVP9_VRRDY_OD
      - GPIO_KB_DISCRETE_INT
      - GPIO_KBD_KSO2
      - GPIO_LID_ACCEL_INT_L
      - GPIO_LID_OPEN
      - GPIO_PACKET_MODE_EN
      - GPIO_PCH_DSW_PWROK
      - GPIO_PCH_PWRBTN_L
      - GPIO_PCH_PWROK
      - GPIO_PCH_RSMRST_L
      - GPIO_PCH_RTCRST
      - GPIO_PCH_SLP_S0_L
      - GPIO_PCH_SLP_S3_L
      - GPIO_PCH_SLP_S5_L
      - GPIO_PCH_SLP_SUS_L
      - GPIO_PCH_SYS_PWROK
      - GPIO_PG_EC_ALL_SYS_PWRGD
      - GPIO_PG_EC_DSW_PWROK
      - GPIO_PG_EC_RSMRST_ODL
      - GPIO_PG_PP4200_S5_OD
      - GPIO_PMIC_EC_PWRGD
      - GPIO_PMIC_EC_RESETB
      - GPIO_PMIC_KPD_PWR_ODL
      - GPIO_PMIC_RESIN_L
      - GPIO_POWER_BUTTON_L
      - GPIO_POWER_GOOD
      - GPIO_PS_HOLD
      - GPIO_RECOVERY_L
      - GPIO_S0_PGOOD
      - GPIO_S5_PGOOD
      - GPIO_SLP_SUS_L
      - GPIO_SWITCHCAP_ON
      - GPIO_SWITCHCAP_ON_L
      - GPIO_SWITCHCAP_PG
      - GPIO_SWITCHCAP_PG_INT_L
      - GPIO_SYS_RESET_L
      - GPIO_SYS_RST_ODL
      - GPIO_TABLET_MODE_L
      - GPIO_TEMP_SENSOR_POWER
      - GPIO_TEST
      - GPIO_USB_C0_BC12_INT_ODL
      - GPIO_USB_C0_C2_TCPC_INT_ODL
      - GPIO_USB_C0_C2_TCPC_RST_ODL
      - GPIO_USB_C0_DISCHARGE
      - GPIO_USB_C0_DP_HPD
      - GPIO_USB_C0_OC_ODL
      - GPIO_USB_C0_PD_INT_ODL
      - GPIO_USB_C0_PPC_INT_ODL
      - GPIO_USB_C0_SWCTL_INT_ODL
      - GPIO_USB_C0_TCPC_INT_ODL
      - GPIO_USB_C0_TCPC_RST_L
      - GPIO_USB_C1_BC12_INT_ODL
      - GPIO_USB_C1_DISCHARGE
      - GPIO_USB_C1_DP_HPD
      - GPIO_USB_C0_FRS_EN
      - GPIO_USB_C1_FRS_EN
      - GPIO_USB_C1_LS_EN
      - GPIO_USB_C1_OC_ODL
      - GPIO_USB_C1_PD_INT_ODL
      - GPIO_USB_C1_PPC_INT_ODL
      - GPIO_USB_C1_RST_ODL
      - GPIO_USB_C1_RT_RST_ODL
      - GPIO_USB_C1_RT_RST_R_ODL
      - GPIO_USB_C1_SWCTL_INT_ODL
      - GPIO_USB_C1_TCPC_INT_ODL
      - GPIO_USB_C1_TCPC_RST_L
      - GPIO_USB_C2_BC12_INT_ODL
      - GPIO_USB_C2_DISCHARGE
      - GPIO_USB_C2_PPC_INT_ODL
      - GPIO_USB1_CTL1
      - GPIO_USB1_CTL2
      - GPIO_USB1_CTL3
      - GPIO_USB1_ILIM_SEL
      - GPIO_USB2_CTL1
      - GPIO_USB2_CTL2
      - GPIO_USB2_CTL3
      - GPIO_USB2_ILIM_SEL
      - GPIO_VBOB_EN
      - GPIO_VCCST_PWRGD_OD
      - GPIO_VOLUME_DOWN_L
      - GPIO_VOLUME_UP_L
      - GPIO_WARM_RESET_L
      - IOEX_USB_A1_RETIMER_EN
      - IOEX_USB_C0_BB_RETIMER_LS_EN
      - IOEX_USB_C0_BB_RETIMER_RST
      - IOEX_USB_C0_C1_OC
      - IOEX_USB_C0_FRS_EN
      - IOEX_USB_C0_HBR_LS_EN
      - IOEX_USB_C0_HBR_RST
      - IOEX_USB_C0_MUX_SBU_SEL_0
      - IOEX_USB_C0_MUX_SBU_SEL_1
      - IOEX_USB_C0_PPC_ILIM_3A_EN
      - IOEX_USB_C0_SBU_FLIP
      - IOEX_USB_C0_TCPC_FASTSW_CTL_EN
      - IOEX_USB_C0_USB_MUX_CNTRL_0
      - IOEX_USB_C0_USB_MUX_CNTRL_1
      - IOEX_USB_C1_BB_RETIMER_LS_EN
      - IOEX_USB_C1_BB_RETIMER_RST
      - IOEX_USB_C1_FAULT_ODL
      - IOEX_USB_C1_HBR_LS_EN
      - IOEX_USB_C1_HBR_RST
      - IOEX_USB_C1_HPD
      - IOEX_USB_C1_HPD_IN_DB
      - IOEX_USB_C1_PPC_ILIM_3A_EN
      - IOEX_USB_C1_SBU_FLIP
      - IOEX_USB_C1_TCPC_FASTSW_CTL_EN
      - IOEX_USB_C2_BB_RETIMER_LS_EN
      - IOEX_USB_C2_BB_RETIMER_RST
      - IOEX_USB_C2_HBR_RST
      - IOEX_USB_C2_HBR_LS_EN
      - IOEX_USB_C2_C3_OC
      - IOEX_USB_C2_FRS_EN
      - IOEX_USB_C3_BB_RETIMER_LS_EN
      - IOEX_USB_C3_BB_RETIMER_RST
      - IOEX_USB_C3_HBR_RST
      - IOEX_USB_C3_HBR_LS_EN
```

## zephyr/dts/bindings/gpio/gpio-id.yaml
```yaml
description: Defines board version and sku id gpios

compatible: cros-ec,gpio-id

properties:
  bits:
    type: phandles
    required: true
    description: GPIO list to read, LSB to MSB

  system:
    type: string
    description:
      Numeral system used to decode values
      - binary - expects array with values of 0 and 1.
      - binary_first_base3 - non-standard ternary number system
          where the first 2^n natural numbers are represented as
          they would be in a binary system (without any Z digits)
          and the following 3^n-2^n numbers use the remaining
          ternary representations in the normal ternary system order
      - ternary - expects array with values of 0, 1 and 2.
          It treats 'Z' state as digit '2'.
    enum:
      - binary
      - binary_first_base3
      - ternary
```

## zephyr/dts/bindings/gpio/hibernate-wake-pins.yaml
```yaml
# Copyright 2021 The Chromium OS Authors. All rights reserved.
# Use of this source code is governed by a BSD-style license that can be
# found in the LICENSE file.

description: Hibernate Wake-up Pins Configurations

compatible: "cros-ec,hibernate-wake-pins"

properties:
  wakeup-pins:
    type: phandles
    required: true
    description: GPIO list for hibernate wake-up
```

## zephyr/dts/bindings/gpio/ioex-enum-name.yaml
```yaml
description: Named IOEXes parent node
properties:
  enum-name:
    type: string
    description:
      Names used for IO expanders pins
    enum:
      - IOEX_5V_DC_DC_MODE_CTRL
      - IOEX_ATMEL_MISO
      - IOEX_ATMEL_MOSI
      - IOEX_ATMEL_RESET_L
      - IOEX_ATMEL_SCLK
      - IOEX_ATMEL_SS
      - IOEX_BAT_LED_AMBER_L
      - IOEX_BAT_LED_GREEN_FULL_L
      - IOEX_BAT_LED_RED_L
      - IOEX_BAT_LED_WHITE_L
      - IOEX_BOARD_ID_DET0
      - IOEX_BOARD_ID_DET1
      - IOEX_BOARD_ID_DET2
      - IOEX_C1_CHARGER_LED_AMBER_DB
      - IOEX_C1_CHARGER_LED_WHITE_DB
      - IOEX_DAC_BUF1_LATCH_FAULT_L
      - IOEX_DAC_BUF2_LATCH_FAULT_L
      - IOEX_DONGLE_DET
      - IOEX_DUT_CHG_EN
      - IOEX_EN_PP3300_DP
      - IOEX_EN_PP3300_ETH
      - IOEX_EN_PP5000_ALT_3P3
      - IOEX_EN_PP5000_USB_A0_VBUS
      - IOEX_EN_PP5000_USB_A1_VBUS_DB
      - IOEX_EN_PWR_HDMI
      - IOEX_EN_PWR_HDMI_DB
      - IOEX_EN_USB_A0_5V
      - IOEX_EN_USB_A1_5V_DB
      - IOEX_EN_USB_A1_5V_DB_OPT1
      - IOEX_EN_USB_A1_5V_DB_OPT2
      - IOEX_EN_VOUT_BUF_CC1
      - IOEX_EN_VOUT_BUF_CC2
      - IOEX_FAULT_CLEAR_CC
      - IOEX_HDMI_DATA_EN
      - IOEX_HDMI_DATA_EN_DB
      - IOEX_HDMI_POWER_EN_DB
      - IOEX_HOST_CHRG_DET
      - IOEX_HOST_OR_CHG_CTL
      - IOEX_ID_1_USB_C0_FRS_EN
      - IOEX_ID_1_USB_C0_OC_ODL
      - IOEX_ID_1_USB_C0_RT_RST_ODL
      - IOEX_ID_1_USB_C1_OC_ODL
      - IOEX_ID_1_USB_C2_FRS_EN
      - IOEX_ID_1_USB_C2_OC_ODL
      - IOEX_ID_1_USB_C2_RT_RST_ODL
      - IOEX_KB_BL_EN
      - IOEX_LED_BLUE
      - IOEX_LED_GREEN
      - IOEX_LED_ORANGE
      - IOEX_PP3300_DP_FAULT_L
      - IOEX_PP5000_SRC_SEL
      - IOEX_PPC_ID
      - IOEX_PWR_LED_WHITE_L
      - IOEX_SBU_FLIP_SEL
      - IOEX_SBU_UART_SEL
      - IOEX_SYS_PWR_IRQ_ODL
      - IOEX_TCA_GPIO_DBG_LED_K_ODL
      - IOEX_UART_18_SEL
      - IOEX_USB3_A0_FAULT_L
      - IOEX_USB3_A0_MUX_EN_L
      - IOEX_USB3_A0_MUX_SEL
      - IOEX_USB3_A0_PWR_EN
      - IOEX_USB3_A1_FAULT_L
      - IOEX_USB3_A1_MUX_SEL
      - IOEX_USB3_A1_PWR_EN
      - IOEX_USB_A0_CHARGE_EN_L
      - IOEX_USB_A0_LIMIT_SDP
      - IOEX_USB_A0_RETIMER_EN
      - IOEX_USB_A0_RETIMER_RST
      - IOEX_USB_A1_CHARGE_EN_DB_L
      - IOEX_USB_A1_CHARGE_EN_DB_L_OPT1
      - IOEX_USB_A1_CHARGE_EN_DB_L_OPT2
      - IOEX_USB_A1_LIMIT_SDP_DB
      - IOEX_USB_A1_RETIMER_EN
      - IOEX_USB_A1_RETIMER_EN_OPT1
      - IOEX_USB_A1_RETIMER_EN_OPT2
      - IOEX_USB_A1_RETIMER_RST
      - IOEX_USB_A1_RETIMER_RST_DB
      - IOEX_USB_C0_BB_RETIMER_LS_EN
      - IOEX_USB_C0_BB_RETIMER_RST
      - IOEX_USB_C0_C1_OC
      - IOEX_USB_C0_DATA_EN
      - IOEX_USB_C0_FAULT_ODL
      - IOEX_USB_C0_FRS_EN
      - IOEX_USB_C0_OC_ODL
      - IOEX_USB_C0_PPC_EN_L
      - IOEX_USB_C0_PPC_ILIM_3A_EN
      - IOEX_USB_C0_RT_RST_ODL
      - IOEX_USB_C0_SBU_FLIP
      - IOEX_USB_C0_TCPC_FASTSW_CTL_EN
      - IOEX_USB_C0_USB_MUX_CNTRL_0
      - IOEX_USB_C0_USB_MUX_CNTRL_1
      - IOEX_USB_C1_BB_RETIMER_LS_EN
      - IOEX_USB_C1_BB_RETIMER_RST
      - IOEX_USB_C1_DATA_EN
      - IOEX_USB_C1_FAULT_ODL
      - IOEX_USB_C1_FRS_EN
      - IOEX_USB_C1_HPD_IN_DB
      - IOEX_USB_C1_IN_HPD
      - IOEX_USB_C1_MUX_RST_DB
      - IOEX_USB_C1_OC_ODL
      - IOEX_USB_C1_POWER_SWITCH_ID
      - IOEX_USB_C1_PPC_EN_L
      - IOEX_USB_C1_PPC_ILIM_3A_EN
      - IOEX_USB_C1_RT_RST_ODL
      - IOEX_USB_C1_TCPC_FASTSW_CTL_EN
      - IOEX_USB_C2_BB_RETIMER_LS_EN
      - IOEX_USB_C2_BB_RETIMER_RST
      - IOEX_USB_C2_C3_OC
      - IOEX_USB_C2_FRS_EN
      - IOEX_USB_C2_OC_ODL
      - IOEX_USB_C2_RT_RST_ODL
      - IOEX_USB_C2_USB_MUX_CNTRL_0
      - IOEX_USB_C2_USB_MUX_CNTRL_1
      - IOEX_USB_C3_BB_RETIMER_LS_EN
      - IOEX_USB_C3_BB_RETIMER_RST
      - IOEX_USB_DUTCHG_FLT_ODL
      - IOEX_USBH_PWRDN_L
      - IOEX_USERVO_FASTBOOT_MUX_SEL
      - IOEX_USERVO_FAULT_L
      - IOEX_USERVO_POWER_EN
      - IOEX_VBUS_DISCHRG_EN
```

## zephyr/dts/bindings/gpio/named-gpios.yaml
```yaml
description: Named GPIOs parent node

compatible: "named-gpios"

child-binding:
  description: Named GPIOs child node
  include: gpio-enum-name.yaml
  properties:
    #
    # Must name this property [..-]gpios which
    # is treated specially (looks for #gpio-cells
    # in referenced node so that cell properties can
    # be specified). If this property does not exist, treat
    # this GPIO as unimplemented.
    gpios:
      type: phandle-array
    no-auto-init:
      description:
        When set, the GPIO is not initialised, and can be
        initialised separately in code, but is still saved so that
        it appears in the list of GPIOs.

        When not set, the GPIO h/w is configured and initialised at startup
        according to the flags in the gpios node.
      type: boolean
    alias:
      description:
        When set, defines an alias for this GPIO's enum-name.

        This is to allow common or generic names in legacy code to map
        to the particular board's GPIO name.
      type: string
```

## zephyr/dts/bindings/gpio/named-ioexes.yaml
```yaml
description: Named IOEXes parent node

compatible: "named-ioexes"

child-binding:
    description: Named IOEXes child node
    include: ioex-enum-name.yaml
    properties:
       gpios:
          type: phandle-array
          required: true
       label:
          required: true
          type: string
          description: |
            Human readable string describing the net name connected
            to the I/O expander pin.
       "#gpio-cells":
          type: int
          required: false
          const: 0
```

## zephyr/dts/bindings/gpio/unused-gpios.yaml
```yaml
description: Unused GPIOs node

compatible: "unused-gpios"

properties:
  unused-gpios:
    type: phandle-array
    required: true
    description: |
      A list contains unused GPIOs. The chip vendor needs to configure them for
      better power consumption in the lowest power state.
```

## zephyr/dts/bindings/gpio_led/cros-ec,gpio-led-colors.yaml
```yaml
# Copyright 2021 The Chromium OS Authors. All rights reserved.
# Use of this source code is governed by a BSD-style license that can be
# found in the LICENSE file.

description: GPIO LED colors parent node

compatible: "cros-ec,gpio-led-colors"

child-binding:
    description: LED Color nodes
    properties:
        charge-state:
            description: If the LED color depends on charge state, this
                         property is used to describe it.
            type: string
            required: false
            enum:
                - PWR_STATE_CHARGE
                - PWR_STATE_DISCHARGE
                - PWR_STATE_ERROR
                - PWR_STATE_IDLE
                - PWR_STATE_CHARGE_NEAR_FULL

        chipset-state:
            description: If the LED color depends on chipset state, this
                         property is used to describe it.
            type: string
            required: false
            enum:
                - POWER_S0
                - POWER_S3
                - POWER_S5

        extra-flag:
            description: If the LED color depends on additional factors
            type: string
            required: false
            enum:
                - NONE
                - LED_CHFLAG_FORCE_IDLE
                - LED_CHFLAG_DEFAULT
                - LED_BATT_BELOW_10_PCT
                - LED_BATT_ABOVE_10_PCT

    child-binding:
        description: Color enum
        properties:
            led-color:
                type: string
                required: true
                enum:
                    - LED_OFF
                    - LED_RED
                    - LED_GREEN
                    - LED_BLUE
                    - LED_YELLOW
                    - LED_WHITE
                    - LED_AMBER
            period:
                description: In case of blinking LEDs, amount of time in secs
                             the LED color is active
                type: int
                required: false
```

## zephyr/dts/bindings/i2c/cros-ec,i2c-port-eeprom.yaml
```yaml
# Copyright (c) 2021 The Chromium OS Authors
# SPDX-License-Identifier: Apache-2.0

description: I2C port properties for the EEPROM node

compatible: "cros-ec,i2c-port-eeprom"

include: [cros-ec-i2c-port-base.yaml]

properties:
  addr-flags:
    type: int
    description:
      EEPROM flags.
```

## zephyr/dts/bindings/i2c/cros-ec,i2c-target-hid.yaml
```yaml
# SPDX-License-Identifier: Apache-2.0

description: |
  Zephyr I2C target HID implements the i2c-hid
  protocol as a i2c slave device.

compatible: "cros-ec,i2c-target-hid"

include: [i2c-device.yaml]

properties:
  reg:
    required: true

  max_report_size:
    type: int
    required: true

  alert_gpios:
    required: true
    type: phandle-array
    description:
      Active low GPIO to notify the i2c master to
      service a request.

  hid_descriptor:
    type: string
    description:
      The C function name that will be called to
      populate the hid report

  hid_report_descriptor:
    type: string
    description:
      The C function name that will be called to
      populate the hid report

  get_report_handler:
    type: string
    description:
      The C function name that will be called to
      populate the hid report

  set_report_handler:
    type: string
    description:
      The C function name that will be called to
      act on a set report from the host

  power_state_handler:
    type: string
    description:
      The C function name that will be called when
      the host updates the power state
```
