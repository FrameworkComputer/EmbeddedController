## zephyr/dts/bindings/emul/zephyr,syv682x.yaml
```yaml
# Copyright 2021 The Chromium OS Authors. All rights reserved.
# Use of this source code is governed by a BSD-style license that can be
# found in the LICENSE file.

description: Zephyr SYV682X Emulator

compatible: "zephyr,syv682x-emul"

include: base.yaml

properties:
  frs_en_gpio:
    type: phandle
    description: The GPIO that controls FRS enable on this device
    required: true
```

## zephyr/dts/bindings/emul/zephyr,tcs3400-emul.yaml
```yaml
# Copyright 2021 The ChromiumOS Authors
# Use of this source code is governed by a BSD-style license that can be
# found in the LICENSE file.

description: Zephyr ALS TCS3400 light sensor i2c emulator

compatible: "zephyr,tcs3400-emul"

include: base.yaml

properties:
  device-id:
    type: string
    enum:
      - TCS340015_DEVICE_ID
      - TCS340037_DEVICE_ID
    default: TCS340015_DEVICE_ID
    description: Device ID that is set in the register.

  revision:
    type: int
    default: 0
    description: Wafer die revision level that is set in the register.

  error-on-ro-write:
    type: boolean
    description:
      Flag indicating if error should be generated when read only register
      is being written.

  error-on-reserved-bit-write:
    type: boolean
    description:
      Flag indicating if error should be generated when reserved bit
      is being written.

  error-on-msb-first-access:
    type: boolean
    description:
      Flag indicating if error should be generated when MSB register of
      accelerometer value is accessed before LSB and shadowing is enabled
      at the same time.
```

## zephyr/dts/bindings/emul/zephyr,tusb1064.yaml
```yaml
# Copyright 2022 The ChromiumOS Authors
# Use of this source code is governed by a BSD-style license that can be
# found in the LICENSE file.
#
description: Zephyr TUSB1064 Emulator

compatible: "zephyr,tusb1064-emul"

include: "ti,tusb1064.yaml"
```

## zephyr/dts/bindings/fan/cros-ec,fan-steps.yaml
```yaml
# Copyright 2022 The ChromiumOS Authors
# Use of this source code is governed by a BSD-style license that can be
# found in the LICENSE file.
description: Fan steps parent node
compatible: "cros-ec,fan-steps"
child-binding:
  description: Support multiple thermal sensor temperature to trigger different fans speed,
               each step could have different rpm for each fan
  properties:
    temp_on:
      type: array
      description:
        Temperatures for each sensor to trigger next fan level,
        <sensor 0, sensor 1, sensor 2, ...> mapping to variant overlay
    temp_off:
      type: array
      description:
        Temperatures for each sensor to trigger previous fan level,
        <sensor 0, sensor 1, sensor 2, ...> mapping to variant overlay
    rpm_target:
      type: array
      description:
        Support multiple fan speed target for each level (in RPM),
        <fan0 rpm target, fan1 rpm target, ...>
```

## zephyr/dts/bindings/fan/named-fans.yaml
```yaml
# Copyright 2021 The Chromium OS Authors. All rights reserved.
# Use of this source code is governed by a BSD-style license that can be
# found in the LICENSE file.

description: Fan parent node

compatible: "named-fans"

child-binding:
  description: Named fan's child node
  properties:
    label:
      required: true
      type: string
      description:
        Human-readable string describing the device (used as
        device_get_binding() argument)
    rpm_min:
      required: true
      type: int
      description:
        Minimum fan speed (in RPM) to keep turning
    rpm_start:
      required: true
      type: int
      description:
        Fan speed (in RPM) to begin turning
    rpm_max:
      required: true
      type: int
      description:
        Maximum fan speed (in RPM)
    pwms:
      type: phandle-array
      required: true
      description:
        PWM channel to control the fan
    pwm-frequency:
      type: int
      description:
        PWM frequency in Hz.
    tach:
      type: phandle
      required: false
      description:
        Tachometer to measure the fan speed
    not_use_rpm_mode:
      required: false
      type: boolean
      description:
        Disable automatic RPM control using tachometer input
    use_fast_start:
      required: false
      type: boolean
      description:
        Fan requires a higher duty cycle to start up than to keep
        running
    pgood_gpio:
      required: false
      type: phandle
      description:
        Active high input GPIO which signals the power is good
    enable_gpio:
      required: false
      type: phandle
      description:
        Active high output GPIO to enable the power
```

## zephyr/dts/bindings/fingerprint/fingerprint-sensor.yaml
```yaml
# Copyright 2023 The Chromium OS Authors. All rights reserved.
# Use of this source code is governed by a BSD-style license that can be
# found in the LICENSE file.

# Common fields for fingerprint sensors

properties:
  width:
    type: int
    required: true
    description: |
      Fingerprint sensor width in pixels.

  height:
    type: int
    required: true
    description: |
      Fingerprint sensor height in pixels.

  bits-per-pixel:
    type: int
    required: true
    description: |
      Pixel resolution in bits.

  v4l2-pixel-format:
    type: string
    required: true
    enum:
      # Grey-scale image. It's a Y'CbCr format which contains no Cb or Cr data.
      # https://docs.kernel.org/userspace-api/media/v4l/pixfmt-yuv-luma.html
      - V4L2_PIX_FMT_GREY
    description: |
     Video4Linux2 pixel format type. List of pixel formats can be found at
     https://docs.kernel.org/userspace-api/media/v4l/pixfmt.html.
```

## zephyr/dts/bindings/fingerprint/fpc,fpc1025.yaml
```yaml
# Copyright 2023 The Chromium OS Authors. All rights reserved.
# Use of this source code is governed by a BSD-style license that can be
# found in the LICENSE file.

description: FPC1025 fingerprint sensor

compatible: "fpc,fpc1025"

include: [spi-device.yaml, fingerprint-sensor.yaml]

properties:
  irq-gpios:
    type: phandle-array
    required: true
    description: |
      This property specifies the connection for sensor interrupt.

  reset-gpios:
    type: phandle-array
    required: true
    description: |
      This property specifies the connection for sensor reset.
```

## zephyr/dts/bindings/gpio/cros,ioex-chip.yaml
```yaml
description: IEOX chip definition

compatible: "cros,ioex-chip"

include: [base.yaml]

properties:
  i2c-port:
    type: phandle
    description:
      Handle to the i2c named-port containing the IO expander chip

  i2c-addr:
    type: int
    required: true
    description:
      I2C address of chip

  flags:
    type: int
    required: true
    description:
      Value which represents IOEX_FLAGS_* or other internal flags
      for IO expander chip.

  drv:
    type: string
    required: true
    description:
      CrOS EC driver used to communicate with chip
    enum:
      - "ccgxxf_ioexpander_drv"
      - "it8801_ioexpander_drv"
      - "nct38xx_ioexpander_drv"
      - "pca9675_ioexpander_drv"
      - "pcal6408_ioexpander_drv"
      - "tca64xxa_ioexpander_drv"

  int-gpios:
    type: phandle-array
    description:
      GPIO connected to the interrupt output signal of IO expander chip

  "#address-cells":
    required: true
    const: 1
  "#size-cells":
    required: true
    const: 0
```

## zephyr/dts/bindings/gpio/cros,ioex-port.yaml
```yaml
description: IEOX port definition

compatible: "cros,ioex-port"

include: [gpio-controller.yaml, base.yaml]

properties:
    reg:
      required: true
      description:
        Number of port within IO expander

    "#gpio-cells":
      required: true
      const: 2
      description:
        Number of parameters describing the pin

    ngpios:
      required: true
      description:
        Number of pins per port

gpio-cells:
  - pin
  - flags
```

## zephyr/dts/bindings/gpio/cros-ec,gpio-interrupts.yaml
```yaml
# Copyright 2022 The ChromiumOS Authors
# Use of this source code is governed by a BSD-style license that can be
# found in the LICENSE file.
#
description: |
  GPIO interrupts list bindings.

  Uses device tree to configure the interrupt handling e.g

    int_lid_open: lid_open {
      irq-pin = <&gpio_lid_open>;
      flags = <GPIO_INT_EDGE_BOTH>;
      handler = "lid_interrupt";
    };

  The interrupt can be enabled either using the DTS label:

    gpio_enable_dt_interrupt(GPIO_INT_FROM_NODELABEL(int_lid_open));

  or the legacy:

    gpio_enable_interrupt(GPIO_LID_OPEN);

compatible: "cros-ec,gpio-interrupts"

child-binding:
  description: GPIO Interrupt definition.
  properties:
    #
    # This is named irq-pin rather than irq-gpio because
    # anything with a name appended with "gpio" is treated specially,
    # which causes warnings about missing #gpio-cells.
    #
    irq-pin:
      type: phandle
      required: true
      description: The named-gpio GPIO source of the interrupt.
    flags:
      type: int
      required: true
      description: The zephyr gpio interrupt config flags.
    handler:
      type: string
      description: The C function name attached to this interrupt.
```

## zephyr/dts/bindings/gpio/cros-ec,hibernate-vci-pin.yaml
```yaml
# Copyright 2024 The ChromiumOS Authors
# Use of this source code is governed by a BSD-style license that can be
# found in the LICENSE file.

description: Hibernate VCI Pins Configurations

compatible: "cros-ec,hibernate-vci-pin"

include: base.yaml
properties:
  reg:
    required: true
    type: array
    description: VCI input id number according to VCI_INx.

  vci-polarity:
    required: true
    type: string
    description: VCI input polarity (0=active low)
    enum:
      - "Active_Low"
      - "Active_High"

  vci-latch-enable:
    type: boolean
    description: If present enable latching of VCI input

  preserve:
    type: boolean
    description: If present its state will be preserved after exiting
      hibernation.

  wakeup:
    type: boolean
    description: If present this input will wake system up once entered in
      hibernation.
```

## zephyr/dts/bindings/gpio/cros-ec,hibernate-vci-pins.yaml
```yaml
# Copyright 2024 The ChromiumOS Authors
# Use of this source code is governed by a BSD-style license that can be
# found in the LICENSE file.

description: Hibernate VCI Pins Configurations

compatible: "cros-ec,hibernate-vci-pins"

child-binding:
  description: VCI child node
  properties:
    gpios:
      required: true
      type: phandle-array
      description: Reference to a VCI instance.

    vci-polarity:
      required: true
      type: string
      description: VCI input polarity (0=active low)
      enum:
        - "Active_Low"
        - "Active_High"

    vci-latch-enable:
      type: boolean
      description: If present enable latching of VCI input
```

## zephyr/dts/bindings/gpio/cros-ec,hibernate-wake-pins.yaml
```yaml
# Copyright 2021 The Chromium OS Authors. All rights reserved.
# Use of this source code is governed by a BSD-style license that can be
# found in the LICENSE file.

description: Hibernate Wake-up Pins Configurations

compatible: "cros-ec,hibernate-wake-pins"

properties:
  wakeup-irqs:
    type: phandles
    required: true
    description: Interrupt list for hibernate wake-up
```

## zephyr/dts/bindings/gpio/cros-ec,shared-spi-flash.yaml
```yaml
description: External Shared SPI falsh GPIO node

compatible: "cros-ec,shared-spi-flash"

properties:
  spi-oe-gpios:
    type: phandle-array
    required: true
    description: GPIO to configure access to the external shared flash
```

## zephyr/dts/bindings/gpio/cros-ec,usba-port-enable-pins.yaml
```yaml
# Copyright 2022 The Chromium OS Authors. All rights reserved.
# Use of this source code is governed by a BSD-style license that can be
# found in the LICENSE file.

description: USBA Port Enable Pins Configurations

compatible: "cros-ec,usba-port-enable-pins"

properties:
  enable-pins:
    type: phandles
    required: true
    description: List of USBA Port Enable Pins
```
