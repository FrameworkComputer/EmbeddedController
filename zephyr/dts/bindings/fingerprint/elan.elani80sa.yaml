## zephyr/dts/bindings/fingerprint/elan.elani80sa.yaml
```yaml
# Copyright 2026 The ChromiumOS Authors. All rights reserved.
# Use of this source code is governed by a BSD-style license that can be
# found in the LICENSE file.

description: ELANI80SA fingerprint sensor

compatible: "elan,elani80sa"

include: [spi-device.yaml]

properties:
  irq-gpios:
    type: phandle-array
    required: true
    description: |
      This property specifies the connection for sensor interrupt.

  reset-gpios:
    type: phandle-array
    required: true
    description: |
      This property specifies the connection for sensor reset.

  base-image:
    type: phandle
    description: |
      Phandle to a partition storing the fingerprint sensor's base image.

  ft-info:
    type: phandle
    description: |
      Phandle to a partition with the Factory Test information.
```

## zephyr/dts/bindings/fingerprint/fingerprint-image-frame-params.yaml
```yaml
# Copyright 2025 The Chromium OS Authors. All rights reserved.
# Use of this source code is governed by a BSD-style license that can be
# found in the LICENSE file.

description: |
  Image frame parameters for a single fingerprint sensor
  configuration.

compatible: "fingerprint-image-frame-params"

child-binding:
  properties:
    width:
      type: int
      required: true
      description: Fingerprint sensor width in pixels for this mode.

    height:
      type: int
      required: true
      description: Fingerprint sensor height in pixels for this mode.

    bits-per-pixel:
      type: int
      required: true
      description: Pixel resolution in bits for this mode.

    frame-size:
      type: int
      required: true
      description: Frame size (bytes) of captured fingerprint image.

    image-data-offset-bytes:
      type: int
      required: true
      description: Image offset in bytes from the start of the sensor buffer.

    v4l2-pixel-format:
      type: string
      required: true
      enum:
        # Grey-scale image. It's a Y'CbCr format which contains no Cb or Cr data.
        # https://docs.kernel.org/userspace-api/media/v4l/pixfmt-yuv-luma.html
        - V4L2_PIX_FMT_GREY
      description: |
        Video4Linux2 pixel format type for this mode.
        See https://docs.kernel.org/userspace-api/media/v4l/pixfmt.html

    capture-type:
      type: string
      required: true
      description: |
        Type of image capture.
      enum:
        - FINGERPRINT_CAPTURE_TYPE_VENDOR_FORMAT
        - FINGERPRINT_CAPTURE_TYPE_DEFECT_PXL_TEST
        - FINGERPRINT_CAPTURE_TYPE_ABNORMAL_TEST
        - FINGERPRINT_CAPTURE_TYPE_NOISE_TEST
        - FINGERPRINT_CAPTURE_TYPE_SIMPLE_IMAGE
        - FINGERPRINT_CAPTURE_TYPE_PATTERN0
        - FINGERPRINT_CAPTURE_TYPE_PATTERN1
        - FINGERPRINT_CAPTURE_TYPE_QUALITY_TEST
        - FINGERPRINT_CAPTURE_TYPE_RESET_TEST
```

## zephyr/dts/bindings/fingerprint/focaltech,ft98xx.yaml
```yaml
# Copyright 2026 The Chromium OS Authors. All rights reserved.
# Use of this source code is governed by a BSD-style license that can be
# found in the LICENSE file.

description: FT98XX fingerprint sensor

compatible: "focaltech,ft98xx"

include: [spi-device.yaml]

properties:
  irq-gpios:
    type: phandle-array
    required: true
    description: |
      This property specifies the connection for sensor interrupt.

  reset-gpios:
    type: phandle-array
    required: true
    description: |
      This property specifies the connection for sensor reset.
```

## zephyr/dts/bindings/hibernate/cros-ec,hibernate-z5.yaml
```yaml
# Copyright 2025 The ChromiumOS Authors
# Use of this source code is governed by a BSD-style license that can be
# found in the LICENSE file.

description: |
  Driver code to support hibernate to the Z5 power state using discrete
  logic on the board.

compatible: "cros-ec,hibernate-z5"

include: base.yaml

properties:
  en-slp-z-gpios:
    type: phandle-array
    required: true
    description: |
      GPIO pin connected to the EN_SLP_Z signal on the platform.  The driver
      asserts this signal to logic 1 when enabling hibernate mode.
```

## zephyr/dts/bindings/imvp/richtek,rt3645.yaml
```yaml
# Copyright 2025 The ChromiumOS Authors
# Use of this source code is governed by a BSD-style license that can be
# found in the LICENSE file.

description: Richtek RT3645 IMVP chip

include: i2c-device.yaml

compatible: "richtek,rt3645"

properties:
  enable-gpios:
    type: phandle-array
    required: true
    description: |
      Power supply control for RT3645 (zephyr standard GPIO format)
  update-data:
    type: array
    required: true
    description: |
      Array of RT3645_UPDATE_ENTRY() entries corresponding to [page, reg, val]
  update-crc:
    type: int
    required: true
    description: CRC value for validation of updated data. This value is data dependent.
```

## zephyr/dts/bindings/input/cros-ec,fn-keys.yaml
```yaml
# Copyright 2025 Google LLC
# Use of this source code is governed by a BSD-style license that can be
# found in the LICENSE file.

description: |
  Fn keys definition

  This can be used to TODO TODO TODO

  Example configuration:

  kbd {
      fn-keys {
          compatible = "cros-ec,fn-keys";

          fn-rc = <KBD_RC(2, 0)>;
          keymap = <
            MATRIX_KEY(1, 1, KBD_SCANCODE_F1)
            MATRIX_KEY(0, 2, KBD_SCANCODE_F2)
            ...
            MATRIX_KEY(0, 4, KBD_SCANCODE_F11)
            MATRIX_KEY(3, 9, KBD_SCANCODE_F12)
          >;
      };
  };

compatible: "cros-ec,fn-keys"

include: base.yaml

properties:
  fn-rc:
    type: int
    required: true
    description: Row-column position of the "Fn" key.

  keymap:
    type: array
    required: true
    description: |
      List of row, key and codes, using the MATRIX_KEY() macro.
```

## zephyr/dts/bindings/input/cros-ec,scancode-set2.yaml
```yaml
# Copyright 2025 Google LLC
# Use of this source code is governed by a BSD-style license that can be
# found in the LICENSE file.

description: |
  Set2 scancode definition

  This defines a scancode_set2 array and the corresponding set and get
  functions.

  Example configuration:

  kbd {
    scancode-set2 {
      compatible = "cros-ec,scancode-set2";

      col0-codes = <0x0000 0x0000 0x0000 0xe01f 0x0000 0x0000 0x0000 0x0000>;
      col1-codes = <0x0078 0x0076 0x000d 0x000e 0x001c 0x0016 0x001a 0x003c>;
      ...
    };
  };

compatible: "cros-ec,scancode-set2"

include: base.yaml

child-binding:
  properties:
    col0-codes:
      type: array
      required: true
      description: The codes for col0, 8 values.

    col1-codes:
      type: array
      required: true

    col2-codes:
      type: array
      required: true

    col3-codes:
      type: array
      required: true

    col4-codes:
      type: array
      required: true

    col5-codes:
      type: array
      required: true

    col6-codes:
      type: array
      required: true

    col7-codes:
      type: array
      required: true

    col8-codes:
      type: array
      required: true

    col9-codes:
      type: array
      required: true

    col10-codes:
      type: array
      required: true

    col11-codes:
      type: array
      required: true

    col12-codes:
      type: array
      required: true

    col13-codes:
      type: array

    col14-codes:
      type: array

    col15-codes:
      type: array

    col16-codes:
      type: array

    col17-codes:
      type: array
```

## zephyr/dts/bindings/input/framework,input-deck.yaml
```yaml
description: |
  Framework Laptop 12 input deck.

  Describes the GPIO signals and capabilities that a particular input deck
  exposes. One of these nodes is selected at runtime by deck-detection (board-ID).
  Each mainboard's project.overlay includes the decks possible .dtsi files.

compatible: "framework,input-deck"

properties:
  deck-type:
    type: string
    required: true
    enum:
      - unknown
      - sunflower
      - dahlia
    description: |
      Symbolic deck identity. The index in this enum is exposed via
      enum input_deck_type in board_adc.h and selects per-deck branches
      in C code. Order MUST match that enum.

  board-id:
    type: int
    required: true
    description: |
      Touchpad-ID ADC value (BOARD_VERSION_*) that identifies this deck runtime.

  tp-en-gpios:
    type: phandle-array
    description: GPIO that powers/enables the touchpad on this deck.

  kbd-en-gpios:
    type: phandle-array
    description: GPIO that enables the keyboard input on this deck.

  lock-led-gpios:
    type: phandle-array
    description: GPIO that drives a Caps Lock indicator LED on this deck.

  matrix-scan:
    type: boolean
    description: Deck uses IT8801 KSI/KSO matrix-scan for keyboard input.

  hid-keyboard:
    type: boolean
    description: Deck delivers keyboard input via I2C HID.

  backlight:
    type: boolean
    description: Deck has a PWM keyboard backlight.
```

## zephyr/dts/bindings/intel/intel,rvp-board-id.yaml
```yaml
# Copyright 2022 The ChromiumOS Authors
# Use of this source code is governed by a BSD-style license that can be
# found in the LICENSE file.

description: Intel RVP Board id

compatible: "intel,rvp-board-id"

include: base.yaml

properties:
  bom-gpios:
    type: phandle-array
    description: |
     A list contains GPIO pins corresponding to BOM ID bits.

  fab-gpios:
    type: phandle-array
    description: |
     A list contains GPIO pins corresponding to FAB ID bits.

  board-gpios:
    type: phandle-array
    required: true
    description: |
     A list contains GPIO pins corresponding to BOARD ID bits.

  defer-until-s5:
    type: phandle
    description: |
     Define the IOEX device node which needs to be deferred
     until EC boots to S5 for RVP, as the power rail to the
     IOEX comes up in S5 state.

  handler:
    type: string
    description: |
     The C function name to call as a notification event when the board
     ID is available.
```

## zephyr/dts/bindings/leds/cros-ec,fwk-led-policy.yaml
```yaml
# Copyright 2024 The ChromiumOS Authors
# Use of this source code is governed by a BSD-style license that can be
# found in the LICENSE file.

description: LED policy parent node

compatible: "cros-ec,fwk-led-policy"

include: cros-ec,led-policy.yaml

child-binding:
  properties:
    standalone-mode:
      description: |
        If the LED color depends on standalone mode, use this property
        to describe the LED behavior in standalone mode.
        e.g.
        standalone-mode-s0 {
          chipset-state = "POWER_S0";
          charge-state = "LED_PWRS_CHARGE";
          standalone-mode;
          led-0 {
            led-id = "EC_LED_ID_BATTERY_LED";
            color-0 {
              led-color = "LED_WHITE";
            };
          };
        };
      type: boolean
```
