## zephyr/dts/bindings/leds/cros-ec,led-policy.yaml
```yaml
# Copyright 2021 The ChromiumOS Authors
# Use of this source code is governed by a BSD-style license that can be
# found in the LICENSE file.

description: LED policy parent node

compatible: "cros-ec,led-policy"

properties:
  led-pins:
    description: |
      Phandle to the physical LED hardware node (e.g. cros-ec,pwm-led-pins,
      cros-ec,gpio-led-pins) that this policy block controls.
    type: phandle
    required: true
  sysrq-alias:
    description: |
      This property is for making another existing led behaves as the
      EC_LED_ID_SYSRQ_DEBUG_LED when any call to `led_control` on the
      SYSRQ_DEBUG_LED.
    type: string
    default: EC_LED_ID_SYSRQ_DEBUG_LED
    enum: &led-id-enum
      - EC_LED_ID_BATTERY_LED
      - EC_LED_ID_POWER_LED
      - EC_LED_ID_ADAPTER_LED
      - EC_LED_ID_LEFT_LED
      - EC_LED_ID_RIGHT_LED
      - EC_LED_ID_RECOVERY_HW_REINIT_LED
      - EC_LED_ID_SYSRQ_DEBUG_LED
      - EC_LED_ID_LIGHTBAR_LED
  sysrq-led-control-color:
    description: |
      Specify what color to display when `led_control` makes the LED
      EC_LED_ID_SYSRQ_DEBUG_LED active.
    type: string
    default: LED_BLUE
    enum: &led-color-enum
      - LED_OFF
      - LED_RED
      - LED_GREEN
      - LED_BLUE
      - LED_YELLOW
      - LED_WHITE
      - LED_AMBER
  recovery-hw-reinit-alias:
    description: |
      This property is for making another existing led behaves as the
      EC_LED_ID_RECOVERY_HW_REINIT_LED when any call to `led_control` on the
      RECOVERY_HW_REINIT_LED.
    type: string
    default: EC_LED_ID_RECOVERY_HW_REINIT_LED
    enum: *led-id-enum
  recovery-hw-reinit-led-control-color:
    description: |
      Specify what color to display when `led_control` makes the LED
      EC_LED_ID_RECOVERY_HW_REINIT_LED active.
    type: string
    default: LED_BLUE
    enum: *led-color-enum

child-binding:
  description: |
    LED policy nodes to describe the policy combination a node depends on, and
    the color to set to for that combination.
    e.g. If Blue color needs to be set for charge state discharge in S0, a
    node looks like
    power-state-discharge-s0 {
       charge-state = "LED_PWRS_DISCHARGE";
       chipset-state = "POWER_S0";
       charge-port = <0>;
       led-0 {
         led-id = "EC_LED_ID_BATTERY_LED";
         color-0 {
           led-color = "LED_BLUE";
         };
       };
    };

  properties:
    charge-state:
      description: |
        If the LED color depends on charge state, this property is used
        to describe it.
        LED_PWRS_CHARGE - AC is connected, battery is charging.
        LED_PWRS_DISCHARGE - AC is not connected, battery is discharging.
        LED_PWRS_ERROR - Battery is in error state.
        LED_PWRS_IDLE - AC is connected, battery is not charging.
        LED_PWRS_FORCED_IDLE - AC is connected, battery is not charging.
                                Used during factory testing.
        LED_PWRS_CHARGE_NEAR_FULL - AC is connected, battery is charging
                                     and close to fully charged.
      type: string
      enum:
        - LED_PWRS_CHARGE
        - LED_PWRS_DISCHARGE
        - LED_PWRS_ERROR
        - LED_PWRS_IDLE
        - LED_PWRS_FORCED_IDLE
        - LED_PWRS_CHARGE_NEAR_FULL

    charge-port:
      description: |
        If the LED color depends on the charging port (left or right).
      type: int

    chipset-state:
      description: |
        If the LED color depends on chipset state, this property is used
        to describe it.
      type: string
      enum:
        - POWER_S0
        - POWER_S3
        - POWER_S5

    batt-state-mask:
      description: |
        If the LED color depends on battery state, this property is used
        to describe the kind of battery state.
        Use the macros defined in dt-bindings/battery.h.
        e.g. SB_STATUS_DISCHARGING - Battery is discharging.
      type: int

    batt-state:
      description: |
        If the LED color depends on battery state, this property is used
        to select the battery state value base on batt-state-mask.
      type: int

    batt-lvl:
      description: |
        If the LED color depends on current battery level, this property
        is used to describe batt_lvl range using closed interval [x,y].
        Use the macros defined in dt-bindings/battery.h.
        e.g. <BATTERY_LEVEL_EMPTY BATTERY_LEVEL_LOW> describes battery level
             range of BATTERY_LEVEL_EMPTY to BATTERY_LEVEL_LOW inclusive.
      type: array

    board-led-alt-policy-label:
      description: |
        If the LED color depends on board level alternated policy, this
        property is used to describe it.
        Use int to mark each alt policy, and define board_led_alt_policy() in
        board level src/led_customization.c to determine LED board level
        alternated policy, which returns int value that represents the label
        of board-led-alt-policy.
      type: int

  child-binding:
    properties:
      led-id:
        description: |
          This property is the same as the one required by the
          EC_CMD_LED_CONTROL host command.
          It must match the enum names defined in ec_commands.h.
        type: string
        required: true
        enum: *led-id-enum
      transition:
        description: |
          This property describes the type of transition this LED will use
          to transition from one color to the next.
        type: string
        enum:
          - LED_TRANSITION_STEP
          - LED_TRANSITION_LINEAR
          - LED_TRANSITION_EXPONENTIAL
      cycle-count:
        type: int
        description: |
          Number of times the sequence repeats before stopping.
          0 (default) implies infinite loop.
          If N > 0, the sequence runs N times and then holds the state
          of the last defined color in the pattern.
    child-binding:
      properties:
        led-color:
          description: |
            Phandle to the LED pin configuration node.
          type: phandle
          required: true
        period-ms:
          description: |
            Duration in msecs for this pattern step. This applies to both
            blinking (LED_TRANSITION_STEP) and fading transitions (e.g.
            LED_TRANSITION_LINEAR).

            The resolution is determined by
            CONFIG_PLATFORM_EC_LED_ANIMATION_TICK_MS (default 30ms). If the
            value is not a multiple of the tick interval, the actual duration
            of individual steps will be quantized to the nearest tick. This
            may result in slight timing jitter between cycles, though the
            average duration will remain correct.

            e.g.
            power-state-error {
               charge-state = "LED_PWRS_ERROR";
               led-0 {
                 led-node = "EC_LED_ID_BATTERY_LED";
                 /* One sec Amber, one sec Off */
                 color-0 {
                   led-color = "LED_AMBER";
                   period-ms = <1000>;
                 };
                 color-1 {
                   led-color = "LED_OFF";
                   period-ms = <1000>;
                 };
               };
            };
          type: int
```

## zephyr/dts/bindings/motionsense/drvdata/cros-ec,drvdata-cm36781.yaml
```yaml
# Copyright 2021 The ChromiumOS Authors
# Use of this source code is governed by a BSD-style license that can be
# found in the LICENSE file.

description: CM36781 CLEAR driver data

compatible: "cros-ec,drvdata-cm36781"

include: drvdata-base.yaml

#
# examples:
#
# cm36781_data: cm36781-drv-data {
#        compatible = "cros-ec,drvdata-cm36781";
#        status = "okay";
#
#        als-drv-data {
#                compatible = "cros-ec,accelgyro-als-drv-data";
#                als-cal {
#                        scale = <1>;
#                        uscale = <0>;
#                        offset = <0>;
#                        als-channel-scale {
#                                compatible = "cros-ec,accelgyro-als-channel-scale";
#                                k-channel-scale = <1>;
#                                cover-scale = <1>;
#                        };
#                };
#        };
# };
#
```

## zephyr/dts/bindings/pchg/nxp,ctn730.yaml
```yaml
# Copyright 2025 The ChromiumOS Authors
# Use of this source code is governed by a BSD-style license that can be
# found in the LICENSE file.

description: NXP CTN730 driver

compatible: "nxp,ctn730"

include: wpc-chip.yaml

properties:
  irq-gpios:
    type: phandle-array
    description: |
      Interrupt line from the WPC (zephyr standard GPIO format)

  full-percent:
    type: int
    default: 96
    description: full charge status is implied by capacity = 96

  block-size:
    type: int
    default: 128
    description: block size is 128

  rf-charge-msec:
    type: int
    default: 0
    description: stylus recovery time
```

## zephyr/dts/bindings/temp/cros-ec,temp-sensor-apl6012.yaml
```yaml
# Copyright 2025 The ChromiumOS Authors
# Use of this source code is governed by a BSD-style license that can be
# found in the LICENSE file.

description: >
  Properties for a APL6012 I2C temperature sensor

compatible: "cros-ec,temp-sensor-apl6012"

include: i2c-device.yaml

child-binding:
  description: APL6012 ADC channels

  properties:
    temperature-type:
      type: string
      required: true
      description: Temperature source type (e.g. APL6012_IDX_CH1)
      enum:
      - APL6012_IDX_CH1
      - APL6012_IDX_CH2
      - APL6012_IDX_CH3
      - APL6012_IDX_CH4
      - APL6012_IDX_CH5
      - APL6012_IDX_CH6
      - APL6012_IDX_CH7
      - APL6012_IDX_CH8
      - APL6012_IDX_CH9
      - APL6012_IDX_CH10
      - APL6012_IDX_CH11
      - APL6012_IDX_CH12
      - APL6012_IDX_CH13
      - APL6012_IDX_CH14
      - APL6012_IDX_CH15

    thermistor:
      type: phandle
      required: true
      description: Reference to thermistor config node
```

## zephyr/dts/bindings/touchpad/focaltech,fts.yaml
```yaml
# Copyright 2023 The ChromiumOS Authors
# Use of this source code is governed by a BSD-style license that can be
# found in the LICENSE file.

description: focaltech I2C touchpad

compatible: "focaltech,fts"

include: i2c-device.yaml

properties:
  irq:
    type: phandle
    required: true
    description: Interrupt from touchpad

  logical-max-x:
    type: int
    required: true
    description: The logical maximum x-axis setting

  logical-max-y:
    type: int
    required: true
    description: The logical maximum y-axis setting

  physical-max-x:
    type: int
    required: true
    description: The physical maximum x-axis setting

  physical-max-y:
    type: int
    required: true
    description: The physical maximum y-axis setting

  max-pressure:
    type: int
    description: The maximum pressure for touchpad
```

## zephyr/dts/bindings/usbc/pdc/ti,tps6699-pdc.yaml
```yaml
# Copyright 2024 Google LLC
# Use of this source code is governed by a BSD-style license that can be
# found in the LICENSE file.

description: TI TPS6699X PDC

compatible: "ti,tps6699-pdc"

include: ["i2c-device.yaml", "pdc-device.yaml"]

properties:
  irq-gpios:
    type: phandle-array
    required: true
    description: |
      Interrupt line from the PD for power path (zephyr standard GPIO format)
  port-index-on-chip:
    type: int
    enum:
      - 1
      - 2
    required: true
    description: |
      The index is used in power switch tasks to determine the switch and is
      used as connector number in UCSI 4CC tasks. For single-port PDCs, the
      index must be 1. For dual-port PDCs, one of the index should be 1 and the
      other should be 2.
  frs-supported:
    type: boolean
    required: true
    description: |
      Whether the PDC supports FRS.
```

## zephyr/dts/bindings/wake_on_lan/cros-ec,wake-on-lan.yaml
```yaml
# SPDX-License-Identifier: Apache-2.0

description: |
  EC can monitor the wake on lan signal to power on the
  system.

compatible: "cros-ec,wake-on-lan"


properties:

  enable-pin:
    required: true
    type: phandle
    description:
      GPIO used to enable the LAN power.

  wake-signal:
    required: true
    type: phandle
    description:
      Wake on lan signal status.

  wake-signal-irq:
    required: true
    type: phandle
    description:
      GPIO to use to handle the wake on lan signal to power
      on the system.
```

## zephyr/program/atria/Kconfig
```kconfig
# Copyright 2026 The ChromiumOS Authors
# Use of this source code is governed by a BSD-style license that can be
# found in the LICENSE file.

config BOARD_ATRIARVP_RTK
	bool "Google Atria Realtek (rtk5915) add-in card for the RVP"
	help
	  Build Realtek RTK5915-based add-in card for Google Atria.
	  This board is for use with the Intel RVP using the MECC 2.1 connector.

module = Atria
module-str = Atria board-specific code
source "subsys/logging/Kconfig.template.log_config"

source "Kconfig.zephyr"
```

## zephyr/program/bluey/Kconfig
```kconfig
# Copyright 2025 The ChromiumOS Authors
# Use of this source code is governed by a BSD-style license that can be
# found in the LICENSE file.

config BOARD_BLUEY
	bool "Google Bluey baseboard"
	help
	  Build Google Bluey reference board.  The board uses Nuvoton
	  NPCX9 chip as the EC.

config BOARD_QUENBI
	bool "Google Quenbi baseboard"
	help
	  Build Google Quenbi reference board. The board uses Nuvoton
	  NPCX9 chip as the EC.

config BOARD_QUARTZ
	bool "Google Quartz baseboard"
	help
	  Build Google Quartz board. The board uses Nuvoton
	  NPCX9 chip as the EC.

config BOARD_MICA
	bool "Google MICA baseboard"
	help
	  Build Google MICA board. The board uses Nuvoton
	  NPCX9 chip as the EC.

module = Bluey
module-str = Bluey board-specific code
source "subsys/logging/Kconfig.template.log_config"

source "Kconfig.zephyr"
```

## zephyr/program/brox/Kconfig
```kconfig
# Copyright 2023 The ChromiumOS Authors
# Use of this source code is governed by a BSD-style license that can be
# found in the LICENSE file.

config BOARD_BROX
	bool "Google Brox Board"
	help
	  Build Google Brox reference board.  This board uses an Intel RPL SoC
	  and ITE EC

config BOARD_CABOC
	bool "Google Caboc Board"
	help
	  Build Google Caboc variant board.  This board uses an Intel RPL SoC
	  and ITE EC

config BOARD_GREENBAYUPOC
	bool "Google Greenbayupoc Board"
	help
	  Build Google Greenbayupoc reference board.  This board uses an Intel RPL SoC
	  and ITE EC

config BOARD_JUCHI
	bool "Google Juchi Board"
	help
	  Build Google Juchi variant board. This board uses an Intel RPL SoC
	  and ITE EC

config BOARD_JUBILANT
	bool "Google Jubilant Board"
	help
	  Build Google Jubilant variant board. This board uses an Intel RPL SoC
	  and ITE EC

config BOARD_LOTSO
	bool "Google Lotso Board"
	help
	  Build Google Lotso variant board. This board uses an Intel RPL SoC
	  and ITE EC

config BOARD_BRTK
	bool "Google Brtk Board"
	help
	  Build Google Brtk reference board.  This board uses an Intel RPL SoC
	  and RTK EC

module = Brox
module-str = Brox board-specific code
source "subsys/logging/Kconfig.template.log_config"

choice PLATFORM_EC_USBC_STACK
	default PLATFORM_EC_USB_PD_CONTROLLER
endchoice

# Caboc and lotso provide a GPIO for battery presence. All other boards read
# the fuel gauge over I2C to determine battery presence.
choice PLATFORM_EC_BATTERY_PRESENT_MODE
	default PLATFORM_EC_BATTERY_PRESENT_GPIO if BOARD_CABOC || BOARD_LOTSO
	default PLATFORM_EC_BATTERY_PRESENT_NONE
endchoice

source "Kconfig.zephyr"
```
