## zephyr/dts/bindings/i2c/cros-ec-i2c-port-base.yaml
```yaml
# Copyright 2021 The ChromiumOS Authors
# SPDX-License-Identifier: Apache-2.0

description: I2C port base properties

properties:
  i2c-port:
    type: phandle
    required: true
  remote-port:
    type: int
    description:
      A port number used by remote components like Kernel via the I2C_PASSTHRU
      Host Command
  enum-names:
    type: string-array
    required: true
    description:
      Enum values used in the source code to refer to the i2c port
  dynamic-speed:
    type: boolean
    description:
      Enables run-time speed configuration.
```

## zephyr/dts/bindings/i2c/i2c-keys.yaml
```yaml
# Copyright (c) 2020 The Chromium OS Authors
# SPDX-License-Identifier: Apache-2.0

description: I2C KEYS parent node

compatible: "i2c-keys"

child-binding:
  description: I2C KEYS child node
  properties:
    i2c-port:
      type: phandle
      required: true
    label:
      required: true
      type: string
      description: Human readable string describing the device (used as device_get_binding() argument)
```

## zephyr/dts/bindings/i2c/named-i2c-ports.yaml
```yaml
# Copyright (c) 2020 The Chromium OS Authors
# SPDX-License-Identifier: Apache-2.0

description: Named I2C ports parent node

compatible: "named-i2c-ports"

child-binding:
  description: Named I2C ports child node
  include: [cros-ec-i2c-port-base.yaml]
```

## zephyr/dts/bindings/input/cros-ec,boot-keys.yaml
```yaml
# Copyright 2024 Google LLC
# Use of this source code is governed by a BSD-style license that can be
# found in the LICENSE file.

description: |
  Boot keys definition.

  This can be used to define the key combinations that trigger boot key events:
  recovery mode, force memory retraining and boot without starting the AP.

  Example configuration:

  kbd {
      boot-keys {
          compatible = "cros-ec,boot-keys";
          down-arrow-rc = <KBD_RC(6, 11)>;
          esc-rc = <KBD_RC(1, 1)>;
          left-shift-rc = <KBD_RC(5, 7)>;
          refresh-rc = <KBD_RC(3, 2)>;
      };
  };

compatible: "cros-ec,boot-keys"

include: base.yaml

properties:
  down-arrow-rc:
    type: int
    required: true
    description: Row-column position of the "down arrow" key.

  esc-rc:
    type: int
    required: true
    description: Row-column position of the "esc" key.

  left-shift-rc:
    type: int
    required: true
    description: Row-column position of the "left shift" key.

  refresh-rc:
    type: int
    required: true
    description: Row-column position of the "refresh" key.
```

## zephyr/dts/bindings/input/cros-ec,col-gpio.yaml
```yaml
# Copyright 2023 Google LLC
# Use of this source code is governed by a BSD-style license that can be
# found in the LICENSE file.

description: |
  Keyboard matrix device GPIO column drive

  This can be used to handle a specific keyboard matrix column using a GPIO.
  Instantiate as a child node of the keyboard matrix device itself.

  Example configuration:

  &kbd {
      ...
      kso-gpio {
          compatible = "cros-ec,col-gpio";
          col-num = <2>;
          col-gpios = <&gpio1 7 GPIO_ACTIVE_HIGH>;
      };
  };

compatible: "cros-ec,col-gpio"

include: base.yaml

properties:
  col-num:
    type: int
    required: true
    description: Column number to handle

  col-gpios:
    type: phandle-array
    required: true
    description: GPIO to use to handle the column
```

## zephyr/dts/bindings/input/cros-ec,keyboard-factory-test.yaml
```yaml
# Copyright 2024 Google LLC
# Use of this source code is governed by a BSD-style license that can be
# found in the LICENSE file.

description: |
  Keyboard factory test definitions.

  This configures the keyboard factory test functionality. It has to be
  instantiated as a child node of the keyboard controller device, and the
  keyboard device must have a "sleep" pinctrl state that restores the pins to
  the gpio functionality.

  Example configuration:

  kbd {
    pinctrl-0 = <...>;
    pinctrl-1 = <...>;
    pinctrl-names = "default", "sleep";

    factory-test {
      compatible = "cros-ec,keyboard-factory-test";

      pin1-gpios = <&gpioksoh 4 GPIO_ACTIVE_HIGH>;
      pin2-gpios = <&gpioksoh 0 GPIO_ACTIVE_HIGH>;
      pin3-gpios = <&gpioksoh 1 GPIO_ACTIVE_HIGH>;
      ...
    };
  };

compatible: "cros-ec,keyboard-factory-test"

include: base.yaml

properties:
  pin1-gpios:
    type: phandle-array
    description: The gpio connected to the keyboard connector pin 1.

  pin2-gpios:
    type: phandle-array

  pin3-gpios:
    type: phandle-array

  pin4-gpios:
    type: phandle-array

  pin5-gpios:
    type: phandle-array

  pin6-gpios:
    type: phandle-array

  pin7-gpios:
    type: phandle-array

  pin8-gpios:
    type: phandle-array

  pin9-gpios:
    type: phandle-array

  pin10-gpios:
    type: phandle-array

  pin11-gpios:
    type: phandle-array

  pin12-gpios:
    type: phandle-array

  pin13-gpios:
    type: phandle-array

  pin14-gpios:
    type: phandle-array

  pin15-gpios:
    type: phandle-array

  pin16-gpios:
    type: phandle-array

  pin17-gpios:
    type: phandle-array

  pin18-gpios:
    type: phandle-array

  pin19-gpios:
    type: phandle-array

  pin20-gpios:
    type: phandle-array

  pin21-gpios:
    type: phandle-array

  pin22-gpios:
    type: phandle-array

  pin23-gpios:
    type: phandle-array

  pin24-gpios:
    type: phandle-array

  pin25-gpios:
    type: phandle-array

  pin26-gpios:
    type: phandle-array

  pin27-gpios:
    type: phandle-array

  pin28-gpios:
    type: phandle-array

  pin29-gpios:
    type: phandle-array

  pin30-gpios:
    type: phandle-array

  pin31-gpios:
    type: phandle-array

  pin32-gpios:
    type: phandle-array
```

## zephyr/dts/bindings/input/cros-ec,runtime-keys.yaml
```yaml
# Copyright 2024 Google LLC
# Use of this source code is governed by a BSD-style license that can be
# found in the LICENSE file.

description: |
  Runtime keys definition.

  This can be used to define the key combinations that trigger runtime key
  events for reboot and hibernate.

  Example configuration:

  runtime-keys {
      compatible = "cros-ec,runtime-keys";
      vol-up-rc = <KBD_RC(0, 4)>;
      left-alt-rc = <KBD_RC(0, 10)>;
      right-alt-rc = <KBD_RC(6, 10)>;
      h-rc = <KBD_RC(1, 6)>;
      r-rc = <KBD_RC(7, 3)>;
  };

compatible: "cros-ec,runtime-keys"

include: base.yaml

properties:
  vol-up-rc:
    type: int
    required: true
    description: Row-column position of the "volume up" key.

  left-alt-rc:
    type: int
    required: true
    description: Row-column position of the "left alt" key.

  right-alt-rc:
    type: int
    required: true
    description: Row-column position of the "right alt" key.

  h-rc:
    type: int
    required: true
    description: Row-column position of the "h" key.

  r-rc:
    type: int
    required: true
    description: Row-column position of the "r" key.
```

## zephyr/dts/bindings/input/cros-ec,vivaldi-kbd.yaml
```yaml
# Copyright 2024 Google LLC
# Use of this source code is governed by a BSD-style license that can be
# found in the LICENSE file.

description: |
  Vivaldi Keyboard mapping

  This can be used for redefining the mapping of the top row keys (T1 to T15)
  and the associated functionality. It redefines scancodes for the specified
  keys and implement the EC_CMD_GET_KEYBD_CONFIG host command to notify the
  system of the actual key layout.

  Example configuration:

  #include <zephyr/dt-bindings/vivaldi_kbd.h>

  vivaldi_kbd: vivaldi-kbd {
          compatible = "cros-ec,vivaldi-kbd";
          vivaldi-keys = <
                  KBD_RC(0, 2)   /* T1 */
                  KBD_RC(3, 2)   /* T2 */
                  KBD_RC(2, 2)   /* T3 */
                  KBD_RC(1, 2)   /* T4 */
                  KBD_RC(3, 4)   /* T5 */
                  KBD_RC(2, 4)   /* T6 */
                  KBD_RC(1, 4)   /* T7 */
                  KBD_RC(2, 9)   /* T8 */
                  KBD_RC(1, 9)   /* T9 */
                  KBD_RC(0, 4)   /* T10 */
                  KBD_RC(0, 1)   /* T11 */
                  KBD_RC(1, 5)   /* T12 */
                  KBD_RC(3, 5)   /* T13 */
                  KBD_RC(0, 9)   /* T14 */
                  KBD_RC(0, 11)  /* T15 */
          >;

          kbd_config_0: kbd-config-0 {
                  vivaldi-codes = <
                          VIVALDI_TK_BACK              /* T1 */
                          VIVALDI_TK_FORWARD           /* T2 */
                          VIVALDI_TK_REFRESH           /* T3 */
                          VIVALDI_TK_FULLSCREEN        /* T4 */
                          VIVALDI_TK_OVERVIEW          /* T5 */
                          VIVALDI_TK_BRIGHTNESS_DOWN   /* T6 */
                          VIVALDI_TK_BRIGHTNESS_UP     /* T7 */
                          VIVALDI_TK_VOL_MUTE          /* T8 */
                          VIVALDI_TK_VOL_DOWN          /* T9 */
                          VIVALDI_TK_VOL_UP            /* T10 */
                  >;
                  capabilities = <VIVALDI_KEYBD_CAP_SCRNLOCK_KEY>;
          };
  };

  If more than one child nodes is present, the application must implement a
  board_vivaldi_keybd_idx() function to select the correct configuration,
  typically using the DT_NODE_CHILD_IDX() macro to indenty the index of the
  desired child node.

compatible: "cros-ec,vivaldi-kbd"

include: base.yaml

properties:
  vivaldi-keys:
    type: array
    required: true
    description: |
      Array of KBD_RC() entries corresponding to the (row, column) location of
      the top keys, starting from T1.

child-binding:
  properties:
    vivaldi-codes:
      type: array
      required: true
      description: |
        Array of TK_ key codes for the top keys, starting from T1.

    capabilities:
      type: int
      required: true
      description: |
        Capabiliies bits for the device, or-btmask of KEYBD_CAP_ entries.
```

## zephyr/dts/bindings/kb_discrete/ite,it8801.yaml
```yaml
# Copyright 2022 The Chromium OS Authors. All rights reserved.
# Use of this source code is governed by a BSD-style license that can be
# found in the LICENSE file.

description: IT8801 discrete Keyboard matrix with PWM & GPIO

compatible: "ite,it8801"

include: i2c-device.yaml

#
# examples:
#
# kb_not_raw: ite-it8801@38 {
#         compatible = "ite,it8801";
#         reg = <0x38>;
#         label = "KEYBOARD_DISCRETE";
# };
#
```

## zephyr/dts/bindings/keyboard/cros-ec,kblight-pwm.yaml
```yaml
# Copyright 2022 The ChromiumOS Authors
# Use of this source code is governed by a BSD-style license that can be
# found in the LICENSE file.

description: PWM keyboard backlight configuration

compatible: "cros-ec,kblight-pwm"

include: base.yaml

properties:
  pwms:
    type: phandle-array
    required: true
    description: PWM controlling the Keyboard backlight level.

  generic-pwm-channel:
    type: int
    description: Generic PWM channel number for legacy compatibility.
```

## zephyr/dts/bindings/keyboard/cros-keyscan.yaml
```yaml
 # Copyright 2021 The Chromium OS Authors. All rights reserved.
 # Use of this source code is governed by a BSD-style license that can be
 # found in the LICENSE file.

description: Keyboard scanning properties

compatible: "cros-keyscan"

properties:
    output-settle:
      type: int
      required: false
      default: 80
      description: |
          Delay time, in microseconds, between setting up output and waiting for
          it to settle. 80 microseconds is the recommended value when column 2
          of the keyboard passes through the Google Security Chip. Otherwise 50
          microseconds is the recommended value.

    debounce-down:
      type: int
      required: false
      default: 9000
      description: |
          Time, in microseconds, to debounce key-down.

    debounce-up:
      type: int
      required: false
      default: 30000
      description: |
          Time, in microseconds, to debounce key-up.

    scan-period:
      type: int
      required: false
      default: 3000
      description: |
          Time between scans when keyboard scan task runs in polling mode.

    min-post-scan-delay:
      type: int
      required: false
      default: 1000
      description: |
          Minimum time between end of one scan and start of the next one.
          This ensures keyboard scanning doesn't starve the rest of the system
          if the scan period is set too short, or if other higher-priority
          system activity is starving the keyboard scan task too.

    poll-timeout:
      type: int
      required: false
      default: 100000
      description: |
          Revert to interrupt mode after no keyboard activity for this period.
          Specified in microseconds.

    actual-key-mask:
      type: array
      required: false
      default: [
        0x1c, # C0
        0xff, # C1
        0xff, # C2
        0xff, # C3
        0xff, # C4
        0xf5, # C5
        0xff, # C6
        0xa4, # C7
        0xfe, # C8
        0x55, # C9
        0xfa, # C10
        0xff, # C11
        0xca, # C12
        0x00, # C13 for keypad
        0x00, # C14 for keypad
      ]
      description: |
          Keyboard scanning mask. For each keyboard column, specify which
          keyboard rows actually exist. Default key mask includes scanning for
          full Chromebook keyboard, excluding the keypad.
```

## zephyr/dts/bindings/led/cros-ec,gpio-leds.yaml
```yaml
# Copyright 2022 The Chromium OS Authors. All rights reserved.
# Use of this source code is governed by a BSD-style license that can be
# found in the LICENSE file.

description: GPIO LED configuration

compatible: "cros-ec,gpio-leds"

include: base.yaml

properties:
  gpios:
    type: phandle-array
    required: true
    description: |
      List of the GPIOs controlling the LEDs. GPIO_ACTIVE_LOW
      can be used for low-side control of the signal.

      For example
        led1 {
                compatible = "cros-ec,gpio-leds";

                pwms = <&gpioc 3 GPIO_ACTIVE_LOW>,
                       <&gpioc 4 GPIO_ACTIVE_LOW>;
        };

  color-list:
    type: array
    required: true
    description: |
      Maps the requested colors from the EC host command
      to the appropriate GPIO channel. So,

          color-list = <BLUE YELLOW>;

      Would return the EC brightness array

          [0, 0, 1, 1, 0, 0]
```
