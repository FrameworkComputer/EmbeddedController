## zephyr/dts/bindings/led/cros-ec,led-policy.yaml
```yaml
# Copyright 2022 The Chromium OS Authors. All rights reserved.
# Use of this source code is governed by a BSD-style license that can be
# found in the LICENSE file.

description: LED inputs and triggers, used to drive LED actions

compatible: "cros-ec,led-policy"

include: base.yaml

properties:
  led:
    type: phandle
    required: true
    description: |
      Reference to the node of the LED handler to use for this policy.
      The handler contains from 1 to 4 LEDs that are managed
      as a set, and can be usually either a PWM based set or a
      GPIO based set.

  enum-name:
    type: string
    required: false
    description: |
      If set, used as the LED enum defined in ec_command.h to
      identify this LED when being referenced as part of the
      common LED API (used by the EC host command).
    enum:
      - EC_LED_ID_BATTERY_LED
      - EC_LED_ID_POWER_LED
      - EC_LED_ID_ADAPTER_LED
      - EC_LED_ID_LEFT_LED
      - EC_LED_ID_RIGHT_LED
      - EC_LED_ID_RECOVERY_HW_REINIT_LED
      - EC_LED_ID_SYSRQ_DEBUG_LED

child-binding:
  description: Input to check for match.
  properties:
    cpu:
      type: string
      required: false
      default: "ANY"
      description: |
        The AP state to check. ANY will match any state.
        This must be the same as enum led_ap_state.
      enum:
        - ANY
        - SUSPENDED
        - RUNNING
        - POWER_OFF
    charger:
      type: string
      required: false
      default: "ANY"
      description: |
        The charger state to match. ANY will match
        any charger state.
        This must be the same as enum led_charger_state.
      enum:
        - ANY
        - FULL
        - CHARGING
        - DISCHARGING
        - IDLE
        - ERROR
    battery:
      type: array
      required: false
      default: [0, 100]
      description: |
        Battery charge to match, as a percentage between 0 and 100.
        The current battery chrge is compared as

          if (charge >= battery[0] && charge <= battery[1])
                match...
    action:
      type: array
      required: true
      description: |
        A list of colors/duration, as sets of 8 bit values,
        interpreted as (colors.. duration), where the number of
        colors is the number of separate LEDs in the referenced
        LED handler, and duration is tenths of a second.
        Typically PWM LED colors are percentages (0-100) and
        GPIO based LEDs are off/on coded as 0 or 1.
        When more than one set is configured, the color sets are
        cycled through, with the duration providing the delay
        between changes.  For example (for a RGB PWM LED)

          action = <100 0 0 10>, <0 100 0 5>;

        This cycles through red (1 second) and green (1/2 second).
```

## zephyr/dts/bindings/led/cros-ec,multi-pwm-leds.yaml
```yaml
# Copyright 2022 The Chromium OS Authors. All rights reserved.
# Use of this source code is governed by a BSD-style license that can be
# found in the LICENSE file.

description: Multi-PWM LED configuration

compatible: "cros-ec,multi-pwm-leds"

include: base.yaml

properties:
  pwms:
    type: phandle-array
    required: true
    description: |
      List of the PWMs attached to the LEDs, up to 3 PWM devices.
      The duration is used when multiple colors are specified
      in a list, and indicates the duration the color is set for.

      For example
        led1 {
                compatible = "cros-ec,multi-pwm-leds";

                pwms = <&pwm1 0 PWM_POLARITY_INVERTED>,
                       <&pwm0 0 PWM_POLARITY_INVERTED>,
                       <&pwm2 0 PWM_POLARITY_INVERTED>;
        };

  frequency:
    type: int
    required: true
    description: |
      PWM frequency in Hz for LEDs.

  color-list:
    type: array
    required: true
    description: |
      The EC LED control host command uses a fixed list
      of colors (defined in ec_command.h). This color list
      maps the known colors from the host command
      to the PWM channel displaying that color. The
      host command colors include RED, GREEN, BLUE, WHITE,
      AMBER, YELLOW.

      For convenience, the dt-bindings/colors.h include
      defines the colors used by the host command.
      These colors can be used in this list to indicate
      the color of the PWM channels so that the channels
      can be mapped to the byte array used by the
      host command brightness API.

          color-list = <RED GREEN BLUE>;

      Would return the EC brightness array

          [255, 255, 255, 0, 0, 0]

      Indicating that the colors RED, GREEN and BLUE (as
      defined in ec_command.h) map to channels 0, 1 and 2
      in this handler, and that there are no channels
      available to display WHITE, AMBER and YELLOW.
```

## zephyr/dts/bindings/led/cros-ec,pwm-leds.yaml
```yaml
# Copyright 2021 The Chromium OS Authors. All rights reserved.
# Use of this source code is governed by a BSD-style license that can be
# found in the LICENSE file.

description: PWM LED configuration

compatible: "cros-ec,pwm-leds"

include: base.yaml

properties:
  leds:
    type: phandles
    required: true
    description: |
      List of pwm-leds nodes. These are expected to have a pwms property
      pointing to the relevant PWMs, in red, green, blue and optionally sidesel
      order.

      For example
        pwmleds {
                compatible = "pwm-leds";
                pwm_led0: pwm_led_0 {
                        pwms = <&led3_red
                                &led2_green
                                &led1_blue
                                &led3_sidesel
                                >;
                };
        };
        cros-pwmleds {
                compatible = "cros-ec,pwm-leds";
                leds = <&pwm_led0>;
        };

  color-map-red:
    type: array
    required: false
    description: |
      A map of PWM duty cycles per color, up to three channels. Unset values
      default to zero.

      For example
        color-map-red    = <100   0   0>;
        color-map-green  = <  0 100   0>;
        color-map-blue   = <  0   0 100>;
        color-map-yellow = <100  70   0>;
        color-map-white  = <100  70 100>;
        color-map-amber  = <100  20   0>;

  color-map-green:
    type: array
    required: false

  color-map-blue:
    type: array
    required: false

  color-map-yellow:
    type: array
    required: false

  color-map-white:
    type: array
    required: false

  color-map-amber:
    type: array
    required: false

  brightness-range:
    type: array
    required: false
    description: |
      A list of brigthness range value for all supported channels in order,
      Red, Green, Blue, Yellow, White, Amber (0 to 255).

child-binding:
  description: |
    LED child binding node for mapping a PWM_LED to a EC_LED_ID.

    For example

    pwm_led_0@0 {
                reg = <0>;
                ec-led-name = "EC_LED_ID_LEFT_LED";
    };
    pwm_led_1@1 {
                reg = <1>;
                ec-led-name = "EC_LED_ID_RIGHT_LED";
    };

  properties:
    reg:
      type: int
      required: true
      description: LED ID, can be either 0 or 1 for PWM_LED0 and PWM_LED1
      enum:
        - 0 # PWM_LED0
        - 1 # PWM_LED1

    ec-led-name:
      type: string
      required: true
      description: The EC_LED_ID value to map the LED to.
```

## zephyr/dts/bindings/led/maxim,max695x.yaml
```yaml
# Copyright 2022 The ChromiumOS Authors
# Use of this source code is governed by a BSD-style license that can be
# found in the LICENSE file.

description: |
    MAX6958/MAX6959 7-Segment LED Display

    Example configuration

    max695x@38 {
            compatible = "maxim,max695x";
            reg = <0x38>;
    };


compatible: "maxim,max695x"

include: i2c-device.yaml
```

## zephyr/dts/bindings/led/maxim,seven-seg-display.yaml
```yaml
# Copyright 2022 The Chromium OS Authors. All rights reserved.
# Use of this source code is governed by a BSD-style license that can be
# found in the LICENSE file.

description: MAX6958/MAX6959 7-Segment LED Display

compatible: "maxim,seven-seg-display"

include: i2c-device.yaml

#
# examples:
#
# seven_seg_display: max695x-seven-seg-display@38 {
#         compatible = "maxim,seven-seg-display";
#         reg = <0x38>;
#         label = "MAX695X_SEVEN_SEG_DISPLAY";
# };
#
```

## zephyr/dts/bindings/leds/cros-ec,gpio-led-pins.yaml
```yaml
# Copyright 2022 The ChromiumOS Authors
# Use of this source code is governed by a BSD-style license that can be
# found in the LICENSE file.

description: GPIO LED pins parent node

compatible: "cros-ec,gpio-led-pins"

child-binding:
  description: |
    Each child node describes all the GPIO pins that need to be altered to set
    the color of a specific LED.
    e.g. For a board with 2 GPIO pins that make up a battery LED, the node looks
    like:
    battery_led: battery-led {
                   led-id = "EC_LED_ID_BATTERY_LED";
                   led-pins = <&gpio_ec_chg_led_y_c1
                               &gpio_ec_chg_led_w_c1>;
                };
  properties:
    led-id:
      type: string
      required: true
      description: |
        This property is required by the EC_CMD_LED_CONTROL host command.
        It must match the enum names defined in ec_commands.h.
      enum:
        - EC_LED_ID_BATTERY_LED
        - EC_LED_ID_POWER_LED
        - EC_LED_ID_ADAPTER_LED
        - EC_LED_ID_LEFT_LED
        - EC_LED_ID_RIGHT_LED
        - EC_LED_ID_RECOVERY_HW_REINIT_LED
        - EC_LED_ID_SYSRQ_DEBUG_LED
    led-pins:
      type: phandles
      required: true
      description: |
        This property is used to specify an array of gpio pins to set a
        particular color.

  child-binding:
    description: |
      Each grandchild node describes all the colors supported by the child LED.
      e.g. For a board supporting Blue and Amber LEDs - to set LED_AMBER color,
      amber LED will need to be set to 1 and blue LED to 0. 1 always turns on
      the LED and 0 always turns off the LED. So a node looks like
      color-amber {
                   led-color = "LED_AMBER";
                   led-values = <1 0>;
                  };
    properties:
      led-color:
        type: string
        required: true
        description: |
          This property is used to identify pin nodes based on color enum.
          It is required by the EC_CMD_LED_CONTROL host command.
        enum:
          - LED_OFF
          - LED_RED
          - LED_GREEN
          - LED_BLUE
          - LED_YELLOW
          - LED_WHITE
          - LED_AMBER
      led-values:
        type: array
        required: true
        description: |
          This property is used to specify an array of values to set on the
          corresponding led-pins to set a particular color.
```

## zephyr/dts/bindings/leds/cros-ec,led-colors.yaml
```yaml
# Copyright 2021 The Chromium OS Authors. All rights reserved.
# Use of this source code is governed by a BSD-style license that can be
# found in the LICENSE file.

description: LED colors parent node

compatible: "cros-ec,led-colors"

child-binding:
    description: LED Color nodes to describe the policy combination a node
                 depends on, and the color to set to for that combination.
                 e.g. If Blue color needs to be set for charge state discharge
                 in S0, a node looks like
                 power-state-discharge-s0 {
                    charge-state = "PWR_STATE_DISCHARGE";
                    chipset-state = "POWER_S0";
                    color-0 {
                      led-color = "LED_BLUE";
                    };
                 };

    properties:
        charge-state:
            description: If the LED color depends on charge state, this
                         property is used to describe it.
            type: string
            required: false
            enum:
                - PWR_STATE_CHARGE
                - PWR_STATE_DISCHARGE
                - PWR_STATE_ERROR
                - PWR_STATE_IDLE
                - PWR_STATE_CHARGE_NEAR_FULL

        chipset-state:
            description: If the LED color depends on chipset state, this
                         property is used to describe it.
            type: string
            required: false
            enum:
                - POWER_S0
                - POWER_S3
                - POWER_S5

        extra-flag:
            description: If the LED color depends on additional factors
            type: string
            required: false
            enum:
                - NONE
                - LED_CHFLAG_FORCE_IDLE
                - LED_CHFLAG_DEFAULT
                - LED_BATT_BELOW_10_PCT
                - LED_BATT_ABOVE_10_PCT

    child-binding:
        description: Color enum
        properties:
            led-color:
                type: string
                required: true
                enum:
                    - LED_OFF
                    - LED_RED
                    - LED_GREEN
                    - LED_BLUE
                    - LED_YELLOW
                    - LED_WHITE
                    - LED_AMBER
            period-ms:
                description: In case of blinking LEDs, amount of time in msecs
                             the LED color is active. This value must be a
                             multiple of HOOK_TICK_INTERVAL_MS
                             e.g.
                             power-state-error {
                                charge-state = "PWR_STATE_ERROR";
                                /* One sec Amber, one sec Off */
                                color-0 {
                                  led-color = "LED_AMBER";
                                  period-ms = <1000>;
                                };
                                color-1 {
                                  led-color = "LED_OFF";
                                  period-ms = <1000>;
                                };
                             };
                type: int
                required: false
```

## zephyr/dts/bindings/leds/cros-ec,pwm-led-pin-config.yaml
```yaml
# Copyright 2022 The Chromium OS Authors. All rights reserved.
# Use of this source code is governed by a BSD-style license that can be
# found in the LICENSE file.

description: PWM LED pin configuration

compatible: "cros-ec,pwm-pin-config"

child-binding:
  description: PWMs associated with LEDs
  properties:
    pwms:
      type: phandle-array
      required: true
    "#led-pin-cells":
      type: int
      required: false
  led-pin-cells:
    - value
```
