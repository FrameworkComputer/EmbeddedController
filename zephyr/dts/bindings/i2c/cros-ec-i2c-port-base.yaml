## zephyr/dts/bindings/leds/cros-ec,pwm-led-pins.yaml
```yaml
# Copyright 2022 The ChromiumOS Authors
# Use of this source code is governed by a BSD-style license that can be
# found in the LICENSE file.

description: PWM LED pins parent node

compatible: "cros-ec,pwm-led-pins"

child-binding:
  description: |
    Each child node describes all the PWM pins that need to be altered to set
    the color of a specific LED.
    e.g. For a battery LED, a node looks like this.
    battery_led: battery-led {
                 led-id = "EC_LED_ID_BATTERY_LED";
                 led-pwms = <&pwm_led_y &pwm_led_b>;
                };
  properties:
    led-id:
      type: string
      required: true
      description: |
        This property is required by the EC_CMD_LED_CONTROL host command.
        It must match the enum names defined in ec_commands.h.
      enum:
        - EC_LED_ID_BATTERY_LED
        - EC_LED_ID_POWER_LED
        - EC_LED_ID_ADAPTER_LED
        - EC_LED_ID_LEFT_LED
        - EC_LED_ID_RIGHT_LED
        - EC_LED_ID_RECOVERY_HW_REINIT_LED
        - EC_LED_ID_SYSRQ_DEBUG_LED
    led-pwms:
      type: phandles
      required: true
      description: |
        This property is used to specify an array of pwms to set a
        particular color.

  child-binding:
    description: |
      Each grandchild node describes all the colors supported by the child LED.
      e.g. For blue and amber PWM channels, in order to set color amber, a node
      looks like this where 100 is PWM duty cycle in percentage.
      color-amber {
                   led-color = <LED_AMBER>;
                   led-values = <100 0>;
                  };
    properties:
      led-color:
        type: string
        required: true
        description: |
          This property is used to identify pin nodes based on color enum.
          It is required by the EC_CMD_LED_CONTROL host command.
        enum:
          - LED_OFF
          - LED_RED
          - LED_GREEN
          - LED_BLUE
          - LED_YELLOW
          - LED_WHITE
          - LED_AMBER
      led-values:
        type: array
        required: true
        description: |
          This property is used to specify an array of values to set on the
          corresponding pwm-pins to set a particular color.
```

## zephyr/dts/bindings/misc/cros,aic-pins.yaml
```yaml
# Copyright 2025 The ChromiumOS Authors
# Use of this source code is governed by a BSD-style license that can be
# found in the LICENSE file.

description: |
  Various pin definitions for the AIC carrier board.

compatible: "cros,aic-pins"

properties:
  io-gpios:
    type: phandle-array
    required: true
```

## zephyr/dts/bindings/misc/cros-ec,prochot-vcmp.yaml
```yaml
# Copyright 2024 Google LLC
# Use of this source code is governed by a BSD-style license that can be
# found in the LICENSE file.

description: |
  PROCHOT signal detection, uses a voltage comparator device to detect
  transitions of the PROCHOT signal and log it on the console if the AP is
  active.

  Example configuration:

  prochot-vcmp {
      compatible = "cros-ec,prochot-vcmp";
      vcmp = <&vcmp0>;
      high-level-mv = <1050>;
  };

  &vcmp0 {
      status = "okay";
      scan-period = <IT8XXX2_VCMP_SCAN_PERIOD_5MS>;
      comparison = <IT8XXX2_VCMP_GREATER>;
      threshold-mv = <0>;
      io-channels = <&adc0 0>;
  };

  &adc0 {
      pinctrl-0 = <&adc0_ch0_gpi0_default>; /* ...and other ADC signals */
      pinctrl-names = "default";
  };

  Note: the voltage comparator initial configuration is irrelevant, the device
  is reconfigured automatically in runtime.

compatible: "cros-ec,prochot-vcmp"

include: base.yaml

properties:
  vcmp:
    description: Voltage comparator device to use.
    type: phandle
    required: true

  high-level-mv:
    description: |
      Signal voltage for the high level, in millivolts, detection thresholds will
      be set to 10% and 90% of this value.
    type: int
    required: true
```

## zephyr/dts/bindings/motionsense/cros-ec,motionsense-bodydetect.yaml
```yaml
# Copyright 2023 The ChromiumOS Authors
# Use of this source code is governed by a BSD-style license that can be
# found in the LICENSE file.

include: base.yaml

compatible: "cros-ec,motionsense-bodydetect"

description: Body detection configuration parameters
properties:
  var_noise_factor:
    type: int
    description: |
      The unit is percentage
      This is used for mitigate the effect of the noise from sensor.
      If set to 100%, the average noise is canceled out.
  var_threshold:
    type: int
    description: |
      The unit is (mm/s^2)^2
      The motion confidence is calculated if the variance is within
      variance_threshold +/- confidence_delta. Otherwise, if variance
      is too high/low, confidence will be 100%/0%
  confidence_delta:
    type: int
    description: |
      The unit is (mm/s^2)^2
      The motion confidence is calculated if the variance is within
      variance_threshold +/- confidence_delta. Otherwise, if variance
      is too high/low, confidence will be 100%/0%

# example:
# base_accel: base-accel {
#    compatible = "cros-ec,lis2dw12";
#    (...)
#    bodydetect {
#         compatible = "cros-ec,motionsense-bodydetect";
#         status = "okay";
#         var_noise_factor = <150>;
#         var_threshold = <3000>;
#         confidence_delta = <2900>;
#   };
# };
```
