## zephyr/dts/bindings/motionsense/cros-ec,motionsense-mutex.yaml
```yaml
# Copyright (c) 2021 The Chromium OS Authors
# SPDX-License-Identifier: Apache-2.0

description: Motion sense mutex parent node

compatible: "cros-ec,motionsense-mutex"

child-binding:
  description: A mutex node is used to create an instance of mutex_t.
               A mutex node is referenced by one or more sensor nodes in
               "/motionsense-sensors" node.

#
# examples:
#
# motionsense-mutex {
#         compatible = "cros-ec,motionsense-mutex";
#         mutex_bma255: bma255-mutex {
#         };
#
#         mutex_bmi260: bmi260-mutex {
#         };
# };
#
```

## zephyr/dts/bindings/motionsense/cros-ec,motionsense-rotation-ref.yaml
```yaml
# Copyright 2021 The Chromium OS Authors. All rights reserved.
# Use of this source code is governed by a BSD-style license that can be
# found in the LICENSE file.

description: rotation reference parent node

compatible: "cros-ec,motionsense-rotation-ref"

child-binding:
  description: |
    A rotation matrix node is used to create
    an instance of mat33_fp_t which is used by
    sensor drivers.
  properties:
    mat33:
      required: true
      type: array
      description: |
        3x3 matrix to rotate x, y, and z axes.
        Applications with the sensor API expects sansor data
        based on the same defined coordinate system.
        * X-axis is horizontal and positive toward the right
        * Y-axis is vertical and positive toward the top
        * Z-axis points toward the user

        Depending on how the sensor is mounted on board(PCB), we
        may need to change the direction of a axis and swap X and
        Y-axis. Using the 3x3 matrix, it generates the correct
        X,Y, and Z on the defined coordinate system.

        +-        -+   +-        -+   +- -+
        | v1 v2 v3 |   | sensor_X |   | X |
        | v4 v5 v6 | * | sensor_Y | = | Y |
        | v7 v8 v9 |   | sensor_Z |   | Z |
        +-        -+   +-        -+   +- -+

#
# examples:
#
# motionsense-rotation-ref {
#        compatible = "cros-ec,motionsense-rotation-ref";
#        /* change the direction of Y and Z-axis */
#        lid_rot_ref: lid-rotation-ref {
#                mat33 = <1 0 0
#                         0 (-1) 0
#                         0 0 (-1)>;
#        };
#        /* swap X and Y-axis, and then change the direction of Y-axis */
#        base_rot_ref: base-rotation-ref {
#                mat33 = <0 1 0
#                         (-1) 0 0
#                         0 0 1>;
#        };
# };
#
```

## zephyr/dts/bindings/motionsense/cros-ec,motionsense-sensor-config.yaml
```yaml
# Copyright 2021 The ChromiumOS Authors
# Use of this source code is governed by a BSD-style license that can be
# found in the LICENSE file.

description: |
    There are 4 configuration parameters to deal with different
    configuration
    Power   |         S0        |            S3     |      S5
    --------+-------------------+-------------------+-----------------
    From AP | <------- SENSOR_CONFIG_AP ----------> |
            | Use for normal    | While sleeping    | Always disabled
            | operation (game,  | For Activity      |
            | screen rotation)  | Recognition       |
    --------+-------------------+-------------------+------------------
    From EC |SENSOR_CONFIG_EC_S0|SENSOR_CONFIG_EC_S3|SENSOR_CONFIG_EC_S5
            | Background        | Gesture  Recognition (Double tap, ...)
            | Activity (compass,|
            | ambient light)    |

compatible: "cros-ec,motionsense-sensor-config"

child-binding:
  description: |
    A config node is used to create a motion_data_t instance.
    Node name can only be either ap, ec-s0, ec-s3, or ec-s5,
    and it is used to indicate one of the 4 configurations.
    For example, node name ec-s0 is for SENSOR_CONFIG_EC_S0.
    ec-s0 {
       odr = <1000>;
       ec_rate = <1000>;
    };
  properties:
    odr:
      type: int
      description: |
        Sensor output data rate in mHz.
        MSB is used to know if we are rounding up.
    ec-rate:
      type: int
      default: 0
      description: Delay between collection by EC, in us.

#
# examples:
#
# configs {
#         compatible =
#                 "cros-ec,motionsense-sensor-config";
#         ec-s0 {
#                 odr = <(10000 | ROUND_UP_FLAG)>;
#         };
#         ec-s3 {
#                 odr = <(10000 | ROUND_UP_FLAG)>;
#         };
# };
#
```

## zephyr/dts/bindings/motionsense/cros-ec,motionsense-sensor-info.yaml
```yaml
# Copyright 2021 The ChromiumOS Authors
# Use of this source code is governed by a BSD-style license that can be
# found in the LICENSE file.

description: The node has the information required by motion sense running

compatible: "cros-ec,motionsense-sensor-info"

properties:
  als-sensors:
    type: phandles
    description: |
        List of ALS sensors to create motion_als_sensors array.
        The ALS sensors listed in the motion_als_sensors array
        are managed by motion sense task. The task reads the sensor
        data from the sensors and put them into the designated part
        in the ec mmap. For example, als_clear and als_rgb are aliases
        of ALS sensor noded defined in motionsense-sensor node.
        als-sensors = <&als_clear, &als_rgb>;
        This will automatically generate motion_als_sensors array from it.
  sensor-irqs:
    type: phandles
    description: |
        List of interrupts from sensors GPIOS to be enabled.
        Interrupts specified here will be enabled before motion sense task starts.
        sensor-irqs = <&int_imu &int_als_rgb>;
  accel-force-mode-sensors:
    type: phandles
    description: |
        List of sensors should be handled in force mode. Sensors listed will be
        used to define CONFIG_ACCEL_FORCE_MODE_MASK so that motion sense task can
        manage them in force mode.
        accel-force-mode-sensors = <&lid_accel &als_clear>;

#
# examples:
#
# motionsense-sensor-info {
#        compatible = "cros-ec,motionsense-sensor-info";
#
#        /* list of entries for motion_als_sensors */
#        als-sensors = <&als_clear>;
#
#        /*
#         * list of GPIO interrupts that have to
#         * be enabled at initial stage
#         */
#        sensor-irqs = <&gpio_ec_imu_int_l &gpio_ec_als_rgb_int_l>;
#
#        /* list of sensors in force mode */
#        accel-force-mode-sensors = <&lid_accel &als_clear>;
# };
#
```

## zephyr/dts/bindings/motionsense/driver/bmi160.yaml
```yaml
# Copyright 2021 The Chromium OS Authors. All rights reserved.
# Use of this source code is governed by a BSD-style license that can be
# found in the LICENSE file.

# common fields for both BMI160 accel and BMI160 gyro

# every motionsense sensor node should include motionsense-sensor-base.yaml
include: motionsense-sensor-base.yaml

properties:
  i2c-spi-addr-flags:
    type: string
    description: i2c address or SPI peripheral logic GPIO
    enum:
      - "BMI160_ADDR0_FLAGS"
    default: "BMI160_ADDR0_FLAGS"
```

## zephyr/dts/bindings/motionsense/driver/bmi260.yaml
```yaml
# Copyright 2021 The Chromium OS Authors. All rights reserved.
# Use of this source code is governed by a BSD-style license that can be
# found in the LICENSE file.

# common fields for both BMI260 accel and BMI260 gyro

# every motionsense sensor node should include motionsense-sensor-base.yaml
include: motionsense-sensor-base.yaml

properties:
  i2c-spi-addr-flags:
    type: string
    description: i2c address or SPI slave logic GPIO
    enum:
      - "BMI260_ADDR0_FLAGS"
    default: "BMI260_ADDR0_FLAGS"
```

## zephyr/dts/bindings/motionsense/driver/bmi3xx.yaml
```yaml
# Copyright 2022 The ChromiumOS Authors
# Use of this source code is governed by a BSD-style license that can be
# found in the LICENSE file.

# common fields for both BMI260 accel and BMI260 gyro

# every motionsense sensor node should include motionsense-sensor-base.yaml
include: motionsense-sensor-base.yaml

properties:
  i2c-spi-addr-flags:
    type: string
    description: i2c address or SPI slave logic GPIO
    enum:
      - "BMI3_ADDR_I2C_PRIM"
      - "BMI3_ADDR_I2C_SEC"
    default: "BMI3_ADDR_I2C_PRIM"
```

## zephyr/dts/bindings/motionsense/driver/cm32183.yaml
```yaml
# Copyright 2021 The ChromiumOS Authors
# Use of this source code is governed by a BSD-style license that can be
# found in the LICENSE file.

description: >
  Properties for a CM32183 I2C ambient light sensor

compatible: "nxp,cm32183"

include: i2c-device.yaml
```

## zephyr/dts/bindings/motionsense/driver/cros-ec,bma255.yaml
```yaml
# Copyright 2021 The Chromium OS Authors. All rights reserved.
# Use of this source code is governed by a BSD-style license that can be
# found in the LICENSE file.

description: motionsense sensor node for BMA255

compatible: "cros-ec,bma255"

# every motionsense sensor node should include motionsense-sensor-base.yaml
include: motionsense-sensor-base.yaml

properties:
  i2c-spi-addr-flags:
    type: string
    description: i2c address or SPI peripheral logic GPIO
    enum:
      - "BMA2x2_I2C_ADDR1_FLAGS"
      - "BMA2x2_I2C_ADDR2_FLAGS"
      - "BMA2x2_I2C_ADDR3_FLAGS"
      - "BMA2x2_I2C_ADDR4_FLAGS"
    default: "BMA2x2_I2C_ADDR1_FLAGS"
```

## zephyr/dts/bindings/motionsense/driver/cros-ec,bma4xx.yaml
```yaml
# Copyright 2022 The ChromiumOS Authors
# Use of this source code is governed by a BSD-style license that can be
# found in the LICENSE file.

description: motionsense sensor node for BMA4xx

compatible: "cros-ec,bma4xx"

# every motionsense sensor node should include motionsense-sensor-base.yaml
include: motionsense-sensor-base.yaml

properties:
  default-range:
    default: 4
  i2c-spi-addr-flags:
    type: string
    description: i2c address or SPI peripheral logic GPIO
    enum:
      - "BMA4_I2C_ADDR_PRIMARY"
      - "BMA4_I2C_ADDR_SECONDARY"
    default: "BMA4_I2C_ADDR_PRIMARY"
```

## zephyr/dts/bindings/motionsense/driver/cros-ec,bmi160-accel.yaml
```yaml
# Copyright 2021 The Chromium OS Authors. All rights reserved.
# Use of this source code is governed by a BSD-style license that can be
# found in the LICENSE file.

description: motion sense sensor node for BMI160 accel

compatible: "cros-ec,bmi160-accel"

include: bmi160.yaml

properties:
  default-range:
    default: 4
```

## zephyr/dts/bindings/motionsense/driver/cros-ec,bmi160-gyro.yaml
```yaml
# Copyright 2021 The Chromium OS Authors. All rights reserved.
# Use of this source code is governed by a BSD-style license that can be
# found in the LICENSE file.

description: motion sense sensor node for BMI160 gyro

compatible: "cros-ec,bmi160-gyro"

include: bmi160.yaml

properties:
  default-range:
    default: 1000
```

## zephyr/dts/bindings/motionsense/driver/cros-ec,bmi260-accel.yaml
```yaml
# Copyright 2021 The Chromium OS Authors. All rights reserved.
# Use of this source code is governed by a BSD-style license that can be
# found in the LICENSE file.

description: motion sense sensor node for BMI260 accel

compatible: "cros-ec,bmi260-accel"

include: bmi260.yaml

properties:
  default-range:
    default: 4
```

## zephyr/dts/bindings/motionsense/driver/cros-ec,bmi260-gyro.yaml
```yaml
# Copyright 2021 The Chromium OS Authors. All rights reserved.
# Use of this source code is governed by a BSD-style license that can be
# found in the LICENSE file.

description: motion sense sensor node for BMI260 gyro

compatible: "cros-ec,bmi260-gyro"

include: bmi260.yaml

properties:
  default-range:
    default: 1000
```

## zephyr/dts/bindings/motionsense/driver/cros-ec,bmi3xx-accel.yaml
```yaml
# Copyright 2022 The Chromium OS Authors. All rights reserved.
# Use of this source code is governed by a BSD-style license that can be
# found in the LICENSE file.

description: motion sense sensor node for BMI260 accel

compatible: "cros-ec,bmi3xx-accel"

include: bmi3xx.yaml

properties:
  default-range:
    default: 4
```

## zephyr/dts/bindings/motionsense/driver/cros-ec,bmi3xx-gyro.yaml
```yaml
# Copyright 2022 The ChromiumOS Authors
# Use of this source code is governed by a BSD-style license that can be
# found in the LICENSE file.

description: motion sense sensor node for BMI3XX gyro

compatible: "cros-ec,bmi3xx-gyro"

include: bmi3xx.yaml

properties:
  default-range:
    default: 1000
```

## zephyr/dts/bindings/motionsense/driver/cros-ec,icm42607-accel.yaml
```yaml
# Copyright 2021 The Chromium OS Authors. All rights reserved.
# Use of this source code is governed by a BSD-style license that can be
# found in the LICENSE file.

description: motion sense sensor node for ICM42607 accel

compatible: "cros-ec,icm42607-accel"

include: icm42607.yaml

properties:
  default-range:
    default: 4
```

## zephyr/dts/bindings/motionsense/driver/cros-ec,icm42607-gyro.yaml
```yaml
# Copyright 2021 The Chromium OS Authors. All rights reserved.
# Use of this source code is governed by a BSD-style license that can be
# found in the LICENSE file.

description: motion sense sensor node for ICM42607 gyro

compatible: "cros-ec,icm42607-gyro"

include: icm42607.yaml

properties:
  default-range:
    default: 1000
```

## zephyr/dts/bindings/motionsense/driver/cros-ec,icm426xx-accel.yaml
```yaml
# Copyright 2021 The ChromiumOS Authors
# Use of this source code is governed by a BSD-style license that can be
# found in the LICENSE file.

description: motion sense sensor node for ICM426xx accel

compatible: "cros-ec,icm426xx-accel"

include: icm426xx.yaml

properties:
  default-range:
    default: 4
```

## zephyr/dts/bindings/motionsense/driver/cros-ec,icm426xx-gyro.yaml
```yaml
# Copyright 2021 The Chromium OS Authors. All rights reserved.
# Use of this source code is governed by a BSD-style license that can be
# found in the LICENSE file.

description: motion sense sensor node for ICM426xx gyro

compatible: "cros-ec,icm426xx-gyro"

include: icm426xx.yaml

properties:
  default-range:
    default: 1000
```

## zephyr/dts/bindings/motionsense/driver/cros-ec,kx022.yaml
```yaml
# Copyright 2021 The Chromium OS Authors. All rights reserved.
# Use of this source code is governed by a BSD-style license that can be
# found in the LICENSE file.

description: motionsense sensor node for KX022

compatible: "cros-ec,kx022"

# every motionsense sensor node should include motionsense-sensor-base.yaml
include: motionsense-sensor-base.yaml

properties:
  i2c-spi-addr-flags:
    type: string
    description: i2c address or SPI peripheral logic GPIO
    enum:
      - "KX022_ADDR0_FLAGS"
      - "KX022_ADDR1_FLAGS"
    default: "KX022_ADDR0_FLAGS"
  default-range:
    default: 2
```

## zephyr/dts/bindings/motionsense/driver/cros-ec,lis2de.yaml
```yaml
# Copyright 2024 The ChromiumOS Authors
# Use of this source code is governed by a BSD-style license that can be
# found in the LICENSE file.

description: motionsense sensor node for LIS2DE Accelerometer

compatible: "cros-ec,lis2de"

# every motionsense sensor node should include motionsense-sensor-base.yaml
include: motionsense-sensor-base.yaml

properties:
  i2c-spi-addr-flags:
    type: string
    description: i2c address or SPI peripheral logic GPIO
    enum:
      - "LIS2DH_ADDR0_FLAGS"
      - "LIS2DH_ADDR1_FLAGS"
    default: "LIS2DH_ADDR1_FLAGS"
  default-range:
    default: 2
```

## zephyr/dts/bindings/motionsense/driver/cros-ec,lis2ds.yaml
```yaml
# Copyright 2023 The ChromiumOS Authors
# Use of this source code is governed by a BSD-style license that can be
# found in the LICENSE file.

description: motionsense sensor node for LIS2DS12 Accelerometer

compatible: "cros-ec,lis2ds"

# every motionsense sensor node should include motionsense-sensor-base.yaml
include: motionsense-sensor-base.yaml

properties:
  i2c-spi-addr-flags:
    type: string
    description: i2c address or SPI peripheral logic GPIO
    enum:
      - "LIS2DS_ADDR0_FLAGS"
      - "LIS2DS_ADDR1_FLAGS"
    default: "LIS2DS_ADDR1_FLAGS"
  default-range:
    default: 2
```
