## zephyr/dts/bindings/motionsense/driver/cros-ec,lis2dw12.yaml
```yaml
# Copyright 2021 The Chromium OS Authors. All rights reserved.
# Use of this source code is governed by a BSD-style license that can be
# found in the LICENSE file.

description: motionsense sensor node for LIS2DW12 Accelerometer

compatible: "cros-ec,lis2dw12"

# every motionsense sensor node should include motionsense-sensor-base.yaml
include: motionsense-sensor-base.yaml

properties:
  i2c-spi-addr-flags:
    type: string
    description: i2c address or SPI peripheral logic GPIO
    enum:
      - "LIS2DWL_ADDR0_FLAGS"
      - "LIS2DWL_ADDR1_FLAGS"
    default: "LIS2DWL_ADDR1_FLAGS"
  default-range:
    default: 2
```

## zephyr/dts/bindings/motionsense/driver/cros-ec,lsm6dsm-gyro.yaml
```yaml
# Copyright 2022 The Chromium OS Authors. All rights reserved.
# Use of this source code is governed by a BSD-style license that can be
# found in the LICENSE file.

description: motionsense sensor node for LSM6DSM Gyro

compatible: "cros-ec,lsm6dsm-gyro"

include: lsm6dsm.yaml

properties:
  default-range:
    default: 1000
```
