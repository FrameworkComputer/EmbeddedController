## zephyr/dts/bindings/motionsense/driver/cros-ec,lsm6dso-accel.yaml
```yaml
# Copyright 2021 The ChromiumOS Authors
# Use of this source code is governed by a BSD-style license that can be
# found in the LICENSE file.

description: motionsense sensor node for LSM6DSO Accelerometer

compatible: "cros-ec,lsm6dso-accel"

include: lsm6dso.yaml

properties:
  default-range:
    default: 2
```

## zephyr/dts/bindings/motionsense/driver/cros-ec,lsm6dso-gyro.yaml
```yaml
# Copyright 2021 The Chromium OS Authors. All rights reserved.
# Use of this source code is governed by a BSD-style license that can be
# found in the LICENSE file.

description: motionsense sensor node for LSM6DSO Gyro

compatible: "cros-ec,lsm6dso-gyro"

include: lsm6dso.yaml

properties:
  default-range:
    default: 1000
```

## zephyr/dts/bindings/motionsense/driver/cros-ec,tcs3400-clear.yaml
```yaml
# Copyright 2021 The Chromium OS Authors. All rights reserved.
# Use of this source code is governed by a BSD-style license that can be
# found in the LICENSE file.

description: motion sense sensor node for TCS3400 CLEAR

compatible: "cros-ec,tcs3400-clear"

include: tcs3400.yaml
```

## zephyr/dts/bindings/motionsense/driver/cros-ec,tcs3400-rgb.yaml
```yaml
# Copyright 2021 The Chromium OS Authors. All rights reserved.
# Use of this source code is governed by a BSD-style license that can be
# found in the LICENSE file.

description: motion sense sensor node for TCS3400 RGB

compatible: "cros-ec,tcs3400-rgb"

include: tcs3400.yaml
```

## zephyr/dts/bindings/motionsense/driver/icm42607.yaml
```yaml
# Copyright 2021 The Chromium OS Authors. All rights reserved.
# Use of this source code is governed by a BSD-style license that can be
# found in the LICENSE file.

# common fields for both ICM426xx accel and gyro

# every motionsense sensor node should include motionsense-sensor-base.yaml
include: motionsense-sensor-base.yaml

properties:
  i2c-spi-addr-flags:
    type: string
    description: i2c address or SPI peripheral logic GPIO
    enum:
      - "ICM42607_ADDR0_FLAGS"
      - "ICM42607_ADDR1_FLAGS"
    default: "ICM42607_ADDR0_FLAGS"
```

## zephyr/dts/bindings/motionsense/driver/icm426xx.yaml
```yaml
# Copyright 2021 The Chromium OS Authors. All rights reserved.
# Use of this source code is governed by a BSD-style license that can be
# found in the LICENSE file.

# common fields for both ICM426xx accel and gyro

# every motionsense sensor node should include motionsense-sensor-base.yaml
include: motionsense-sensor-base.yaml

properties:
  i2c-spi-addr-flags:
    type: string
    description: i2c address or SPI peripheral logic GPIO
    enum:
      - "ICM426XX_ADDR0_FLAGS"
      - "ICM426XX_ADDR1_FLAGS"
    default: "ICM426XX_ADDR0_FLAGS"
```

## zephyr/dts/bindings/motionsense/driver/lsm6dso.yaml
```yaml
# Copyright 2021 The Chromium OS Authors. All rights reserved.
# Use of this source code is governed by a BSD-style license that can be
# found in the LICENSE file.
#
# common fields for both LSM6DSO accel and gyro

# every motionsense sensor node should include motionsense-sensor-base.yaml
include: motionsense-sensor-base.yaml

properties:
  i2c-spi-addr-flags:
    type: string
    description: i2c address or SPI peripheral logic GPIO
    # Address is b'0110101x' where x is determined by the
    # logic level on SA0
    enum:
      - "LSM6DSO_ADDR0_FLAGS"
      - "LSM6DSO_ADDR1_FLAGS"
    default: "LSM6DSO_ADDR0_FLAGS"
```

## zephyr/dts/bindings/motionsense/driver/tcs3400.yaml
```yaml
# Copyright 2021 The Chromium OS Authors. All rights reserved.
# Use of this source code is governed by a BSD-style license that can be
# found in the LICENSE file.

# common fields for both TCS3400 clear and TCS3400 rgb

# every motionsense sensor node should include motionsense-sensor-base.yaml
include: motionsense-sensor-base.yaml

properties:
  i2c-spi-addr-flags:
    type: string
    description: i2c address or SPI peripheral logic GPIO
    enum:
      - "TCS3400_I2C_ADDR_FLAGS"
    default: "TCS3400_I2C_ADDR_FLAGS"
  default-range:
    default: 0x10000 # scale = 1x, uscale = 0
```

## zephyr/dts/bindings/motionsense/drvdata/cros-ec,accelgyro-als-channel-scale.yaml
```yaml
# Copyright 2021 The Chromium OS Authors. All rights reserved.
# Use of this source code is governed by a BSD-style license that can be
# found in the LICENSE file.

description: |
  Bindings for als_channel_scale_t in accelgyro.h.
  Each channel has scaling factor for normalization & cover

compatible: cros-ec,accelgyro-als-channel-scale

properties:
  k-channel-scale:
    type: int
    required: true
    description: Channel scale factor
  cover-scale:
    type: int
    required: true
    description: Cover compensation scale factor

#
# examples:
#
# als-channel-scale {
#        compatible = "cros-ec,accelgyro-als-channel-scale";
#        k-channel-scale = <1>;
#        cover-scale = <1>;
# };
#
```

## zephyr/dts/bindings/motionsense/drvdata/cros-ec,accelgyro-als-drv-data.yaml
```yaml
# Copyright 2021 The Chromium OS Authors. All rights reserved.
# Use of this source code is governed by a BSD-style license that can be
# found in the LICENSE file.

description: ALS driver data

compatible: "cros-ec,accelgyro-als-drv-data"

child-binding:
  description: ALS calibration data
  properties:
    scale:
      type: int
      required: true
      description: |
        Scale, uscale, and offset are used to correct the raw 16 bit ALS data
        and then to convert it to 32 bit using the following equations
        raw_value += offset;\n
        adjusted_value = raw_value * scale + raw_value * uscale / 10000;
    uscale:
      type: int
      required: true
      description: uscale
    offset:
      type: int
      required: true
      description: offset

#
# examples:
# als-drv-data {
#        compatible = "cros-ec,accelgyro-als-drv-data";
#        als-cal {
#                scale = <1>;
#                uscale = <0>;
#                offset = <0>;
#                als-channel-scale {
#                compatible = "cros-ec,accelgyro-als-channel-scale";
#                        k-channel-scale = <1>;
#                        cover-scale = <1>;
#                };
#        };
# };
#
```

## zephyr/dts/bindings/motionsense/drvdata/cros-ec,accelgyro-rgb-calibration.yaml
```yaml
# Copyright 2021 The Chromium OS Authors. All rights reserved.
# Use of this source code is governed by a BSD-style license that can be
# found in the LICENSE file.

description: bindings for rgb_calibration_t in accelgyro.h

compatible: "cros-ec,accelgyro-rgb-calibration"

properties:
  irt:
    type: int
    required: true
    description: incandecent scaling factor

child-binding:
  description: RGB ALS Calibration Data
  properties:
    offset:
      type: int
      required: true
      description: Any offset to add to raw channel data
    coeff:
      type: array
      required: true
      description: Clear, R, G, and B coefficients for this channel

#
# examples:
#
# rgb_calibration {
#        compatible = "cros-ec,accelgyro-rgb-calibration";
#
#        irt = <1>;
#
#        rgb-cal-x {
#                offset = <0>;
#                coeff = <0 0 0 0>;
#                als-channel-scale {
#                compatible = "cros-ec,accelgyro-als-channel-scale";
#                        k-channel-scale = <1>;
#                        cover-scale = <1>;
#                };
#        };
#        rgb-cal-y {
#                offset = <0>;
#                coeff = <0 0 0 0>;
#                als-channel-scale {
#                compatible = "cros-ec,accelgyro-als-channel-scale";
#                        k-channel-scale = <1>;
#                        cover-scale = <1>;
#                };
#        };
#        rgb-cal-z {
#                offset = <0>;
#                coeff = <0 0 0 0>;
#                als-channel-scale {
#                compatible = "cros-ec,accelgyro-als-channel-scale";
#                        k-channel-scale = <1>;
#                        cover-scale = <1>;
#                };
#        };
# };
#
```

## zephyr/dts/bindings/motionsense/drvdata/cros-ec,drvdata-bma255.yaml
```yaml
# Copyright 2021 The Chromium OS Authors. All rights reserved.
# Use of this source code is governed by a BSD-style license that can be
# found in the LICENSE file.

description: BMA255 driver data node

compatible: "cros-ec,drvdata-bma255"

include: drvdata-base.yaml

#
# examples:
#
# bma255_data: bma255-drv-data {
#       compatible = "cros-ec,drvdata-bma255";
#       status = "okay";
# };
#
```

## zephyr/dts/bindings/motionsense/drvdata/cros-ec,drvdata-bma4xx.yaml
```yaml
# Copyright 2022 The Chromium OS Authors. All rights reserved.
# Use of this source code is governed by a BSD-style license that can be
# found in the LICENSE file.

description: BMA4XX driver data node

compatible: "cros-ec,drvdata-bma4xx"

include: drvdata-base.yaml

#
# examples:
#
# bma4xx_data: bma4xx-drv-data {
#       compatible = "cros-ec,drvdata-bma4xx";
#       status = "okay";
# };
#
```

## zephyr/dts/bindings/motionsense/drvdata/cros-ec,drvdata-bmi160.yaml
```yaml
# Copyright 2021 The ChromiumOS Authors
# Use of this source code is governed by a BSD-style license that can be
# found in the LICENSE file.

description: BMI160 driver data node

compatible: "cros-ec,drvdata-bmi160"

include: drvdata-base.yaml

#
# examples:
#
# bmi160_data: bmi160-drv-data {
#        compatible = "cros-ec,drvdata-bmi160";
#        status = "okay";
# };
#
```

## zephyr/dts/bindings/motionsense/drvdata/cros-ec,drvdata-bmi260.yaml
```yaml
# Copyright 2021 The Chromium OS Authors. All rights reserved.
# Use of this source code is governed by a BSD-style license that can be
# found in the LICENSE file.

description: BMI260 driver data node

compatible: "cros-ec,drvdata-bmi260"

include: drvdata-base.yaml

#
# examples:
#
# bmi260_data: bmi260-drv-data {
#        compatible = "cros-ec,drvdata-bmi260";
#        status = "okay";
# };
#
```

## zephyr/dts/bindings/motionsense/drvdata/cros-ec,drvdata-bmi3xx.yaml
```yaml
# Copyright 2022 The Chromium OS Authors. All rights reserved.
# Use of this source code is governed by a BSD-style license that can be
# found in the LICENSE file.

description: BMI3XX driver data node

compatible: "cros-ec,drvdata-bmi3xx"

include: drvdata-base.yaml

#
# examples:
#
# bmi3xx_data: bmi3xx-drv-data {
#        compatible = "cros-ec,drvdata-bmi3xx";
#        status = "okay";
# };
#
```

## zephyr/dts/bindings/motionsense/drvdata/cros-ec,drvdata-icm426xx.yaml
```yaml
# Copyright 2021 The Chromium OS Authors. All rights reserved.
# Use of this source code is governed by a BSD-style license that can be
# found in the LICENSE file.

description: ICM426xx driver data node

compatible: "cros-ec,drvdata-icm426xx"

include: drvdata-base.yaml

#
# examples:
#
# icm426xx_data: icm426xx-drv-data {
#       compatible = "cros-ec,drvdata-icm426xx";
#       status = "okay";
# };
#
```

## zephyr/dts/bindings/motionsense/drvdata/cros-ec,drvdata-kionix.yaml
```yaml
# Copyright 2021 The Chromium OS Authors. All rights reserved.
# Use of this source code is governed by a BSD-style license that can be
# found in the LICENSE file.

description: Kionix driver data node

compatible: "cros-ec,drvdata-kionix"

include: drvdata-base.yaml

#
# examples:
#
# kx022_data: kx022-drv-data {
#       compatible = "cros-ec,drvdata-kionix";
#       status = "okay";
# };
#
```

## zephyr/dts/bindings/motionsense/drvdata/cros-ec,drvdata-lis2de.yaml
```yaml
# Copyright 2024 The ChromiumOS Authors
# Use of this source code is governed by a BSD-style license that can be
# found in the LICENSE file.

description: LIS2DE driver data node

compatible: "cros-ec,drvdata-lis2de"

include: drvdata-base.yaml

#
# examples:
#
# lis2de_data: lis2de-drv-data {
#        compatible = "cros-ec,drvdata-lis2de";
#        status = "okay";
# };
#
```

## zephyr/dts/bindings/motionsense/drvdata/cros-ec,drvdata-lis2ds.yaml
```yaml
# Copyright 2023 The ChromiumOS Authors
# Use of this source code is governed by a BSD-style license that can be
# found in the LICENSE file.

description: LIS2DS12 driver data node

compatible: "cros-ec,drvdata-lis2ds"

include: drvdata-base.yaml

#
# examples:
#
# lis2ds_data: lis2ds-drv-data {
#        compatible = "cros-ec,drvdata-lis2ds";
#        status = "okay";
# };
#
```

## zephyr/dts/bindings/motionsense/drvdata/cros-ec,drvdata-lis2dw12.yaml
```yaml
# Copyright 2021 The Chromium OS Authors. All rights reserved.
# Use of this source code is governed by a BSD-style license that can be
# found in the LICENSE file.

description: LIS2DW12 driver data node

compatible: "cros-ec,drvdata-lis2dw12"

include: drvdata-base.yaml

#
# examples:
#
# lis2dw12_data: lis2dw12-drv-data {
#        compatible = "cros-ec,drvdata-lis2dw12";
#        status = "okay";
# };
#
```

## zephyr/dts/bindings/motionsense/drvdata/cros-ec,drvdata-lsm6dsm.yaml
```yaml
# Copyright 2022 The Chromium OS Authors. All rights reserved.
# Use of this source code is governed by a BSD-style license that can be
# found in the LICENSE file.

description: LSM6DSM driver data node. Note this has to be
  a separate instance for each sensor instance for this device
  e.g if the device is used for both accel and gyro, then
  separate instances of this driver data node must be used for each.

compatible: "cros-ec,drvdata-lsm6dsm"

include: drvdata-base.yaml

#
# examples:
#
# lsm6dsm_data: lsm6dsm-drv-data {
#       compatible = "cros-ec,drvdata-lsm6dsm";
#       status = "okay";
# };
#
```

## zephyr/dts/bindings/motionsense/drvdata/cros-ec,drvdata-lsm6dso.yaml
```yaml
# Copyright 2021 The Chromium OS Authors. All rights reserved.
# Use of this source code is governed by a BSD-style license that can be
# found in the LICENSE file.

description: LSM6DSO driver data node. Note this has to be
  a separate instance for each sensor instance for this device
  e.g if the device is used for both accel and gyro, then
  separate instances of this driver data node must be used for each.

compatible: "cros-ec,drvdata-lsm6dso"

include: drvdata-base.yaml

#
# examples:
#
# lsm6dso_data: lsm6dso-drv-data {
#       compatible = "cros-ec,drvdata-lsm6dso";
#       status = "okay";
# };
#
```

## zephyr/dts/bindings/motionsense/drvdata/cros-ec,drvdata-tcs3400-clear.yaml
```yaml
# Copyright 2021 The Chromium OS Authors. All rights reserved.
# Use of this source code is governed by a BSD-style license that can be
# found in the LICENSE file.

description: TCS3400 CLEAR driver data

compatible: "cros-ec,drvdata-tcs3400-clear"

include: drvdata-base.yaml

#
# examples:
#
# tcs_clear_data: tcs3400-clear-drv-data {
#        compatible = "cros-ec,drvdata-tcs3400-clear";
#        status = "okay";
#
#        als-drv-data {
#                compatible = "cros-ec,accelgyro-als-drv-data";
#                als-cal {
#                        scale = <1>;
#                        uscale = <0>;
#                        offset = <0>;
#                        als-channel-scale {
#                        compatible = "cros-ec,accelgyro-als-channel-scale";
#                                k-channel-scale = <1>;
#                                cover-scale = <1>;
#                        };
#                };
#        };
# };
#
```

## zephyr/dts/bindings/motionsense/drvdata/cros-ec,drvdata-tcs3400-rgb.yaml
```yaml
# Copyright 2021 The ChromiumOS Authors
# Use of this source code is governed by a BSD-style license that can be
# found in the LICENSE file.

description: TCS3400 RGB driver data

compatible: "cros-ec,drvdata-tcs3400-rgb"

include: drvdata-base.yaml

child-binding:
  description: saturation auto-adjustment
  properties:
    again:
      type: int
      description: Gain Scaling; must be value between 0 and 3
    atime:
      type: int
      description: Acquisition Time, controlled by the ATIME register
```
