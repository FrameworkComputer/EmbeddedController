## zephyr/dts/bindings/power/intel,ap-pwrseq.yaml
```yaml
# Copyright 2022 The ChromiumOS Authors
# Use of this source code is governed by a BSD-style license that can be
# found in the LICENSE file.

description: |
    Common fields for AP power sequence configuration
    The configuration consists of a number of mostly timing
    related values.

compatible: "intel,ap-pwrseq"

properties:
  dsw-pwrok-delay:
    type: int
    default: 10
    description: |
      Delay to set DSW_PWROK high to PCH after 3.3V rail stable,
      in milliseconds.

  rsmrst-delay:
    type: int
    default: 10
    description: |
      Delay to set RSMRST from EC to SoC, in milliseconds.

  sys-pwrok-delay:
    type: int
    default: 45
    description: |
      Delay from PG_EC_ALL_SYS_PWRGD high to set EC_PCH_SYS_PWROK high,
      in milliseconds.

  pm-pwrbtn-delay:
    type: int
    default: 200
    description: |
      Power button delay, in milliseconds.

  pch-pwrok-delay:
    type: int
    default: 2
    description: |
      Delay in ms from IMVP9_VRRDY high to PCH_PWROK high delay.

  vccst-pwrgd-delay:
    type: int
    default: 2
    description: |
      Delay in ms from PG_EC_ALL_SYS_PWRGD high
      to VCCST_PWRGD high.

  sys-reset-delay:
    type: int
    default: 32
    description: Debounce time for SYS_RESET_L.

  vrrdy-timeout:
    type: int
    default: 50
    description: |
      Timeout in ms for IMVP9_VRRDY high.

  all-sys-pwrgd-timeout:
    type: int
    default: 0
    description: |
      Timeout in ms for ALL_SYS_PWRGD input to EC to be high.

  wait-signal-timeout:
    type: int
    default: 1000
    description: |
      Timeout in ms for monitoring power signals.

  s5-inactivity-timeout:
    type: int
    default: 10
    description: |
      Timeout in seconds for dropping back from S5 to G3.
```

## zephyr/dts/bindings/pwm/named-pwms.yaml
```yaml
# Copyright 2021 The Chromium OS Authors. All rights reserved.
# Use of this source code is governed by a BSD-style license that can be
# found in the LICENSE file.

description: PWM KEYS parent node

compatible: "named-pwms"

child-binding:
  description: Named PWMs child node
  properties:
    pwms:
      type: phandle-array
      required: true
    frequency:
      required: true
      type: int
      description: PWM frequency, in Hz
```

## zephyr/dts/bindings/retimer/intel,jhl8040r.yaml
```yaml
# Copyright 2021 The Chromium OS Authors. All rights reserved.
# Use of this source code is governed by a BSD-style license that can be
# found in the LICENSE file.

description: Intel JHL8040R Thunderbolt 4 Retimer

compatible: "intel,jhl8040r"

include: i2c-device.yaml

properties:
    reset-pin:
      type: phandle
      required: true

    int-pin:
      type: phandle
      required: false

    ls-en-pin:
      type: phandle
      required: false
```

## zephyr/dts/bindings/switchcap/cros-ec,switchcap-gpio.yaml
```yaml
description: SwitchCap controlled by gpios

compatible: "cros-ec,switchcap-gpio"

properties:
  enable-pin:
    type: phandle
    required: true
    description: |
      GPIO used to enable the switch cap

  power-good-pin:
    type: phandle
    description: |
      GPIO used to read if power is good

  poff-delay-ms:
    type: int
    description: |
      Additional power off delay required for some systems
```

## zephyr/dts/bindings/switchcap/switchcap-gpio.yaml
```yaml
description: SwitchCap controlled by gpios

compatible: "switchcap-gpio"

properties:
  enable-pin:
    type: phandle
    required: true
    description: |
      GPIO used to enable the switch cap

  power-good-pin:
    type: phandle
    required: false
    description: |
      GPIO used to read if power is good

  poff-delay-ms:
    type: int
    required: false
    description: |
      Additional power off delay required for some systems
```

## zephyr/dts/bindings/switchcap/switchcap-ln9310.yaml
```yaml
description: SwitchCap controlled by LN9310

compatible: "switchcap-ln9310"

properties:
  enable-pin:
    type: phandle
    required: true
    description: |
      GPIO used to enable the switch cap. Relies on
      GPIO flags to determine active low or high.

  port:
    type: phandle
    required: true
    description: |
      I2C port used to communicate with controller

  addr-flags:
    type: string
    default: "LN9310_I2C_ADDR_0_FLAGS"
    enum:
      - "LN9310_I2C_ADDR_0_FLAGS"
      - "LN9310_I2C_ADDR_1_FLAGS"
      - "LN9310_I2C_ADDR_2_FLAGS"
      - "LN9310_I2C_ADDR_3_FLAGS"
    description: |
      I2C address of controller
```

## zephyr/dts/bindings/temp/cros-ec,temp-sensor-amdr23m.yaml
```yaml
# Copyright 2023 The ChromiumOS Authors
# Use of this source code is governed by a BSD-style license that can be
# found in the LICENSE file.

description: >
  Properties for a AMD R23M I2C temperature sensor

compatible: "cros-ec,temp-sensor-amdr23m"

include: i2c-device.yaml
```

## zephyr/dts/bindings/temp/cros-ec,temp-sensor-battery.yaml
```yaml
# Copyright 2023 The ChromiumOS Authors
# Use of this source code is governed by a BSD-style license that can be
# found in the LICENSE file.

description: >
  Get the last polled battery/charger temperature.

compatible: "cros-ec,temp-sensor-battery"

include: i2c-device.yaml
```

## zephyr/dts/bindings/temp/cros-ec,temp-sensor-f75303.yaml
```yaml
# Copyright 2023 The ChromiumOS Authors
# Use of this source code is governed by a BSD-style license that can be
# found in the LICENSE file.

description: >
  Properties for a F75303 I2C temperature sensor

compatible: "cros-ec,temp-sensor-f75303"

include: i2c-device.yaml
```

## zephyr/dts/bindings/temp/cros-ec,temp-sensor-f75397.yaml
```yaml
# Copyright 2023 The ChromiumOS Authors
# Use of this source code is governed by a BSD-style license that can be
# found in the LICENSE file.

description: >
  Properties for a F75397 I2C temperature sensor

compatible: "cros-ec,temp-sensor-f75397"

include: i2c-device.yaml

properties:
  temperature-type:
    type: string
    required: true
    description:
      One temperature sensor have three sensor type.
    enum:
      - F75397_IDX_LOCAL
      - F75397_IDX_REMOTE1
```

## zephyr/dts/bindings/temp/cros-ec,temp-sensor-rt9490.yaml
```yaml
# Copyright 2022 The ChromiumOS Authors
# Use of this source code is governed by a BSD-style license that can be
# found in the LICENSE file.

description: >
  Properties for a thermistor on RT9490

include: cros-ec,temp-sensor.yaml

compatible: "cros-ec,temp-sensor-rt9490"

properties:
    port:
      required: true
      type: phandle
      description: phandle to the named i2c port

    thermistor:
      type: phandle
      description: Underlying thermistor device
```

## zephyr/dts/bindings/temp/cros-ec,temp-sensor-sb-tsi.yaml
```yaml
# Copyright 2021 The ChromiumOS Authors
# Use of this source code is governed by a BSD-style license that can be
# found in the LICENSE file.

description: >
  Properties for an Side Band Temperature Sensor Interface sensor

compatible: "cros-ec,temp-sensor-sb-tsi"

include: i2c-device.yaml
```
