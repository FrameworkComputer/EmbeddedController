## zephyr/dts/bindings/motionsense/drvdata/drvdata-base.yaml
```yaml
# Copyright 2021 The Chromium OS Authors. All rights reserved.
# Use of this source code is governed by a BSD-style license that can be
# found in the LICENSE file.

# common fields for driver data

include: base.yaml

properties:
  status:
    required: true
```

## zephyr/dts/bindings/motionsense/motionsense-sensor-base.yaml
```yaml
# Copyright 2021 The ChromiumOS Authors
# Use of this source code is governed by a BSD-style license that can be
# found in the LICENSE file.

# Common fields for motion sensors

include: base.yaml

properties:
  status:
    required: true
  active-mask:
    type: string
    description: indicates system power state for sensor to be active
    enum:
      - "SENSOR_ACTIVE_S5"
      - "SENSOR_ACTIVE_S3"
      - "SENSOR_ACTIVE_S0"
      - "SENSOR_ACTIVE_S0_S3"
      - "SENSOR_ACTIVE_S0_S3_S5"
    default: "SENSOR_ACTIVE_S0_S3"
  location:
    type: string
    required: true
    description: location of the motion sensor
    enum:
      - "MOTIONSENSE_LOC_BASE"
      - "MOTIONSENSE_LOC_LID"
      - "MOTIONSENSE_LOC_CAMERA"
  mutex:
    type: phandle
    description: mutex used by chip driver
  port:
    type: phandle
    description: phandle to the named i2c port
  rot-standard-ref:
    type: phandle
    description: phandle to 3x3 rotation matrix
  default-range:
    type: int
    description: default range of sensor read
  drv-data:
    type: phandle
    description: phandle to driver data to be used for the motion sensor.
      Some drivers require this to be a global shared datas structure
      used by all instances of this device, others require separate
      data structures for each instance.
  alternate-for:
    type: phandle
    description: phandle to another sensor that can be swapped with this one
      at runtime.
  alternate-ssfc-indicator:
    type: phandle
    description: phandle to CBI SSFC value indicating that the sensor
      should be used
  int-signal:
    type: phandle
    description: pin which triggers interrupt for sensor

#
# examples:
#
# lid_accel: lid-accel {
#           compatible = "cros-ec,bma255";
#           status = "okay";
#
#           active-mask = "SENSOR_ACTIVE_S0_S3";
#           location = "MOTIONSENSE_LOC_LID";
#           mutex = <&mutex_bma255>;
#           port = <&i2c_sensor>;
#           rot-standard-ref = <&lid_rot_ref>;
#           default-range = <2>;
#           drv-data = <&bma255_data>;
# };
#
```

## zephyr/dts/bindings/one_wire_uart/cros-ec,one-wire-uart.yaml
```yaml
# Copyright 2022 The ChromiumOS Authors
# Use of this source code is governed by a BSD-style license that can be
# found in the LICENSE file.

description: One wire UART module

compatible: "cros-ec,one-wire-uart"

include: base.yaml

properties:
  id:
    type: int
    enum:
      - 0
      - 1
    description: |
      ID bit for loopback detection. The implementation uses this ID to detect
      if a packet is sent from remote or not. The two sides of one-wire uart
      application must set different ID.

      For CrOS detachable devices, ID can be auto-detected using the existence
      of CONFIG_PLATFORM_EC_DETACHABLE_BASE. No need to set manually.
```

## zephyr/dts/bindings/pmic/mps,mp2964.yaml
```yaml
# Copyright 2021 The ChromiumOS Authors
# Use of this source code is governed by a BSD-style license that can be
# found in the LICENSE file.

description: MPS MP2964 Power Management IC

compatible: "mps,mp2964"

include: i2c-device.yaml
```

## zephyr/dts/bindings/power/ap-pwrseq-sub-states.yaml
```yaml
# Copyright 2022 Intel Corporation
# SPDX-License-Identifier: Apache-2.0

description: |
  Define additional substates to be included in state machine. Use corresponding
  macros to provide action handlers.
compatible: "ap-pwrseq-sub-states"

properties:
  chipset:
    type: string-array
    description: |
      User defined power subtstates, use AP_POWER_CHIPSET_SUB_STATE_DEFINE, to define
      substate action handler functions.
  application:
    type: string-array
    description: |
      User defined power subtstates, use AP_POWER_APP_SUB_STATE_DEFINE, to define
      substate action handler functions.
```

## zephyr/dts/bindings/power/intel,ap-pwr-signal-base.yaml
```yaml
# Copyright 2022 The ChromiumOS Authors
# Use of this source code is governed by a BSD-style license that can be
# found in the LICENSE file.

description: |
    The power signals are defined using different compatibles,
    which configure the source of the signal (GPIO, VW, external etc.).
    All signals use a common base enum-name so that the core code
    can use consistent names.

properties:
  dbg-label:
    type: string
    required: true
    description: Label of power signals used in debug messages

  enum-name:
    type: string
    required: true
    description: |
      Enumeration values for power signals.
      Keep in alphebetical order.
    enum:
    - PWR_ALL_SYS_PWRGD
    - PWR_DSW_PWROK
    - PWR_EC_PCH_RSMRST
    - PWR_EC_PCH_SYS_PWROK
    - PWR_EC_SOC_DSW_PWROK
    - PWR_EN_PP3300_A
    - PWR_EN_PP5000_A
    - PWR_IMVP9_VRRDY
    - PWR_PCH_PWROK
    - PWR_PG_PP1P05
    - PWR_RSMRST_PWRGD
    - PWR_SLP_S0
    - PWR_SLP_S3
    - PWR_SLP_S4
    - PWR_SLP_S5
    - PWR_SLP_SUS
    - PWR_SYS_RST
    - PWR_VCCST_PWRGD

  reset-val:
    type: int
    default: 0
    description: |
      Logical level (active/inactive) to set this signal to on power sequencing
      reset. Behavior depends on the signal type: for GPIOs this only affects
      outputs, and for virtual wires it specifies the assumed value of the
      signal on eSPI reset.
```

## zephyr/dts/bindings/power/intel,ap-pwr-signal-emul.yaml
```yaml
# Copyright 2022 The ChromiumOS Authors
# Use of this source code is governed by a BSD-style license that can be
# found in the LICENSE file.

description: |
  Power Signal Emulator Node

  Power signal emulator allows executing AP Power Sequence in a virtual
  environment by simulating power signals behavior.

  This file defines a node to bind two or more power signals. A node connects
  one input-signal with one or more output-signals. When a node is loaded and
  initialized by power signal emulator, its input-signal state will control
  the value of its children output-signals. Behavior of output-signals are
  configurable to meet AP power sequence test cases.

  Power Signals direction is determined from emulator node perspective. An input
  signal in a node, is the one to be monitored by the emulator, while an output
  signal gets its value altered when corresponding input signal's state changes.

compatible: "intel,ap-pwr-signal-emul"

properties:
  input-signal:
    type: phandle
    required: true
    description: |
      Input signal whose value is monitored to control children output-signal`s
      value.

  assert-value:
    type: int
    default: 1
    description: |
      Value that indicates `input-signal` must be ASSERTED.

      A power signal state can be ASSERTED or DEASSERTED.`input-signal` is only
      considered asserted if its new value is equal to `assert-value`, any
      other value makes it deasserted.

  edge:
    type: string
    description: |
      Controls when to trigger children value change, based on `input-signal`
      new state.

      EDGE_ACTIVE_ON_ASSERT: Children value changes only when `input-signal`
        state changes into asserted.

      EDGE_ACTIVE_ON_DEASSERT: Children value changes only when `input-signal`
        state changes into deasserted.

      EDGE_ACTIVE_ON_DEASSERT: Children value changes everytime `input-signal`
        state changes.

    default: EDGE_ACTIVE_ON_BOTH
    enum:
      - EDGE_ACTIVE_ON_ASSERT
      - EDGE_ACTIVE_ON_DEASSERT
      - EDGE_ACTIVE_ON_BOTH

  init-value:
    type: int
    description: |
      Initial value of `input-signal`.

child-binding:
  description: |
    Child power signals configuration.

  properties:
    output-signal:
      type: phandle
      required: true
      description: |
        Output signal whose value will be controlled by parent `input-signal`
        state.

    assert-value:
      type: int
      default: 1
      description: |
        Value that will be assigned to this signal when parent `input-signal`
        state is asserted.

    assert-delay-ms:
      type: int
      default: 10
      description: |
        Milliseconds to delay setting this signal to its `assert-value`
        after `input-signal` is asserted.

    deassert-value:
      type: int
      default: 0
      description: |
        Value that will be assigned to this signal when parent `input-signal`
        state is deasserted.

    deassert-delay-ms:
      type: int
      default: 10
      description: |
        Milliseconds to delay setting this signal to its `deassert-value`
        after `input-signal` is deasserted.

    init-value:
      type: int
      description: |
        Value set to this power signal when initializing this node.

    invert-value:
      type: boolean
      description: |
        Invert this power signal assertion logic, this applies to both values
        and delays.
```

## zephyr/dts/bindings/power/intel,ap-pwr-test-platform.yaml
```yaml
 # Copyright 2022 The Chromium OS Authors. All rights reserved.
 # Use of this source code is governed by a BSD-style license that can be
 # found in the LICENSE file.

description: |
  Power Signal Test Platform

  This is a virtual representation of platform comprised of one or more power
  signal emulator nodes. Test platform is loaded into power signal emulator.

compatible: "intel,ap-pwr-test-platform"

properties:
  nodes:
    type: phandles
    required: true
    description: |
       phandle array of power signals nodes to be run by emulator.
```

## zephyr/dts/bindings/power/intel,ap-pwrseq-adc.yaml
```yaml
# Copyright 2022 The Chromium OS Authors. All rights reserved.
# Use of this source code is governed by a BSD-style license that can be
# found in the LICENSE file.

description: Power sequence analog signals container.

compatible: "intel,ap-pwrseq-adc"

include: intel,ap-pwr-signal-base.yaml

properties:
    trigger-high:
        description: Rising edge trigger adc comparator
        type: phandle
        required: true

    trigger-low:
        description: Falling edge trigger adc comparator
        type: phandle
        required: true
```

## zephyr/dts/bindings/power/intel,ap-pwrseq-external.yaml
```yaml
# Copyright 2022 The Chromium OS Authors. All rights reserved.
# Use of this source code is governed by a BSD-style license that can be
# found in the LICENSE file.

description: Node for externally supplied power signals

compatible: "intel,ap-pwrseq-external"

include: intel,ap-pwr-signal-base.yaml
```

## zephyr/dts/bindings/power/intel,ap-pwrseq-gpio.yaml
```yaml
# Copyright 2022 The ChromiumOS Authors
# Use of this source code is governed by a BSD-style license that can be
# found in the LICENSE file.

description: Node for power signal GPIO

compatible: "intel,ap-pwrseq-gpio"

include: intel,ap-pwr-signal-base.yaml
properties:
  gpios:
    type: phandle-array
    required: true
    description: |
      GPIO to be used for power signal. Input GPIOs can be
      configured to generate an interrupt if the 'interrupt-flags'
      property is set with the appropriate interrupt flags.

  output:
    type: boolean
    description: Output GPIO. No interrupts used.

  interrupt-flags:
    type: int
    description: GPIO interrupt configuration flags.

  no-enable:
    type: boolean
    description: Do not enable interrupt on start-up
```

## zephyr/dts/bindings/power/intel,ap-pwrseq-signal-list.yaml
```yaml
# Copyright 2022 The Chromium OS Authors. All rights reserved.
# Use of this source code is governed by a BSD-style license that can be
# found in the LICENSE file.

description: Power sequence signals information list.
    The signals could be GPIO signals, eSPI signals through virtual wire.

compatible: "intel,ap-pwrseq-signal-list"

child-binding:
    description: Power sequence signals list child node
    properties:
        dbg-label:
            type: string
            required: true
            description: Label of power signals used in debug messages

        pwrseq-int-gpios:
            type: phandle-array
            required: false
            description: Associated GPIO interrupts pin

        pwrseq-int-flags:
            type: int
            required: false
            description: GPIO interrupt configuration flags.

        enable-int-on-boot:
            type: boolean
            required: false
            description: true - Enable GPIO interrupt at boot up;
                         false - Do not enable GPIO interrupt at boot up.

        pwrseq-vw-enum:
            type: string
            required: false
            description: Enumeration value to eSPI signals that can be sent
              or received through virtual wire channel
            enum:
            - ESPI_VWIRE_SIGNAL_SLP_S3
            - ESPI_VWIRE_SIGNAL_SLP_S4
            - ESPI_VWIRE_SIGNAL_SLP_S5

        pwrseq-signal-enum:
            type: string
            required: true
            description: Enumeration values for power signals

        pwrseq-adc-enum:
            type: string
            required: false

        flags:
            type: int
            required: true
            description: bit 0 represents active in high or low state
              bit[0] = 1 active high
              bit[0] = 0 active low

        pwrseq-board-value:
            type: string
            required: false
            description: a value defined at board level.
```

## zephyr/dts/bindings/power/intel,ap-pwrseq-vw.yaml
```yaml
# Copyright 2022 The Chromium OS Authors. All rights reserved.
# Use of this source code is governed by a BSD-style license that can be
# found in the LICENSE file.

description: Node for eSPI virtual wire power signal

compatible: "intel,ap-pwrseq-vw"

include: intel,ap-pwr-signal-base.yaml
properties:
    virtual-wire:
        type: string
        required: true
        description: |
          Enumeration value to eSPI signals that can be sent
          or received through virtual wire channel

        enum:
        - ESPI_VWIRE_SIGNAL_SLP_S3
        - ESPI_VWIRE_SIGNAL_SLP_S4
        - ESPI_VWIRE_SIGNAL_SLP_S5

    vw-invert:
        type: boolean
        description: |
          Only used for virtual wire nodes.
          If set, the virtual wire signal is inverted before
          being returned.
```
