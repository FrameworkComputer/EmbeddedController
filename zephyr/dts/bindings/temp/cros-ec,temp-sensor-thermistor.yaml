## zephyr/dts/bindings/usbc/cros-ec,tcpci.yaml
```yaml
description: USBC TCPC

compatible: "cros-ec,tcpci"

properties:
  port:
    type: phandle
    required: true
    description: |
      I2C port used to communicate with controller

  i2c-addr-flags:
    type: int
    required: true
    description: |
      I2C address of controller
```

## zephyr/dts/bindings/usbc/cros-ec,usb-mux-chain.yaml
```yaml
# Copyright 2022 The Chromium OS Authors. All rights reserved.
# Use of this source code is governed by a BSD-style license that can be
# found in the LICENSE file.

description: USB-C muxes chain

compatible: "cros-ec,usb-mux-chain"

properties:
  usb-muxes:
    type: phandles
    required: true
    description: |
      List of USB-C muxes and retimers for the USB-C port. The USB-C subsystem
      traverses this list in the order specified. The phandles are references to
      cros-ec,usbc-mux nodes. Link this mux chain with a specific USB-C port by
      adding the "cros-ec,usb-mux-chain" as a child of the "named-usbc-port"
      node.

  alternative-chain:
    type: boolean
    description: |
      Set if this is alternative USB-C muxes chain. It can be selected in
      runtime using USB_MUX_ENABLE_ALTERNATIVE macro.

# Example DTS defining USB-C port 0 with main and alternative usb mux chains.
# The main chain has two muxes: BB retimer and virtual mux.
# The alternative chain has three muxes: BB retimer, SOC side BB retimer and
# virtual mux.
#
#       usbc_port0: port0@0 {
#               compatible = "named-usbc-port";
#               reg = <0>;
#               ...
#               usb-mux-chain-0 {
#                       compatible = "cros-ec,usb-mux-chain";
#                       usb-muxes = <&usb_c0_bb_retimer
#                                    &virtual_mux_c0>;
#               };
#               usb-mux-chain-0 {
#                       compatible = "cros-ec,usb-mux-chain";
#                       alternative-chain;
#                       usb-muxes = <&usb_c0_bb_retimer
#                                    &usb_c0_soc_side_bb_retimer
#                                    &virtual_mux_c0>;
#               };
#       };
```

## zephyr/dts/bindings/usbc/cypress,ccgxxf.yaml
```yaml
# Copyright 2022 The Chromium OS Authors. All rights reserved.
# Use of this source code is governed by a BSD-style license that can be
# found in the LICENSE file.

description: USBC TCPC

compatible: "cypress,ccgxxf"

properties:
  port:
    type: phandle
    required: true
    description: |
      I2C port used to communicate with controller

  i2c-addr-flags:
    type: string
    default: "CCGXXF_I2C_ADDR1_FLAGS"
    enum:
      - "CCGXXF_I2C_ADDR1_FLAGS"
      - "CCGXXF_I2C_ADDR2_FLAGS"
    description: |
      I2C address of controller
```

## zephyr/dts/bindings/usbc/fairchild,fusb302.yaml
```yaml
description: USBC TCPC

compatible: "fairchild,fusb302"

properties:
  port:
    type: phandle
    required: true
    description: |
      I2C port used to communicate with controller

  i2c-addr-flags:
    type: string
    default: "FUSB302_I2C_ADDR_FLAGS"
    enum:
      - "FUSB302_I2C_ADDR_FLAGS"
      - "FUSB302_I2C_ADDR_B01_FLAGS"
      - "FUSB302_I2C_ADDR_B10_FLAGS"
      - "FUSB302_I2C_ADDR_B11_FLAGS"
    description: |
      I2C address of controller
```

## zephyr/dts/bindings/usbc/mux/amd,usbc-mux-amd-fp6.yaml
```yaml
# Copyright 2022 The ChromiumOS Authors
# Use of this source code is governed by a BSD-style license that can be
# found in the LICENSE file.

description: USB-C AMD-FP6 mux

include: ["i2c-device.yaml", "cros-ec,usbc-mux.yaml"]

compatible: "amd,usbc-mux-amd-fp6"
```
