## zephyr/dts/bindings/temp/cros-ec,temp-sensor-thermistor.yaml
```yaml
# Copyright 2021 The ChromiumOS Authors
# Use of this source code is governed by a BSD-style license that can be
# found in the LICENSE file.

description: >
  Properties for a thermistor temperature sensor

include: cros-ec,temp-sensor.yaml

compatible: "cros-ec,temp-sensor-thermistor"

properties:
    adc:
      required: true
      type: phandle
      description: The named adc channel

    thermistor:
      type: phandle
      description: Underlying thermistor device
```

## zephyr/dts/bindings/temp/cros-ec,temp-sensor-tmp112.yaml
```yaml
# Copyright 2021 The ChromiumOS Authors
# Use of this source code is governed by a BSD-style license that can be
# found in the LICENSE file.

description: >
  Properties for a TMP112 I2C temperature sensor

compatible: "cros-ec,temp-sensor-tmp112"

include: i2c-device.yaml
```

## zephyr/dts/bindings/temp/cros-ec,temp-sensors.yaml
```yaml
# Copyright 2021 The ChromiumOS Authors
# Use of this source code is governed by a BSD-style license that can be
# found in the LICENSE file.

description: >
  Common properties for temperature sensors that are not handled by drivers.
  Zero values in degrees K(-273 in degrees C)in thermal thresholds will
  be ignored

compatible: "cros-ec,temp-sensors"

child-binding:
  description: Named temperature sensor node
  properties:
    sensor:
      type: phandle
      required: true
      description:
        A pointer to a coresponding temperature sensor node.

    power-good-pin:
      type: phandle
      description:
        If this sensor will be unpowered some of the time, provide an input GPIO
        which can be referenced to detect whether the sensor is powered before
        reading.

    temp_fan_off:
      type: int
      description:
        Temperature threshold in degrees C when no active cooling
        is needed

    temp_fan_max:
      type: int
      description:
        Temperature threshold in degrees C when max active cooling
        is needed

    temp_host_warn:
      type: int
      description:
        Temperature threshold in degrees C of thermal warn.
        Temperatures above the thermal warn threshold generate a
        request to the AP to throttle itself.

    temp_host_high:
      type: int
      description:
        Temperature threshold in degrees C of thermal high.
        Temperatures above the thermal high threshold cause the EC to
        assert a signal (usually PROCHOT) to the AP and force the AP to
        throttle.

    temp_host_halt:
      type: int
      description:
        Temperature threshold in degrees C that forces AP to shutdown
        due to thermal reason

    temp_host_release_warn:
      type: int
      description:
        Temperature release threshold in degrees C of thermal warn

    temp_host_release_high:
      type: int
      description:
        Temperature release threshold in degrees C of thermal high

    temp_host_release_halt:
      type: int
      description:
        Temperature release threshold in degrees C of thermal shutdown
```

## zephyr/dts/bindings/temp/cros_ec_temp_sensor.yaml
```yaml
# Copyright 2021 The Chromium OS Authors. All rights reserved.
# Use of this source code is governed by a BSD-style license that can be
# found in the LICENSE file.

description: >
  Common properties for temperature sensors
  Zero values in degrees K(-273 in degrees C)in thermal thresholds will
  be ignored

compatible: cros-ec,temp-sensor

properties:
    adc:
      required: true
      type: phandle
      description: The named adc channel

    thermistor:
      type: phandle
      description: Underlying thermistor device if used

    label:
      required: true
      type: string
      description:
        Human-readable string describing the device (used as
        device_get_binding() argument)

    enum-name:
      type: string
      required: true
      description:
        Enum values used in the source code to refer to the temperature sensors
      enum:
      - TEMP_SENSOR_CHARGER
      - TEMP_SENSOR_DDR_SOC
      - TEMP_SENSOR_FAN
      - TEMP_SENSOR_PP3300_REGULATOR
      - TEMP_SENSOR_1_DDR_SOC
      - TEMP_SENSOR_2_AMBIENT
      - TEMP_SENSOR_3_CHARGER
      - TEMP_SENSOR_4_WWAN

    temp_fan_off:
      type: int
      description:
        Temperature threshold in degrees C when no active cooling
        is needed

    temp_fan_max:
      type: int
      description:
        Temperature threshold in degrees C when max active cooling
        is needed

    temp_host_warn:
      type: int
      description:
        Temperature threshold in degrees C of thermal warn.
        Temperatures above the thermal warn threshold generate a
        request to the AP to throttle itself.

    temp_host_high:
      type: int
      description:
        Temperature threshold in degrees C of thermal high.
        Temperatures above the thermal high threshold cause the EC to
        assert a signal (usually PROCHOT) to the AP and force the AP to
        throttle.

    temp_host_halt:
      type: int
      description:
        Temperature threshold in degrees C that forces AP to shutdown
        due to thermal reason

    temp_host_release_warn:
      type: int
      description:
        Temperature release threshold in degrees C of thermal warn

    temp_host_release_high:
      type: int
      description:
        Temperature release threshold in degrees C of thermal high

    temp_host_release_halt:
      type: int
      description:
        Temperature release threshold in degrees C of thermal shutdown
```

## zephyr/dts/bindings/temp/cros_ec_temp_sensor_pct2075.yaml
```yaml
# Copyright 2022 The Chromium OS Authors. All rights reserved.
# Use of this source code is governed by a BSD-style license that can be
# found in the LICENSE file.

description: >
  Properties for a PCT2075 I2C temperature sensor

include: cros_ec_temp_sensor.yaml

compatible: cros-ec,temp-sensor-pct2075

properties:
    pct2075-name:
      type: string
      required: true
      description:
        Enum value to index into the PCT2075 specific sensors
      enum:
      - PCT2075_SOC
      - PCT2075_AMB

    port:
      required: true
      type: phandle
      description: phandle to the named i2c port

    i2c-addr-flags:
      required: true
      type: string
      description: I2C address of chip
      enum:
        - PCT2075_I2C_ADDR_FLAGS0
        - PCT2075_I2C_ADDR_FLAGS1
        - PCT2075_I2C_ADDR_FLAGS2
        - PCT2075_I2C_ADDR_FLAGS3
        - PCT2075_I2C_ADDR_FLAGS4
        - PCT2075_I2C_ADDR_FLAGS5
        - PCT2075_I2C_ADDR_FLAGS6
        - PCT2075_I2C_ADDR_FLAGS7
```

## zephyr/dts/bindings/temp/cros_ec_temp_sensor_sb_tsi.yaml
```yaml
# Copyright 2021 The Chromium OS Authors. All rights reserved.
# Use of this source code is governed by a BSD-style license that can be
# found in the LICENSE file.

description: >
  Properties for an Side Band Temperature Sensor Interface sensor

include: cros_ec_temp_sensor.yaml

compatible: cros-ec,temp-sensor-sb-tsi

properties:
    port:
      required: true
      type: phandle
      description: phandle to the sensor's i2c port
```

## zephyr/dts/bindings/temp/cros_ec_temp_sensor_thermistor.yaml
```yaml
# Copyright 2021 The Chromium OS Authors. All rights reserved.
# Use of this source code is governed by a BSD-style license that can be
# found in the LICENSE file.

description: >
  Properties for a thermistor temperature sensor

include: cros_ec_temp_sensor.yaml

compatible: cros-ec,temp-sensor-thermistor

properties:
    adc:
      required: true
      type: phandle
      description: The named adc channel

    thermistor:
      type: phandle
      description: Underlying thermistor device
```

## zephyr/dts/bindings/temp/cros_ec_temp_sensor_tmp112.yaml
```yaml
# Copyright 2021 The Chromium OS Authors. All rights reserved.
# Use of this source code is governed by a BSD-style license that can be
# found in the LICENSE file.

description: >
  Properties for a TMP112 I2C temperature sensor

include: cros_ec_temp_sensor.yaml

compatible: cros-ec,temp-sensor-tmp112

properties:
    tmp112-name:
      type: string
      required: true
      description:
        Enum value to index into the TMP112 specific sensors
      enum:
      - TMP112_SOC
      - TMP112_AMB

    port:
      required: true
      type: phandle
      description: phandle to the named i2c port

    i2c-addr-flags:
      required: true
      type: string
      description: I2C address of chip
      enum:
        - TMP112_I2C_ADDR_FLAGS0
        - TMP112_I2C_ADDR_FLAGS1
        - TMP112_I2C_ADDR_FLAGS2
        - TMP112_I2C_ADDR_FLAGS3
```

## zephyr/dts/bindings/temp/cros_ec_thermistor.yaml
```yaml
# Copyright 2021 The Chromium OS Authors. All rights reserved.
# Use of this source code is governed by a BSD-style license that can be
# found in the LICENSE file.

# For more information:
# https://www.electronics-tutorials.ws/io/thermistors.html

description: Common properties for thermistors

compatible: cros-ec,thermistor

properties:
  scaling-factor:
    required: true
    type: int
    description: Scaling factor for voltage pairs

  num-pairs:
    required: true
    type: int
    description: Number of sample data points for linear interpolation

  steinhart-reference-mv:
    required: true
    type: int
    description: >
      Used only for testing.
      Is the reference voltage for temperature 25C.

  steinhart-reference-res:
    required: true
    type: int
    description: >
      Used only for testing.
      Is the reference resistance for temperature 25C.

child-binding:
  description: >
    Data samples derived from Steinhart-Hart
    equation in a resistor divider circuit.
    Used in linear interpolation.

  properties:
    milivolt:
      type: int
      required: true
      description: Voltage reading for a given temperature sample

    temp:
      type: int
      required: true
      description: Temperature (Celcius) in a sample

    sample-index:
      type: int
      required: true
      description: The index of a datum to maintain sample order to interpolate.
```

## zephyr/dts/bindings/temp/nxp,pct2075.yaml
```yaml
# Copyright 2021 The ChromiumOS Authors
# Use of this source code is governed by a BSD-style license that can be
# found in the LICENSE file.

description: >
  Properties for a PCT2075 I2C temperature sensor

compatible: "nxp,pct2075"

include: i2c-device.yaml
```

## zephyr/dts/bindings/temp/temp-3v0-22k6-47k-4050b.yaml
```yaml
# Copyright 2021 The Chromium OS Authors. All rights reserved.
# Use of this source code is governed by a BSD-style license that can be
# found in the LICENSE file.

description: Thermistor 3v0-22k6-47k-4050b

compatible: "temp-3v0-22k6-47k-4050b"

include: [temp_sensor.yaml, thermistor.yaml]

properties:
  get-temp-func:
    enum:
    - get_temp_3v0_22k6_47k_4050b
    default: get_temp_3v0_22k6_47k_4050b
```

## zephyr/dts/bindings/temp/temp-3v3-13k7-47k-4050b.yaml
```yaml
# Copyright 2021 The Chromium OS Authors. All rights reserved.
# Use of this source code is governed by a BSD-style license that can be
# found in the LICENSE file.

description: Thermistor 3v3-13k7-47k-4050b

compatible: "temp-3v3-13k7-47k-4050b"

include: [temp_sensor.yaml, thermistor.yaml]

properties:
  get-temp-func:
    enum:
    - get_temp_3v3_13k7_47k_4050b
    default: get_temp_3v3_13k7_47k_4050b
```

## zephyr/dts/bindings/temp/thermistor.yaml
```yaml
# Copyright 2021 The Chromium OS Authors. All rights reserved.
# Use of this source code is governed by a BSD-style license that can be
# found in the LICENSE file.

# Common properties for thermistors

properties:
  adc:
    required: true
    type: phandle
    description: named-adc child node connected to the thermistor

  get-temp-func:
    type: string
    required: false
    description: >
      Name of the board-provided function which reads the temperature. If you
      have different values and need to add a new function, you can add that
      here.

      The name is get_temp_<v>_<rs>_<rn>_<b>:

      v: voltage of resistor-divider circuit
      rs: value of the resistor that is in series with the thermistor
      rn: nominal resistance of thermistor at 25C
      b: B value for temperature range 25C to 100C

      See https://www.electronics-tutorials.ws/io/thermistors.html for more
      information.
```

## zephyr/dts/bindings/touchpad/cros-ec,hid-i2c-touchpad.yaml
```yaml
# Copyright 2023 The ChromiumOS Authors
# Use of this source code is governed by a BSD-style license that can be
# found in the LICENSE file.

description: HID over I2C Touchpad

compatible: "cros-ec,hid-i2c-touchpad"

include: i2c-device.yaml

properties:
  logical_max_x:
    type: int
    description: The logical maximum x_axis setting

  logical_max_y:
    type: int
    description: The logical maximum y_axis setting

  physical_max_x:
    type: int
    description: The physical maximum x_axis setting

  physical_max_y:
    type: int
    description: The physical maximum y_axis setting

  max_pressure:
    type: int
    description: The maximum pressure for touchpad

  vid:
    type: int
    description: Vendor ID of this HID device

  pid:
    type: int
    description: Product ID of this HID device
```

## zephyr/dts/bindings/touchpad/cros-ec,usb-hid-touchpad.yaml
```yaml
# Copyright 2023 The ChromiumOS Authors
# Use of this source code is governed by a BSD-style license that can be
# found in the LICENSE file.

description: USB HID Touchpad

compatible: "cros-ec,usb-hid-touchpad"

on-bus: usb

properties:
  logical_max_x:
    type: int
    description: The logical maximum x_axis setting

  logical_max_y:
    type: int
    description: The logical maximum y_axis setting

  physical_max_x:
    type: int
    description: The physical maximum x_axis setting

  physical_max_y:
    type: int
    description: The physical maximum y_axis setting

  max_pressure:
    type: int
    description: The maximum pressure for touchpad
```

## zephyr/dts/bindings/touchpad/elan,ekth3000.yaml
```yaml
# Copyright 2023 The ChromiumOS Authors
# Use of this source code is governed by a BSD-style license that can be
# found in the LICENSE file.

description: Elan I2C touchpad

compatible: "elan,ekth3000"

include: i2c-device.yaml

properties:
  irq:
    type: phandle
    required: true
    description: Interrupt from touchpad

  logical_max_x:
    type: int
    required: true
    description: The logical maximum x-axis setting

  logical_max_y:
    type: int
    required: true
    description: The logical maximum y-axis setting

  physical_max_x:
    type: int
    required: true
    description: The physical maximum x-axis setting

  physical_max_y:
    type: int
    required: true
    description: The physical maximum y-axis setting

  max_pressure:
    type: int
    description: The maximum pressure for touchpad
```

## zephyr/dts/bindings/usbc/anologix,anx7447-tcpc.yaml
```yaml
description: Anologix ANX7447 USBC TCPC binding

compatible: "anologix,anx7447-tcpc"

include: i2c-device.yaml

properties:
  tcpc-flags:
    type: int
    default: 0
    description: |
      TCPC configuration flags
```

## zephyr/dts/bindings/usbc/bc12/richtek,rt1718s-bc12.yaml
```yaml
# Copyright 2022 The ChromiumOS Authors
# Use of this source code is governed by a BSD-style license that can be
# found in the LICENSE file.

description: USBC RT1718S BC1.2

compatible: "richtek,rt1718s-bc12"

include: base.yaml
```

## zephyr/dts/bindings/usbc/bc12/richtek,rt1739-bc12.yaml
```yaml
# Copyright 2022 The ChromiumOS Authors
# Use of this source code is governed by a BSD-style license that can be
# found in the LICENSE file.

description: USBC BC1.2

compatible: "richtek,rt1739-bc12"

include: base.yaml
```
