## zephyr/dts/bindings/usbc/mux/amd,usbc-mux-amd-fp8.yaml
```yaml
# Copyright 2023 The ChromiumOS Authors
# Use of this source code is governed by a BSD-style license that can be
# found in the LICENSE file.

description: USB-C AMD-FP8 mux

include: ["i2c-device.yaml", "cros-ec,usbc-mux.yaml"]

compatible: "amd,usbc-mux-amd-fp8"

properties:
  irq-gpios:
    type: phandle-array
    required: true
    description: Interrupt from SoC

  fixed:
    type: int
    description: Fixed mux state to always apply
```

## zephyr/dts/bindings/usbc/mux/analogix,anx3443.yaml
```yaml
# Copyright 2024 The ChromiumOS Authors
# Use of this source code is governed by a BSD-style license that can be
# found in the LICENSE file.

description: |
  Analogix re-timing MUX

include: ["i2c-device.yaml", "cros-ec,usbc-mux.yaml"]

compatible: "analogix,anx3443"
```

## zephyr/dts/bindings/usbc/mux/analogix,anx7452.yaml
```yaml
# Copyright 2023 The ChromiumOS Authors
# Use of this source code is governed by a BSD-style license that can be
# found in the LICENSE file.

description: |
  Analogix re-timing MUX

include: ["i2c-device.yaml", "cros-ec,usbc-mux.yaml"]

compatible: "analogix,anx7452"

properties:
  usb-en-pin:
    type: phandle
    required: true

  dp-en-pin:
    type: phandle
```

## zephyr/dts/bindings/usbc/mux/analogix,anx7483.yaml
```yaml
# Copyright 2022 The Chromium OS Authors. All rights reserved.
# Use of this source code is governed by a BSD-style license that can be
# found in the LICENSE file.

description: |
  Analogix re-timing MUX

include: cros-ec,usbc-mux.yaml

compatible: "analogix,anx7483"

properties:
  port:
    type: phandle
    required: true
    description: phandle to the named i2c port

  i2c-addr-flags:
    type: string
    required: true
    description: I2C address of chip
    enum:
      - ANX7483_I2C_ADDR0_FLAGS
      - ANX7483_I2C_ADDR1_FLAGS
      - ANX7483_I2C_ADDR2_FLAGS
      - ANX7483_I2C_ADDR3_FLAGS
```

## zephyr/dts/bindings/usbc/mux/analogix,usbc-mux-anx7447.yaml
```yaml
# Copyright 2022 The ChromiumOS Authors
# Use of this source code is governed by a BSD-style license that can be
# found in the LICENSE file.

description: USBC ANX7447 USB MUX

include: ["base.yaml", "cros-ec,usbc-mux.yaml"]

compatible: "analogix,usbc-mux-anx7447"

properties:
  hpd-update-enable:
    type: boolean
    description: |
      Enable anx7447 hpd update callback
```

## zephyr/dts/bindings/usbc/mux/cros-ec,usbc-mux-tcpci.yaml
```yaml
# Copyright 2022 The ChromiumOS Authors
# Use of this source code is governed by a BSD-style license that can be
# found in the LICENSE file.

description: USBC TCPC USB MUX

# Include base.yaml instead of i2c-device.yaml because the reg property is not
# required for this node.
include: ["base.yaml", "cros-ec,usbc-mux.yaml"]

compatible: "cros-ec,usbc-mux-tcpci"

properties:
  hpd-update:
    type: string
    description: |
      Name of function used as hpd_update callback
```

## zephyr/dts/bindings/usbc/mux/cros-ec,usbc-mux-virtual.yaml
```yaml
# Copyright 2022 The ChromiumOS Authors
# Use of this source code is governed by a BSD-style license that can be
# found in the LICENSE file.

description: USB-C Virtual USB MUX

include: ["base.yaml", "cros-ec,usbc-mux.yaml"]

compatible: "cros-ec,usbc-mux-virtual"
```

## zephyr/dts/bindings/usbc/mux/cros-ec,usbc-mux.yaml
```yaml
# Copyright 2022 The ChromiumOS Authors
# Use of this source code is governed by a BSD-style license that can be
# found in the LICENSE file.

description: Common properties for USB-C mux

properties:
  flags:
    type: int
    default: 0
    description: |
      Mask of flags defined in dt-bindings/usbc_mux.h

  board-init:
    type: string
    description: |
      Name of function used as board_init callback

  board-set:
    type: string
    description: |
      Name of function used as board_set callback
```

## zephyr/dts/bindings/usbc/mux/intel,jhl8040r.yaml
```yaml
# Copyright 2021 The ChromiumOS Authors
# Use of this source code is governed by a BSD-style license that can be
# found in the LICENSE file.

description: Intel JHL8040R Thunderbolt 4 Retimer

compatible: "intel,jhl8040r"

include: ["i2c-device.yaml", "cros-ec,usbc-mux.yaml"]

properties:
  reset-pin:
    type: phandle
    required: true

  int-pin:
    type: phandle

  ls-en-pin:
    type: phandle
```

## zephyr/dts/bindings/usbc/mux/intel,jhl804r.yaml
```yaml
# Copyright 2021 The Chromium OS Authors. All rights reserved.
# Use of this source code is governed by a BSD-style license that can be
# found in the LICENSE file.

description: Intel JHL8040R Thunderbolt 4 Retimer

compatible: "intel,jhl8040r"

include: cros-ec,usbc-mux.yaml

properties:
    reset-pin:
      type: phandle
      required: true

    int-pin:
      type: phandle
      required: false

    ls-en-pin:
      type: phandle
      required: false

    port:
      type: phandle
      required: true
      description: phandle to the named i2c port

    i2c-addr-flags:
      type: int
      required: true
      description: I2C address of chip
```

## zephyr/dts/bindings/usbc/mux/intel,jhl9040r.yaml
```yaml
# Copyright 2022 Google LLC
# Use of this source code is governed by a BSD-style license that can be
# found in the LICENSE file.

description: Intel JHL9040R Thunderbolt 4 Retimer

compatible: "intel,jhl9040r"

include: ["i2c-device.yaml", "cros-ec,usbc-mux.yaml"]

properties:
  reset-pin:
    type: phandle
    required: true

  int-pin:
    type: phandle

  ls-en-pin:
    type: phandle
```

## zephyr/dts/bindings/usbc/mux/ite,it5205.yaml
```yaml
# Copyright 2022 The ChromiumOS Authors
# Use of this source code is governed by a BSD-style license that can be
# found in the LICENSE file.

description: ITE IT5205 USB Type-C 3:2 alternate mode MUX

include: ["i2c-device.yaml", "cros-ec,usbc-mux.yaml"]

compatible: "ite,it5205"
```

## zephyr/dts/bindings/usbc/mux/kandou,kb8010.yaml
```yaml
# Copyright 2023 The ChromiumOS Authors
# Use of this source code is governed by a BSD-style license that can be
# found in the LICENSE file.

description: Kandou re-timing MUX

include: ["i2c-device.yaml", "cros-ec,usbc-mux.yaml"]

compatible: "kandou,kb8010"

properties:
  dp-en-pin:
    type: phandle
    required: true

  reset-pin:
    type: phandle
    required: true

  int-pin:
    type: phandle
```

## zephyr/dts/bindings/usbc/mux/parade,ps8743.yaml
```yaml
# Copyright 2022 The ChromiumOS Authors
# Use of this source code is governed by a BSD-style license that can be
# found in the LICENSE file.

description: Parade PS8743 USB Type-C alternate mode MUX

include: ["i2c-device.yaml", "cros-ec,usbc-mux.yaml"]

compatible: "parade,ps8743"
```

## zephyr/dts/bindings/usbc/mux/parade,ps8802.yaml
```yaml
# Copyright 2024 The ChromiumOS Authors
# Use of this source code is governed by a BSD-style license that can be
# found in the LICENSE file.

description: USBC PS8802 Retimer

include: ["i2c-device.yaml", "cros-ec,usbc-mux.yaml"]

compatible: "parade,ps8802"
```

## zephyr/dts/bindings/usbc/mux/parade,ps8818.yaml
```yaml
# Copyright 2022 The ChromiumOS Authors
# Use of this source code is governed by a BSD-style license that can be
# found in the LICENSE file.

description: USBC PS8818 Retimer

include: ["i2c-device.yaml", "cros-ec,usbc-mux.yaml"]

compatible: "parade,ps8818"
```

## zephyr/dts/bindings/usbc/mux/parade,ps8828.yaml
```yaml
# Copyright 2023 The ChromiumOS Authors
# Use of this source code is governed by a BSD-style license that can be
# found in the LICENSE file.

description: Parade PS8828 USB Type-C 10Gbps Retimer

include: ["i2c-device.yaml", "cros-ec,usbc-mux.yaml"]

compatible: "parade,ps8828"
```

## zephyr/dts/bindings/usbc/mux/parade,usbc-mux-ps8xxx.yaml
```yaml
# Copyright 2022 The Chromium OS Authors. All rights reserved.
# Use of this source code is governed by a BSD-style license that can be
# found in the LICENSE file.

description: USBC PS8xxx USB MUX

include: cros-ec,usbc-mux-tcpci.yaml

compatible: "parade,usbc-mux-ps8xxx"

properties:
  hpd-update:
    description: |
      PS8xxx USB MUX almost always use this hdp_update callback
    default: "ps8xxx_tcpc_update_hpd_status"
```

## zephyr/dts/bindings/usbc/mux/ti,tusb1044.yaml
```yaml
# Copyright 2024 The ChromiumOS Authors
# Use of this source code is governed by a BSD-style license that can be
# found in the LICENSE file.

description: |
  TUSB1044 or TUSB1046 USB-C MUX

include: ["i2c-device.yaml", "cros-ec,usbc-mux.yaml"]

compatible: "ti,tusb1044"
```

## zephyr/dts/bindings/usbc/mux/ti,tusb1064.yaml
```yaml
# Copyright 2022 The ChromiumOS Authors
# Use of this source code is governed by a BSD-style license that can be
# found in the LICENSE file.

description: |
  TI TUSB1064 USB-C MUX

include: ["i2c-device.yaml", "cros-ec,usbc-mux.yaml"]

compatible: "ti,tusb1064"
```

## zephyr/dts/bindings/usbc/mux/ti,tusb546.yaml
```yaml
# Copyright 2024 The ChromiumOS Authors
# Use of this source code is governed by a BSD-style license that can be
# found in the LICENSE file.

description: |
  TI TUSB546 USB-C MUX

include: ["i2c-device.yaml", "cros-ec,usbc-mux.yaml"]

compatible: "ti,tusb546"
```

## zephyr/dts/bindings/usbc/named-usbc-port.yaml
```yaml
# Copyright 2022 The ChromiumOS Authors
# Use of this source code is governed by a BSD-style license that can be
# found in the LICENSE file.

description: |
  Named USB-C port node

  Example:
        usbc {
                #address-cells = <1>;
                #size-cells = <0>;

                /* Reg property is used to assign a port number */
                port0@0 {
                        compatible = "named-usbc-port";
                        reg = <0>;
                        bc12 = <&bc12_port0>;
                };
                port1@1 {
                        compatible = "named-usbc-port";
                        reg = <1>;
                        bc12 = <&bc12_port1>;
                };
                };

compatible: "named-usbc-port"

include: base.yaml

properties:
  bc12:
    type: phandle
    description: |
      BC1.2 chip for the USB-C port.
  tcpc:
    type: phandle
    description: |
      TCPC chip for the USB-C port.
  chg:
    type: phandle
    description: |
      Charger chip for the USB-C port.
  chg_alt:
    type: phandle
    description: |
      Alternative charger for the USB-C port.
  ppc:
    type: phandle
    description: |
      PPC for the USB-C port.
  ppc_alt:
    type: phandle
    description: |
      Alternate PPC for the USB-C port.
  alt-mode:
    type: phandle
    description: |
      PD chip for configuring the alternate modes of the USB-C port.
  pdc:
    type: phandle
    description: |
      PD chip for managing Power Delivery
  pd-retimer:
    type: boolean
    description: |
      If present, this PD port has a retimer and connected to PD chip.
```

## zephyr/dts/bindings/usbc/named-usbc-ports.yaml
```yaml
# Copyright (c) 2021 The Chromium OS Authors
# SPDX-License-Identifier: Apache-2.0

description: Named USB-C ports parent node

compatible: "named-usbc-ports"

include: base.yaml

properties:
  "#address-cells":
    required: true
    const: 1
  "#size-cells":
    required: true
    const: 0

child-binding:
  description: Named USB-C port
  properties:
    reg:
      type: array
      required: true
      description: |
        USB-C port number to serialize devices used for USB-C communication
```

## zephyr/dts/bindings/usbc/nuvoton,nct38xx.yaml
```yaml
# Copyright 2021 The Chromium OS Authors. All rights reserved.
# Use of this source code is governed by a BSD-style license that can be
# found in the LICENSE file.

description: Nuvoton NCT38XX USB TCPC binding

compatible: "nuvoton,nct38xx"

properties:
  gpio-dev:
    type: phandle
    description: |
      Pointer to the NCT38XX GPIO device. This is used to binding the Cros TCPC
      port index to Zephyr NCT38XX GPIO device.

  port:
    type: phandle
    description: |
      I2C port used to communicate with controller

  i2c-addr-flags:
    type: string
    default: "NCT38XX_I2C_ADDR1_1_FLAGS"
    enum:
      - "NCT38XX_I2C_ADDR1_1_FLAGS"
      - "NCT38XX_I2C_ADDR1_2_FLAGS"
      - "NCT38XX_I2C_ADDR1_3_FLAGS"
      - "NCT38XX_I2C_ADDR1_4_FLAGS"
      - "NCT38XX_I2C_ADDR2_1_FLAGS"
      - "NCT38XX_I2C_ADDR2_2_FLAGS"
      - "NCT38XX_I2C_ADDR2_3_FLAGS"
      - "NCT38XX_I2C_ADDR2_4_FLAGS"
    description: |
      I2C address of controller

  tcpc-flags:
    type: int
    default: 0
    description: |
      TCPC configuration flags
```

## zephyr/dts/bindings/usbc/nxp,nx20p348x.yaml
```yaml
# Copyright 2022 The ChromiumOS Authors.
# Use of this source code is governed by a BSD-style license that can be
# found in the LICENSE file.

description: NXP NX20P348X USBC PPC binding

compatible: "nxp,nx20p348x"

include: ppc-chip.yaml

properties:
  i2c-addr-flags:
    default: "NX20P3483_ADDR2_FLAGS"
    enum:
      - "NX20P3483_ADDR0_FLAGS"
      - "NX20P3483_ADDR1_FLAGS"
      - "NX20P3483_ADDR2_FLAGS"
      - "NX20P3483_ADDR3_FLAGS"
      - "NX20P3481_ADDR0_FLAGS"
      - "NX20P3481_ADDR1_FLAGS"
      - "NX20P3481_ADDR2_FLAGS"
      - "NX20P3481_ADDR3_FLAGS"
```
