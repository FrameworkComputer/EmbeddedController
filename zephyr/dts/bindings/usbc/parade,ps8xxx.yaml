## zephyr/dts/bindings/usbc/parade,ps8xxx.yaml
```yaml
description: USBC TCPC

compatible: "parade,ps8xxx"

properties:
  port:
    type: phandle
    required: true
    description: |
      I2C port used to communicate with controller

  i2c-addr-flags:
    type: string
    default: "PS8XXX_I2C_ADDR1_FLAGS"
    enum:
      - "PS8XXX_I2C_ADDR1_P1_FLAGS"
      - "PS8XXX_I2C_ADDR1_P2_FLAGS"
      - "PS8XXX_I2C_ADDR1_FLAGS"
      - "PS8XXX_I2C_ADDR2_FLAGS"
      - "PS8XXX_I2C_ADDR3_FLAGS"
      - "PS8XXX_I2C_ADDR4_FLAGS"
    description: |
      I2C address of controller

  tcpc-flags:
    type: int
    default: 0
    description: |
      TCPC configuration flags
```

## zephyr/dts/bindings/usbc/pd/infineon,ccg8.yaml
```yaml
# Copyright 2024 Google LLC
# Use of this source code is governed by a BSD-style license that can be
# found in the LICENSE file.

description: Infineon CCG8 Power Delivery Controller

compatible: "infineon,ccg8"

include: ["i2c-device.yaml"]

properties:
  irq-gpios:
    type: phandle-array
    required: true
    description: |
      Interrupt line from the PD for power path (zephyr standard GPIO format)
```

## zephyr/dts/bindings/usbc/pd/intel,pd-altmode.yaml
```yaml
# Copyright 2023 Google LLC
# Use of this source code is governed by a BSD-style license that can be
# found in the LICENSE file.

description: Intel SoC USBC Alternate mode Compatible PD

compatible: "intel,pd-altmode"

include: ["i2c-device.yaml"]

properties:
  irq-gpios:
    type: phandle-array
    required: true
    description: |
      Interrupt line from the PD for data path (zephyr standard GPIO format)
  irq-shared:
    type: boolean
    description: |
      Interrupt line is shared between ports in a dual port solution.
      Define it only for the secondary port so that the driver doesn't
      trigger multiple events.
```

## zephyr/dts/bindings/usbc/pd/realtek,rts545x.yaml
```yaml
# Copyright 2023 Google LLC
# Use of this source code is governed by a BSD-style license that can be
# found in the LICENSE file.

description: Realtek RTS545x Power Delivery Controller

compatible: "realtek,rts545x"

include: ["i2c-device.yaml"]

properties:
  irq-gpios:
    type: phandle-array
    description: |
      Interrupt line from the PD controller.
```

## zephyr/dts/bindings/usbc/pdc/pdc-device.yaml
```yaml
# Copyright 2024 Google LLC
# Use of this source code is governed by a BSD-style license that can be
# found in the LICENSE file.

properties:
  # TODO: http://b/323371550
  # Revisit this property when we support PDC port groupings
  no-fw-update:
    type: boolean
    description: |
      If set, do NOT consider this node to be an independent PD chip and
      instruct Depthcharge to NOT apply firmware updates to this device. For
      two-port PDC devices where each port has its own DT node, one of them
      should have this property set to avoid updating the same chip twice
      through each port.
  ccd:
    type: boolean
    description: |
      If present, this USB-C port has hardware support for closed-case
      debugging (CCD). Used only on boards with PDC-driven CCD. This should be
      applied to the port serviced by the PDC driver that correlates to PORTB
      on dual-port PDCs. On dual-port RTK PDCs, this is the lower I2C target
      address; on TI PDCs, this is the higher I2C address.
```

## zephyr/dts/bindings/usbc/pdc/realtek,rts54-pdc.yaml
```yaml
# Copyright 2023 Google LLC
# Use of this source code is governed by a BSD-style license that can be
# found in the LICENSE file.

description: Realtek PDC RTS54 Power

compatible: "realtek,rts54-pdc"

include: ["i2c-device.yaml", "pdc-device.yaml"]

properties:
  irq-gpios:
    type: phandle-array
    required: true
    description: |
      Interrupt line from the PD for power path (zephyr standard GPIO format)
```

## zephyr/dts/bindings/usbc/pericom,pi3usb9201.yaml
```yaml
description: USBC BC1.2

compatible: "pericom,pi3usb9201"

include: base.yaml

properties:
  irq:
    type: phandles
    description: |
        GPIO interrupt from BC1.2
```

## zephyr/dts/bindings/usbc/ppc-chip.yaml
```yaml
# Copyright 2021 The ChromiumOS Authors
# SPDX-License-Identifier: Apache-2.0

description: Power path chip

properties:

  irq:
    type: phandles
    description: |
      GPIO interrupt from PPC using a named-gpios child node

  is-alt:
    type: boolean
    description: |
      If present, this node refers to an altnerate PPC device. The PPC device
      is not used by default, and must be manually enabled at runtime.

  irq-gpios:
    type: phandle-array
    description: |
      Interrupt line from the PPC (zephyr standard GPIO format)
```

## zephyr/dts/bindings/usbc/ppc/aoz,aoz1380.yaml
```yaml
# Copyright 2022 The ChromiumOS Authors
# Use of this source code is governed by a BSD-style license that can be
# found in the LICENSE file.

description: AOZ1380 USBC PPC binding

compatible: "aoz,aoz1380"

include: ["base.yaml", "ppc-chip.yaml"]
```

## zephyr/dts/bindings/usbc/ppc/kinetic,ktu1125.yaml
```yaml
description: USBC PPC

compatible: "kinetic,ktu1125"

include: ["i2c-device.yaml", "ppc-chip.yaml"]
```

## zephyr/dts/bindings/usbc/ppc/richtek,rt1739-ppc.yaml
```yaml
# Copyright 2022 The ChromiumOS Authors
# Use of this source code is governed by a BSD-style license that can be
# found in the LICENSE file.

description: USBC PPC

compatible: "richtek,rt1739-ppc"

include: ["i2c-device.yaml", "ppc-chip.yaml"]

properties:
  frs_en_gpio:
    type: phandle
    description: The GPIO that controls FRS enable on this device
```

## zephyr/dts/bindings/usbc/ppc/silergy,syv682x.yaml
```yaml
description: USBC PPC

compatible: "silergy,syv682x"

include: ["i2c-device.yaml", "ppc-chip.yaml"]

properties:
  frs_en_gpio:
    type: phandle
    description: The GPIO that controls FRS enable on this device
```

## zephyr/dts/bindings/usbc/ppc/ti,sn5s330.yaml
```yaml
description: USBC PPC

compatible: "ti,sn5s330"

include: ["i2c-device.yaml", "ppc-chip.yaml"]
```

## zephyr/dts/bindings/usbc/richtek,rt1718s-tcpc.yaml
```yaml
# Copyright 2022 The ChromiumOS Authors.
# Use of this source code is governed by a BSD-style license that can be
# found in the LICENSE file.

description: USBC RT1718S TCPC

compatible: "richtek,rt1718s-tcpc"

properties:
  port:
    type: phandle
    required: true
    description: |
      I2C port used to communicate with controller

  i2c-addr-flags:
    type: string
    default: "RT1718S_I2C_ADDR1_FLAGS"
    enum:
      - "RT1718S_I2C_ADDR1_FLAGS"
      - "RT1718S_I2C_ADDR2_FLAGS"
    description: |
      I2C address of controller

  tcpc-flags:
    type: int
    default: 0
    description: |
      TCPC configuration flags
```

## zephyr/dts/bindings/usbc/richtek,rt1739-ppc.yaml
```yaml
# Copyright 2022 The Chromium OS Authors. All rights reserved.
# Use of this source code is governed by a BSD-style license that can be
# found in the LICENSE file.

description: USBC PPC

compatible: "richtek,rt1739-ppc"

include: ppc-chip.yaml

properties:
  i2c-addr-flags:
    default: "RT1739_ADDR1_FLAGS"
    enum:
      - "RT1739_ADDR1_FLAGS"
      - "RT1739_ADDR2_FLAGS"
      - "RT1739_ADDR3_FLAGS"
      - "RT1739_ADDR4_FLAGS"
```

## zephyr/dts/bindings/usbc/richtek,rt9490-bc12.yaml
```yaml
# Copyright 2022 The Chromium OS Authors. All rights reserved.
# Use of this source code is governed by a BSD-style license that can be
# found in the LICENSE file.

description: USBC BC1.2

compatible: "richtek,rt9490-bc12"
```

## zephyr/dts/bindings/usbc/silergy,syv682x.yaml
```yaml
description: USBC PPC

compatible: "silergy,syv682x"

include: ppc-chip.yaml

properties:
  frs_en_gpio:
    type: phandle
    description: The GPIO that controls FRS enable on this device
    required: false
```

## zephyr/dts/bindings/usbc/tcpc/analogix,anx7447-tcpc.yaml
```yaml
description: Analogix ANX7447 USBC TCPC binding

compatible: "analogix,anx7447-tcpc"

include: ["i2c-device.yaml", "tcpc-device.yaml"]

properties:
  irq-gpios:
    type: phandle-array
    description: |
      Interrupt from TCPC
  rst-gpios:
    type: phandle-array
    description: |
      TCPC reset line
```

## zephyr/dts/bindings/usbc/tcpc/cros-ec,tcpci.yaml
```yaml
# Copyright 2023 The ChromiumOS Authors
# Use of this source code is governed by a BSD-style license that can be
# found in the LICENSE file.

description: |
  TCPCI compatible driver with no vendor extensions

compatible: "cros-ec,tcpci"

include: ["i2c-device.yaml", "tcpc-device.yaml"]
```

## zephyr/dts/bindings/usbc/tcpc/cypress,ccgxxf.yaml
```yaml
# Copyright 2022 The ChromiumOS Authors
# Use of this source code is governed by a BSD-style license that can be
# found in the LICENSE file.

description: USBC TCPC

compatible: "cypress,ccgxxf"

include: ["i2c-device.yaml", "tcpc-device.yaml"]

properties:
  irq-gpios:
    type: phandle-array
    description: |
      Interrupt from TCPC using shim driver
  rst-gpios:
    type: phandle-array
    description: |
      TCPC reset line while using shim driver
  int-pin:
    type: phandles
    deprecated: true
    description: |
      Interrupt from TCPC using gpio-int. This property should only be used when
      CONFIG_PLATFORM_EC_TCPC_INTERRUPT=n and should be removed when the chip
      uses the common TCPC driver.
```

## zephyr/dts/bindings/usbc/tcpc/fairchild,fusb302.yaml
```yaml
description: USBC TCPC

compatible: "fairchild,fusb302"

include: ["i2c-device.yaml", "tcpc-device.yaml"]

properties:
  irq-gpios:
    type: phandle-array
    description: |
      Interrupt from TCPC using shim driver
  rst-gpios:
    type: phandle-array
    description: |
      TCPC reset line while using shim driver
  int-pin:
    type: phandles
    deprecated: true
    description: |
      Interrupt from TCPC using gpio-int. This property should only be used when
      CONFIG_PLATFORM_EC_TCPC_INTERRUPT=n and should be removed when the chip
      uses the common TCPC driver.
```

## zephyr/dts/bindings/usbc/tcpc/nuvoton,nct38xx-tcpc.yaml
```yaml
# Copyright 2021 The ChromiumOS Authors
# Use of this source code is governed by a BSD-style license that can be
# found in the LICENSE file.

description: |
  Nuvoton NCT38XX USB TCPC binding

  This NCT38xx TCPC binding must be child-node under the "nuvoton,nct38xx"
  multi-function device node.

compatible: "nuvoton,nct38xx-tcpc"

include: ["tcpc-device.yaml"]

properties:
  gpio-dev:
    type: phandle
    description: |
      Pointer to the NCT38XX GPIO device. This is used to binding the Cros TCPC
      port index to Zephyr NCT38XX GPIO device.

  irq-gpios:
    type: phandle-array
    description: |
      Interrupt from TCPC using shim driver

  rst-gpios:
    type: phandle-array
    description: |
      TCPC reset line while using shim driver

  int-pin:
    type: phandles
    deprecated: true
    description: |
      Interrupt from TCPC using gpio-int. This property should only be used when
      CONFIG_PLATFORM_EC_TCPC_INTERRUPT=n and should be removed when the chip
      uses the common TCPC driver.
```

## zephyr/dts/bindings/usbc/tcpc/nuvoton,nct38xx.yaml
```yaml
# Copyright 2021 The ChromiumOS Authors
# Use of this source code is governed by a BSD-style license that can be
# found in the LICENSE file.

description: Nuvoton NCT38XX USB TCPC binding

compatible: "nuvoton,nct38xx"

include: ["i2c-device.yaml", "cros-ec,tcpci.yaml"]

properties:
  gpio-dev:
    type: phandle
    description: |
      Pointer to the NCT38XX GPIO device. This is used to binding the Cros TCPC
      port index to Zephyr NCT38XX GPIO device.

  tcpc-flags:
    type: int
    default: 0
    description: |
      TCPC configuration flags

  irq-gpios:
    type: phandle-array
    required: false
    description: |
      Interrupt from TCPC using shim driver

  rst-gpios:
    type: phandle-array
    required: false
    description: |
      TCPC reset line while using shim driver

  int-pin:
    type: phandles
    required: false
    deprecated: true
    description: |
      Interrupt from TCPC using gpio-int. This property should only be used when
      CONFIG_PLATFORM_EC_TCPC_INTERRUPT=n and should be removed when the chip
      uses the common TCPC driver.
```

## zephyr/dts/bindings/usbc/tcpc/parade,ps8xxx.yaml
```yaml
description: USBC TCPC

compatible: "parade,ps8xxx"

include: ["i2c-device.yaml", "tcpc-device.yaml"]

properties:
  irq-gpios:
    type: phandle-array
    description: |
      Interrupt from TCPC
  rst-gpios:
    type: phandle-array
    description: |
      TCPC reset line
```

## zephyr/dts/bindings/usbc/tcpc/renesas,raa489000.yaml
```yaml
# Copyright 2022 The ChromiumOS Authors
# Use of this source code is governed by a BSD-style license that can be
# found in the LICENSE file.

description: Renesas RAA489000 USB TCPC binding

compatible: "renesas,raa489000"

include: ["i2c-device.yaml", "tcpc-device.yaml"]

properties:
  irq-gpios:
    type: phandle-array
    description: |
      Interrupt from TCPC
  rst-gpios:
    type: phandle-array
    description: |
      TCPC reset line
```
