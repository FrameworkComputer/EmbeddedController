## zephyr/dts/bindings/usbc/tcpc/richtek,rt1715-tcpc.yaml
```yaml
# Copyright 2023 The ChromiumOS Authors
# Use of this source code is governed by a BSD-style license that can be
# found in the LICENSE file.

description: USBC RT1715 TCPC

compatible: "richtek,rt1715-tcpc"

include: ["i2c-device.yaml", "tcpc-device.yaml"]

properties:
  irq-gpios:
    type: phandle-array
    description: |
      Interrupt from TCPC
```

## zephyr/dts/bindings/usbc/tcpc/richtek,rt1718s-tcpc.yaml
```yaml
# Copyright 2022 The ChromiumOS Authors
# Use of this source code is governed by a BSD-style license that can be
# found in the LICENSE file.

description: USBC RT1718S TCPC

compatible: "richtek,rt1718s-tcpc"

include: ["i2c-device.yaml", "tcpc-device.yaml"]

properties:
  irq-gpios:
    type: phandle-array
    description: |
      Interrupt from TCPC
```

## zephyr/dts/bindings/usbc/tcpc/tcpc-device.yaml
```yaml
# Copyright 2022 The ChromiumOS Authors
# Use of this source code is governed by a BSD-style license that can be
# found in the LICENSE file.

description: |
  USBC TCPC

  Properties common to all TCPC drivers.

compatible: "tcpc-device"

include: base.yaml

properties:
  tcpc-flags:
    type: int
    default: 0
    description: |
      TCPC configuration flags
  is-alt:
    type: boolean
    description: |
      If present, this node refers to an alternate TCPC device. The TCPC device
      is not used by default, and must be manually enabled at runtime.
```

## zephyr/dts/bindings/usbc/ti,sn5s330.yaml
```yaml
description: USBC PPC

compatible: "ti,sn5s330"

include: ppc-chip.yaml

properties:
  i2c-addr-flags:
    default: "SN5S330_ADDR0_FLAGS"
    enum:
      - "SN5S330_ADDR0_FLAGS"
      - "SN5S330_ADDR1_FLAGS"
      - "SN5S330_ADDR2_FLAGS"
      - "SN5S330_ADDR3_FLAGS"
```

## zephyr/dts/bindings/usbc/usbc-port-policy.yaml
```yaml
# Copyright 2024 The ChromiumOS Authors
# Use of this source code is governed by a BSD-style license that can be
# found in the LICENSE file.

description: |
  The default policies of a USB-C port

  Example:
    TODO

compatible: "usbc-port-policy"

include: base.yaml

properties:
  unattached_rp_value:
    type: string
    # Must match enum typec_current_t
    enum:
      - "TC_CURRENT_PPM_DEFINED"
      - "TC_CURRENT_3_0A"
      - "TC_CURRENT_1_5A"
      - "TC_CURRENT_USB_DEFAULT"
    required: true
  unattached_cc_mode:
    type: string
    # Must match enum ccom_t
    enum:
      - "CCOM_RP"
      - "CCOM_RD"
      - "CCOM_DRP"
    required: true
  unattached_try:
    type: string
    # Must match enum drp_mode_t
    enum:
      - "DRP_NORMAL"
      - "DRP_TRY_SRC"
      - "DRP_TRY_SNK"
    required: true
```

## zephyr/dts/bindings/vendor-prefixes.txt
```
# Copyright 2021 The ChromiumOS Authors
# Use of this source code is governed by a BSD-style license that can be
# found in the LICENSE file.

# Valid device-tree compatible string prefixes used in this
# Zephyr module.  The format is:
#  vendor-prefix<TAB>vendor name
aec	Battery vendor
aoz	Alpha & Omega Semiconductor
atl	Battery vendor
bms-gf	Battery vendor
byd	Battery vendor
celxpert	Battery vendor
cosmx	Battery vendor
cros-ec	The Chromium OS Embedded Controller Project
cros	The Chromium OS Embedded Controller Project
dynapack	Battery vendor
fairchild	Fairchild Semiconductor
fpc	Fingerprint Cards AB
ganfeng	Battery vendor
getac	Battery vendor
gfl	Battery vendor
intersil	Intersil
kandou		Kandou
lgc	LG Chem
lges	Battery vendor
powertech	Battery vendor
pow-tech	Battery vendor
smp	Battery vendor
sunwoda	Battery vendor
sdi	Samsung SDI
```

## zephyr/emul/Kconfig
```kconfig
# Copyright 2021 The ChromiumOS Authors
# Use of this source code is governed by a BSD-style license that can be
# found in the LICENSE file.

rsource "retimer/Kconfig"
rsource "tcpc/Kconfig"

config EMUL_COMMON_I2C
	bool "Common handler for I2C emulator messages"
	help
	  Enable common code that is used by many emulators of devices on I2C
	  bus. It allows to share code for handling I2C messages, locking and
	  custom user handlers between these emulators.

config EMUL_SMART_BATTERY
	bool "Smart Battery emulator"
	default y
	depends on DT_HAS_ZEPHYR_SMART_BATTERY_EMUL_ENABLED
	select EMUL_COMMON_I2C
	help
	  Enable the Smart Battery emulator. This driver use emulated I2C bus.

config EMUL_BMA255
	bool "BMA255 emulator"
	default y
	depends on DT_HAS_ZEPHYR_BMA255_EMUL_ENABLED
	select EMUL_COMMON_I2C
	help
	  Enable the BMA255 emulator. This driver use emulated I2C bus.
	  It is used to test bma2x2 driver. Emulators API is available in
	  zephyr/include/emul/emul_bma255.h

config EMUL_BMA4XX
	bool "BMA4xx emulator"
	default y
	depends on DT_HAS_CROS_BMA4XX_EMUL_ENABLED
	select EMUL_COMMON_I2C
	help
	  Enable the BMA4xx emulator, used to test the bma4xx driver on an
	  emulated I2C bus; emulator API is in
	  zephyr/include/emul/emul_bma4xx.h.

config EMUL_BC12_DETECT_PI3USB9201
	bool "PI3USB9201 emulator"
	default y if ZTEST
	depends on DT_HAS_PERICOM_PI3USB9201_ENABLED
	help
	  Enable the PI3USB9201 emulator. PI3USB9201 is a BC1.2 charger
	  detector/advertiser. The emulator supports reading and writing the
	  4 I2C registers of the PI3USB9201 using the emulated I2C bus.

config EMUL_CHARGER_ISL9241
	bool "Renesas buck-boost battery charger emulator"
	default y
	depends on ZTEST && DT_HAS_INTERSIL_ISL9241_ENABLED
	select EMUL_COMMON_I2C
	help
	  Enable the ISL9241 emulator.  This chip is a configurable buck-boost
	  battery charger which can communicate over I2C, and utilizes the
	  emulated I2C bus.

config EMUL_PPC_NX20P348X
	bool "NXP PPC emulator"
	default y
	depends on ZTEST && DT_HAS_NXP_NX20P348X_ENABLED
	select EMUL_COMMON_I2C
	help
	  Enable the NX20P348X emulator, which covers both the NX20P3481 and
	  NX20P3483.  It is also register compatible with the SM5360A.  This
	  emulator makes use of the emulated I2C bus.

config EMUL_PPC_SYV682X
	bool "Silergy SYV682x PPC emulator"
	default y
	depends on DT_HAS_ZEPHYR_SYV682X_EMUL_ENABLED
	select PLATFORM_EC_USBC_PPC_SYV682X
	help
	  Enable the SYV682x emulator. SYV682 is a USB Type-C PPC. This driver
	  uses the emulated I2C bus.

config EMUL_BMI
	bool "BMI emulator"
	default y
	depends on DT_HAS_ZEPHYR_BMI_EMUL_ENABLED
	select EMUL_COMMON_I2C
	help
	  Enable the BMI emulator. This driver use emulated I2C bus.
	  It is used to test bmi 160 and 260 drivers. Emulators API is
	  available in zephyr/include/emul/emul_bmi.h

config EMUL_TCS3400
	bool "TCS3400 emulator"
	default y
	depends on DT_HAS_ZEPHYR_TCS3400_EMUL_ENABLED
	select EMUL_COMMON_I2C
	help
	  Enable the TCS3400 light sensor. This driver use emulated I2C bus.
	  It is used to test als_tcs3400 driver. It supports reading sensor
	  values which are correctly scaled using current gain and integration
	  time configuration, switching between IR and clear sensor and
	  clearing status register using clear interrupt registers. Other
	  TCS3400 registers support read and write with optional checking
	  of proper access to reserved bits. Emulators API is available in
	  zephyr/include/emul/emul_tcs3400.h

config EMUL_TUSB1064
	bool "TCS3400 emulator"
	default y
	depends on DT_HAS_ZEPHYR_TUSB1064_EMUL_ENABLED
	select EMUL_COMMON_I2C
	help
	  Enable the TUSB1064 usb mux. This driver use emulated I2C bus.
	  Emulator API is available in zephyr/include/emul/emul_tusb1064.h.

config EMUL_USB_MUX_AMD_FP6
	bool "AMD FP6 USB mux emulator"
	default y
	depends on ZTEST && DT_HAS_AMD_USBC_MUX_AMD_FP6_ENABLED
	select EMUL_COMMON_I2C
	help
	  Enable emulator for the AMD FP6 USB mux target.  This is a mux
	  which, while it resides on the SoC, presents itself to the EC as a
	  I2C target device

config EMUL_BB_RETIMER
	bool "BB retimer emulator"
	default y
	depends on ZTEST && DT_HAS_INTEL_JHL8040R_ENABLED
	select EMUL_COMMON_I2C
	help
	  Enable the BB (Burnside Bridge) retimer emulator. This driver use
	  emulated I2C bus. It is used to test bb_retimer driver. It supports
	  reads and writes to all emulator registers. Emulators API is
	  available in zephyr/include/emul/emul_bb_retimer.h

config EMUL_KB_RAW
	bool "Raw keyboard emulator"
	default y
	depends on DT_HAS_CROS_EC_KB_RAW_EMUL_ENABLED
	help
	  Enable the raw keyboard emulator.

config EMUL_CROS_FLASH
	bool "Emulated flash driver for the Zephyr shim"
	default y
	depends on DT_HAS_CROS_EC_FLASH_EMUL_ENABLED
	select PLATFORM_EC_FLASH_CROS
	imply SYSTEM_FAKE
	help
	  This option enables the flash emulator for testing.

config EMUL_FPC1025
	bool "FPC1025 fingerprint sensor emulator"
	depends on ZTEST && DT_HAS_FPC_FPC1025_ENABLED && ARCH_POSIX
	default y
	help
	  This option enables the FPC1025 fingerprint sensor emulator.
	  It supports only basic commands (get hardware id, enter low power
	  mode) that can be issued by the public driver (without FPC private
	  library)

config EMUL_SMBUS_ARA
	bool "SMBUS Alert Response Address emulator"
	default y
	depends on DT_HAS_ZEPHYR_SMBUS_ARA_EMUL_ENABLED && EMUL
	select EMUL_COMMON_I2C
	help
	  Enable the SMBUS ARA emulator. This driver use emulated I2C bus.

config EMUL_REALTEK_RTS54_PDC
	bool "Realtek RTS5453P Type-C Power Delivery Controller emulator"
	default y
	depends on DT_HAS_REALTEK_RTS54_PDC_ENABLED && EMUL
	select EMUL_COMMON_I2C
	help
	  Enable the Realtek RTS5453P emulator. This driver use emulated I2C bus.
	  Emulator API is available in zephyr/include/emul/emul_realtek_rts5453p.h

config EMUL_RTC
	bool "Emulated RTC driver for Zephyr shim"
	default y
	depends on DT_HAS_CROS_EC_RTC_EMUL_ENABLED
	help
	  This options enables the RTC emulator for testing.

config EMUL_KTU1125
	bool "KTU1125 PPC emulator"
	default y
	depends on DT_HAS_ZEPHYR_KTU1125_EMUL_ENABLED
	help
	  Enable the KTU1125 PPC emulator. This driver uses an emulated
	  I2C bus. This is a minimal emulator that does not provide
	  functional emulation but does support coverage testing of the
	  KTU1125 PPC driver.
	  Emulator API is available in zephyr/include/emul/emul_ktu1125.h.

config EMUL_RT1739
	bool "RT1739 PPC emulator"
	default y
	depends on DT_HAS_ZEPHYR_RT1739_EMUL_ENABLED
	help
	  Enable the RT1739 PPC emulator. This driver use emulated I2C bus.
	  Emulator API is available in zephyr/include/emul/emul_rt1739.h.

config EMUL_RT9490
	bool "Rt9490 charger emulator"
	default y
	depends on DT_HAS_ZEPHYR_RT9490_EMUL_ENABLED
	select EMUL_COMMON_I2C
	help
	  Enable the RT9490 light sensor emulator. This driver use emulated I2C
	  bus. Emulators API is available in zephyr/include/emul/emul_rt9490.h.

config PWM_MOCK
	bool "Mock implementation of an PWM device"
	default y
	depends on DT_HAS_CROS_PWM_MOCK_ENABLED
	help
	  Enable the PWM mock. This driver is a pure mock and does nothing by
	  default.

config TACH_MOCK
	bool "Mock implementation of a tachometer"
	default y
	depends on DT_HAS_CROS_TACH_MOCK_ENABLED
	help
	  Enable the tachometer mock.  This driver does nothing by default but
	  provides an interface to set the tachometer reading value as needed.

config VCMP_MOCK
	bool "Generic voltage comparator device mock implementation"
	default y
	depends on DT_HAS_CROS_VCMP_MOCK_ENABLED
	select ADC
	help
	  Enable the generic voltage comparator mock driver.

config EMUL_PCT2075
	bool "PCT2075 emulator"
	default y
	depends on ZTEST && DT_HAS_NXP_PCT2075_ENABLED
	select EMUL_COMMON_I2C
	help
	  Enable the PCT2075 temperature sensor emulator. It uses emulated I2C bus.
	  Emulator API is available in zephyr/include/emul/emul_pct2075.h.

config EMUL_ANX7452
	bool "ANX7452 retimer emulator"
	default y
	depends on ZTEST && DT_HAS_ANALOGIX_ANX7452_ENABLED
	select EMUL_COMMON_I2C
	help
	  Enable the ANX7452(Analogix) retimer emulator. This driver use
	  emulated I2C bus. It is used to test anx7452 driver. It supports
	  reads and writes to all emulator registers. Emulators API is
	  available in zephyr/include/emul/emul_anx7452.h

config EMUL_KB8010
	bool "KB8010 retimer emulator"
	default y
	depends on ZTEST && DT_HAS_KANDOU_KB8010_ENABLED
	select EMUL_COMMON_I2C
	help
	  Enable the Kandou kb8010 retimer emulator. This driver use
	  emulated I2C bus. It is used to test kb8010 driver. It
	  supports reads and writes to all emulator registers.
	  XXX The emulator's
	  XXX API is available in zephyr/include/emul/emul_kb8010.h

config EMUL_PS8743
	bool "PS8743 emulator"
	default y
	depends on DT_HAS_ZEPHYR_PS8743_EMUL_ENABLED
	select EMUL_COMMON_I2C
	help
	  Enable the PS8743 usb mux. This driver use emulated I2C bus.
	  Emulator API is available in zephyr/include/emul/emul_ps8743.h.

config EMUL_ICM42607
	bool "icm42607 emulator"
	default y
	depends on DT_HAS_ZEPHYR_ICM42607_EMUL_ENABLED
	select EMUL_COMMON_I2C
	help
	  Enable the ICM42607 accelerometer and gyroscope emulator.

config EMUL_LSM6DSO
  bool "lsm6dso emulator"
  default y
  depends on DT_HAS_CROS_LSM6DSO_EMUL_ENABLED
  help
    Enable the LSM6DSO accelerometer and gyroscope emulator.

rsource "Kconfig.ln9310"
rsource "Kconfig.lis2dw12"
rsource "Kconfig.i2c_mock"
rsource "Kconfig.gpio_controller_mock"
rsource "Kconfig.isl923x"
rsource "Kconfig.clock_control"
rsource "Kconfig.sm5803"
rsource "Kconfig.sn5s330"
```

## zephyr/emul/Kconfig.clock_control
```kconfig
# Copyright 2021 The ChromiumOS Authors
# Use of this source code is governed by a BSD-style license that can be
# found in the LICENSE file.

config EMUL_CLOCK_CONTROL
	bool "Emulated clock control"
	default y
	depends on DT_HAS_CROS_CLOCK_CONTROL_EMUL_ENABLED
	help
	  Enable the emulated clock control module. This module introduces a
	  functioning clock control implementation along with backdoor APIs to
	  verify and override behavior. Emulator API is available in
	  zephyr/include/emul/emul_clock_control.h

if EMUL_CLOCK_CONTROL

module = CLOCK_CONTROL_EMUL
module-str = clock_control_emul
source "subsys/logging/Kconfig.template.log_config"

endif # EMUL_CLOCK_CONTROL
```

## zephyr/emul/Kconfig.gpio_controller_mock
```kconfig
# Copyright 2023 The ChromiumOS Authors
# Use of this source code is governed by a BSD-style license that can be
# found in the LICENSE file.

config GPIO_CONTROLLER_MOCK
	bool "Mock implementation of a GPIO controller"
	default y
	depends on DT_HAS_CROS_GPIO_CONTROLLER_MOCK_ENABLED
	help
	  Enable the GPIO controller mock. This driver is a pure mock and
	  only forces device_is_ready() calls to fail.
```

## zephyr/emul/Kconfig.i2c_mock
```kconfig
# Copyright 2021 The ChromiumOS Authors
# Use of this source code is governed by a BSD-style license that can be
# found in the LICENSE file.

menuconfig I2C_MOCK
	bool "Mock implementation of an I2C device"
	default y
	depends on DT_HAS_CROS_I2C_MOCK_ENABLED
	depends on I2C_EMUL
	help
	  Enable the I2C mock. This driver is a pure mock and does nothing by
	  default. It is used to test common i2c code. Mock API is available in
	  zephyr/include/emul/i2c_mock.h

if I2C_MOCK

module = I2C_MOCK
module-str = i2c_mock
source "subsys/logging/Kconfig.template.log_config"

endif # I2C_MOCK
```

## zephyr/emul/Kconfig.isl923x
```kconfig
# Copyright 2021 The ChromiumOS Authors
# Use of this source code is governed by a BSD-style license that can be
# found in the LICENSE file.

menuconfig EMUL_ISL923X
	bool "ISL923X switchcap emulator"
	default y
	depends on DT_HAS_CROS_ISL923X_EMUL_ENABLED
	depends on I2C_EMUL
	help
	  Enable the ISL923X emulator. This driver uses the emulated I2C bus. It
	  is used to test the isl923x driver. Emulator API is available in
	  zephyr/include/emul/emul_isl923x.h

if EMUL_ISL923X

module = ISL923X_EMUL
module-str = isl923x_emul
source "subsys/logging/Kconfig.template.log_config"

endif # EMUL_ISL923X
```
