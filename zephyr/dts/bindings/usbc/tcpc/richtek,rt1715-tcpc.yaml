## zephyr/emul/Kconfig.lis2dw12
```kconfig
# Copyright 2021 The Chromium OS Authors. All rights reserved.
# Use of this source code is governed by a BSD-style license that can be
# found in the LICENSE file.

menuconfig EMUL_LIS2DW12
	bool "LIS2DW12 accelerometer emulator"
	default y
	depends on DT_HAS_CROS_LIS2DW12_EMUL_ENABLED
	depends on I2C_EMUL
	select PLATFORM_EC_ACCEL_LIS2DW12
	help
	  Enable the LIS2DW12 emulator. This driver uses the emulated I2C bus.
	  It is used to test the lis2dw12 driver. Emulator API is available in
	  zephyr/include/emul/emul_lis2dw12.h

if EMUL_LIS2DW12

module = LIS2DW12_EMUL
module-str = lis2dw12_emul
source "subsys/logging/Kconfig.template.log_config"

endif # EMUL_LIS2DW12
```

## zephyr/emul/Kconfig.ln9310
```kconfig
# Copyright 2021 The Chromium OS Authors. All rights reserved.
# Use of this source code is governed by a BSD-style license that can be
# found in the LICENSE file.

DT_COMPAT_LN9310_EMUL := cros,ln9310-emul

menuconfig EMUL_LN9310
	bool "LN9310 switchcap emulator"
	default $(dt_compat_enabled,$(DT_COMPAT_LN9310_EMUL))
	depends on I2C_EMUL
	help
	  Enable the LN9310 emulator. This driver uses the emulated I2C bus. It
	  is used to test the ln9310 driver. Emulator API is available in
	  zephyr/include/emul/emul_ln9310.h

if EMUL_LN9310

module = LN9310_EMUL
module-str = ln9310_emul
source "subsys/logging/Kconfig.template.log_config"

endif # EMUL_LN9310
```

## zephyr/emul/Kconfig.sm5803
```kconfig
# Copyright 2023 The ChromiumOS Authors
# Use of this source code is governed by a BSD-style license that can be
# found in the LICENSE file.

menuconfig EMUL_SM5803
	bool "SM5803 charger emulator"
	default y
	depends on DT_HAS_CROS_SM5803_EMUL_ENABLED
	depends on I2C_EMUL
	help
	  Enable the SM5803 emulator, used to test the sm5803 driver.
	  The emulator API is defined in zephyr/include/emul/emul_sm5803.h

if EMUL_SM5803
module = SM5803_EMUL
module-str = sm5803_emul
source "subsys/logging/Kconfig.template.log_config"
endif
```

## zephyr/emul/Kconfig.sn5s330
```kconfig
# Copyright 2021 The Chromium OS Authors. All rights reserved.
# Use of this source code is governed by a BSD-style license that can be
# found in the LICENSE file.

DT_COMPAT_SN5S330_EMUL := cros,sn5s330-emul

menuconfig EMUL_SN5S330
	bool "sn5s330 emulator"
	default $(dt_compat_enabled,$(DT_COMPAT_SN5S330_EMUL))
	depends on I2C_EMUL
	depends on ASSERT
	help
	  Enable the sn5s330 emulator. This driver uses the emulated I2C bus. It
	  is used to test the sn5s330 driver. Emulator API is available in
	  zephyr/include/emul/emul_sn5s330.h

if EMUL_SN5S330

module = SN5S330_EMUL
module-str = sn5s330_emul
source "subsys/logging/Kconfig.template.log_config"

endif # EMUL_SN5S330
```

## zephyr/emul/Kconfig.tcpci
```kconfig
# Copyright 2021 The Chromium OS Authors. All rights reserved.
# Use of this source code is governed by a BSD-style license that can be
# found in the LICENSE file.

DT_COMPAT_TCPCI_EMUL := cros,tcpci-emul

menuconfig EMUL_TCPCI
	bool "TCPCI emulator"
	default $(dt_compat_enabled,$(DT_COMPAT_TCPCI_EMUL))
	depends on I2C_EMUL
	help
	  Enable the TCPCI emulator. This driver uses the emulated I2C bus.
	  It is used to test tcpci code. It supports reads and writes to all
	  emulator registers. Generic TCPCI emulator can be used as the base
	  for specific TCPC device emulator that follow TCPCI specification.
	  TCPCI emulator API is available in zephyr/include/emul/emul_tcpci.h

if EMUL_TCPCI

module = TCPCI_EMUL
module-str = tcpci_emul
source "subsys/logging/Kconfig.template.log_config"

config EMUL_PS8XXX
	bool "Parade PS8XXX emulator"
	help
	  Enable emulator for PS8XXX family of TCPC. This emulator is extenstion
	  for TCPCI emulator. PS8XXX specific API is available in
	  zephyr/include/emul/emul_tcpci.h

endif # EMUL_TCPCI
```

## zephyr/emul/retimer/Kconfig
```kconfig
# Copyright 2023 The ChromiumOS Authors
# Use of this source code is governed by a BSD-style license that can be
# found in the LICENSE file.

config EMUL_ANX7483
	bool "ANX7483 Emulator"
	depends on DT_HAS_CROS_ANX7483_EMUL_ENABLED
	default y
	help
	  Enable emulator for ANX7483 retimer.

config EMUL_PS8811
	bool "Parade PS8811 Emulator"
	depends on DT_HAS_CROS_PS8811_EMUL_ENABLED
	default y
	help
	  Enable emulator for PS8811 retimer.

config RETIMER_EMUL_LOG_LEVEL
	int "Retimer emulator log level"
	default 3 # Log level info
```

## zephyr/emul/tcpc/Kconfig
```kconfig
# Copyright 2021 The ChromiumOS Authors
# Use of this source code is governed by a BSD-style license that can be
# found in the LICENSE file.

menuconfig EMUL_TCPCI
	bool "TCPCI common functionality"
	default y
	depends on DT_HAS_CROS_TCPCI_GENERIC_EMUL_ENABLED
	depends on I2C_EMUL
	select PLATFORM_EC_USB_PD_TCPM_TCPCI
	select EMUL_COMMON_I2C
	help
	  Enable the TCPCI emulator. This driver uses the emulated I2C bus.
	  It is used to test tcpci code. It supports reads and writes to all
	  emulator registers. Generic TCPCI emulator can be used as the base
	  for specific TCPC device emulator that follow TCPCI specification.
	  TCPCI emulator API is available in
	  zephyr/include/emul/tcpc/emul_tcpci.h

if EMUL_TCPCI

module = TCPCI_EMUL
module-str = tcpci_emul
source "subsys/logging/Kconfig.template.log_config"

config EMUL_ANX7447
	bool "Analogix ANX7447 emulator"
	default y
	depends on DT_HAS_CROS_ANX7447_TCPC_EMUL_ENABLED
	help
	  Enable emulator for ANX7447 of TCPM. This emulator is extension for
	  TCPCI emulator. ANX7447 specific API is available in
	  zephyr/include/emul/tpcp/emul_anx7447.h

config EMUL_TCPCI_PARTNER_COMMON
	bool
	help
	  This option is selected automatically by specific TCPCI partner
	  emulators. Enable common code that can be used by TCPCI partner device
	  emulators. It covers sending delayed messages. API of common functions
	  is available in zephyr/include/emul/tcpc/emul_common_tcpci_partner.h

config EMUL_NCT38XX
	bool "Nuvoton NCT38xx emulator"
	default y
	depends on DT_HAS_NUVOTON_NCT38XX_TCPC_ENABLED
	help
	  Enable emulator for NCT38XX family of TCPC. This emulator is extension
	  of the TCPCI emulator.

config EMUL_PS8XXX
	bool "Parade PS8XXX emulator"
	default y
	depends on DT_HAS_CROS_PS8XXX_EMUL_ENABLED
	help
	  Enable emulator for PS8XXX family of TCPC. This emulator is extenstion
	  for TCPCI emulator. PS8XXX specific API is available in
	  zephyr/include/emul/tcpc/emul_ps8xxx.h

config EMUL_RT1718S
	bool "Richtek rt1718s emulator"
	default y
	depends on DT_HAS_CROS_RT1718S_TCPC_EMUL_ENABLED
	help
	  Enable emulator for rt1718s of TCPM. This emulator is extension for
	  TCPCI emulator. rt1718s specific API is available in
	  zephyr/include/emul/tcpc/emul_rt1718s.h

config EMUL_TCPCI_PARTNER_SRC
	bool "USB-C source device emulator"
	select EMUL_TCPCI_PARTNER_COMMON
	help
	  Enable USB-C source device emulator which may be attached to TCPCI
	  emulator. API of source device emulator is available in
	  zephyr/include/emul/tcpc/emul_tcpci_partner_src.h

config EMUL_TCPCI_PARTNER_SNK
	bool "USB-C sink device emulator"
	select EMUL_TCPCI_PARTNER_COMMON
	help
	  Enable USB-C sink device emulator which may be attached to TCPCI
	  emulator. API of sink device emulator is available in
	  zephyr/include/emul/tcpc/emul_tcpci_partner_snk.h

config EMUL_TCPCI_PARTNER_DRP
	bool "USB-C dual role device emulator"
	select EMUL_TCPCI_PARTNER_COMMON
	select EMUL_TCPCI_PARTNER_SNK
	select EMUL_TCPCI_PARTNER_SRC
	help
	  Enable USB-C dual role device emulator which may be attached to TCPCI
	  emulator. API of dual role device emulator is available in
	  zephyr/include/emul/tcpc/emul_tcpci_partner_drp.h

config EMUL_TCPCI_PARTNER_FAULTY_EXT
	bool "USB-C malfunctioning device emulator"
	select EMUL_TCPCI_PARTNER_COMMON
	select EMUL_TCPCI_PARTNER_SNK
	help
	  Enable USB-C malfunctioning device emulator which may be attached
	  to TCPCI emulator. API of malfunctioning device emulator is
	  available in zephyr/include/emul/tcpc/emul_tcpci_partner_faulty_ext.h

config EMUL_TCPCI_PARTNER_VPD
	bool "USB-C VCONN-powered device emulator"
	select EMUL_TCPCI_PARTNER_COMMON
	# select EMUL_TCPCI_PARTNER_SRC
	help
	  Enable USB-C VCONN-powered device (VPD) emulator, which may be
	  attached to TCPCI emulator. API of VPD is available in
	  zephyr/include/emul/tcpc/emul_tcpci_partner_vpd.h. This emulation is
	  specifically for the host port side of the VPD.

endif # EMUL_TCPCI
```

## zephyr/fake/Kconfig
```kconfig
# Copyright 2022 The ChromiumOS Authors
# Use of this source code is governed by a BSD-style license that can be
# found in the LICENSE file.

config SYSTEM_FAKE
	bool "Use a fake system module"
	help
	  This provides a fake implementation of some of the hooks used by
	  common/system.c so that EC reboots can be faked.

	  It should only be included in tests.
```

## zephyr/libc/Kconfig
```kconfig
# Copyright 2025 The ChromiumOS Authors
# Use of this source code is governed by a BSD-style license that can be
# found in the LICENSE file.

config LIBC_EXIT
	bool "Use CrosEC implementation of the exit function"
	default y if NEWLIB_LIBC
	help
	  Override the default Zephyr exit function when using newlib so
	  that exit() terminates the currently running thread, which can
	  result in a system reboot. The default zephyr behavior respresents
	  an infinite / busy-wait loop.
```

## zephyr/mock/Kconfig
```kconfig
# Copyright 2022 The ChromiumOS Authors
# Use of this source code is governed by a BSD-style license that can be
# found in the LICENSE file.

config POWER_SEQUENCE_MOCK
	bool "Use a mocked power sequence driver."
	help
	  A simplified power sequence driver that invokes startup/shutdown
	  and suspend/resume hooks in appropriate state transitions. Any
	  request that comes in mid sequence is pended and ran after final
	  state is reached.

config AP_POWER_EVENTS_MOCK
	bool "Use a mocked ap power events driver."
	help
	  A simplified ap power events driver that provides it's functions fakes.

config POWER_SIGNALS_MOCK
	bool "Use a mocked power signals driver."
	help
	  A simplified power signals driver that provides it's functions fakes.

config ISL923X_MOCK
	bool "Use mocked ISL923X functions"
	help
	  Simple ISL923x function mocks
```

## zephyr/program/brya/Kconfig
```kconfig
# Copyright 2022 The ChromiumOS Authors
# Use of this source code is governed by a BSD-style license that can be
# found in the LICENSE file.

config BOARD_BRYA
	bool "Google Brya Baseboard"
	help
	  Build Google Brya reference board. The board uses the Nuvuton NPCX9
	  chip as the EC.

config BOARD_BRYA_PDC
	bool "Google Brya"
	help
	  Build Google Brya board with PD controller.

# Override the default USB-C stack choice baseed on the board type.
# This must be done before including Kconfig.zephyr below.
choice PLATFORM_EC_USBC_STACK
	default PLATFORM_EC_USB_PD_CONTROLLER if BOARD_BRYA_PDC
endchoice

source "Kconfig.zephyr"
```

## zephyr/program/ec-aic/Kconfig
```kconfig
# Copyright 2025 The ChromiumOS Authors
# Use of this source code is governed by a BSD-style license that can be
# found in the LICENSE file.

config BOARD_ITE_AIC
	bool "Google ITE AIC board"
	help
	  Build Google AIC image for the ITE chipset.

config BOARD_NPCX_AIC
	bool "Google NPCX AIC board"
	help
	  Build Google AIC image for the NPCX9 chipset.

module = EC_AIC
module-str = EC-AIC board-specific code
source "subsys/logging/Kconfig.template.log_config"

source "Kconfig.zephyr"
```

## zephyr/program/fpmcu/testcase.yaml
```yaml
# Copyright 2024 The ChromiumOS Authors
# Use of this source code is governed by a BSD-style license that can be
# found in the LICENSE file.

tests:
  abort:
    extra_configs:
    - CONFIG_HW_TEST_ABORT=y
    extra_conf_files:
    - prj_hw_tests.conf
  aes:
    extra_configs:
    - CONFIG_HW_TEST_AES=y
    - CONFIG_ZTEST_STACK_SIZE=3072
    extra_conf_files:
    - prj_hw_tests.conf
  benchmark:
    extra_configs:
    - CONFIG_HW_TEST_BENCHMARK=y
    extra_conf_files:
    - prj_hw_tests.conf
  boringssl_crypto:
    extra_configs:
    - CONFIG_HW_TEST_BORINGSSL_CRYPTO=y
    - CONFIG_ZTEST_STACK_SIZE=2048
    extra_conf_files:
    - prj_hw_tests.conf
  cortexm_fpu:
    extra_configs:
    - CONFIG_HW_TEST_CORTEXM_FPU=y
    extra_conf_files:
    - prj_hw_tests.conf
  crc:
    extra_configs:
    - CONFIG_HW_TEST_CRC=y
    extra_conf_files:
    - prj_hw_tests.conf
  exception:
    extra_configs:
    - CONFIG_HW_TEST_EXCEPTION=y
    extra_conf_files:
    - prj_hw_tests.conf
  flash_physical:
    extra_configs:
    - CONFIG_HW_TEST_FLASH_PHYSICAL=y
    extra_conf_files:
    - prj_hw_tests.conf
  flash_write_protect:
    extra_configs:
    - CONFIG_HW_TEST_FLASH_WRITE_PROTECT=y
    # Added to reduce RO flash usage
    - CONFIG_PM=n
    extra_conf_files:
    - prj_hw_tests.conf
  fp_transport:
    extra_configs:
    - CONFIG_HW_TEST_FP_TRANSPORT=y
    # Added to reduce RO flash usage
    - CONFIG_PM=n
    extra_conf_files:
    - prj_hw_tests.conf
  fpsensor_auth_crypto_stateful:
    extra_configs:
    - CONFIG_HW_TEST_FPSENSOR_AUTH_CRYPTO_STATEFUL=y
    - CONFIG_ZTEST_STACK_SIZE=2048
    extra_conf_files:
    - prj_hw_tests.conf
  ftrapv:
    extra_configs:
    - CONFIG_HW_TEST_FTRAPV=y
    extra_conf_files:
    - prj_hw_tests.conf
  libc_printf:
    extra_configs:
    - CONFIG_HW_TEST_LIBC_PRINTF=y
    extra_conf_files:
    - prj_hw_tests.conf
  malloc:
    extra_configs:
    - CONFIG_HW_TEST_MALLOC=y
    # Added to reduce RO flash usage
    - CONFIG_PM=n
    extra_conf_files:
    - prj_hw_tests.conf
  panic:
    extra_configs:
    - CONFIG_HW_TEST_PANIC=y
    - CONFIG_PLATFORM_EC_PANIC_STRIP_GPR=n
    extra_conf_files:
    - prj_hw_tests.conf
  printf:
    extra_configs:
    - CONFIG_HW_TEST_PRINTF=y
    - CONFIG_ZTEST_STACK_SIZE=2048
    extra_conf_files:
    - prj_hw_tests.conf
  queue:
    extra_configs:
    - CONFIG_HW_TEST_QUEUE=y
    extra_conf_files:
    - prj_hw_tests.conf
  restricted_console:
    extra_configs:
    - CONFIG_HW_TEST_RESTRICTED_CONSOLE=y
    extra_conf_files:
    - prj_hw_tests.conf
  rollback:
    extra_configs:
    - CONFIG_HW_TEST_ROLLBACK=y
    extra_conf_files:
    - prj_hw_tests.conf
  rollback_entropy:
    extra_configs:
    - CONFIG_HW_TEST_ROLLBACK_ENTROPY=y
    # Added to reduce RO flash usage
    - CONFIG_PM=n
    extra_conf_files:
    - prj_hw_tests.conf
  sha256:
    extra_configs:
    - CONFIG_HW_TEST_SHA256=y
    extra_conf_files:
    - prj_hw_tests.conf
  sha256_unrolled:
    extra_configs:
    - CONFIG_HW_TEST_SHA256_UNROLLED=y
    extra_conf_files:
    - prj_hw_tests.conf
  static_if:
    extra_configs:
    - CONFIG_HW_TEST_STATIC_IF=y
  system_is_locked:
    extra_configs:
    - CONFIG_HW_TEST_SYSTEM_IS_LOCKED=y
    extra_conf_files:
    - prj_hw_tests.conf
  utils:
    extra_configs:
    - CONFIG_HW_TEST_UTILS=y
    extra_conf_files:
    - prj_hw_tests.conf
  utils_str:
    extra_configs:
    - CONFIG_HW_TEST_UTILS_STR=y
    extra_conf_files:
    - prj_hw_tests.conf
  stdlib:
    extra_configs:
    - CONFIG_HW_TEST_STDLIB=y
    extra_conf_files:
    - prj_hw_tests.conf
```

## zephyr/program/geralt/Kconfig
```kconfig
# Copyright 2022 The ChromiumOS Authors
# Use of this source code is governed by a BSD-style license that can be
# found in the LICENSE file.

choice GERALT_VARIANT
	prompt "Pick a variant of Geralt"
	help
	  Geralt is the reference device that has MediaTek MT8188G SoC with
	  ITE it81202-cx EC.
	  Pick one of the variants below.

config BOARD_GERALT
	bool "Google Geralt Reference Board"
	help
	  Build the Geralt reference board. The board is the reference design
	  of Geralt family.

config BOARD_CIRI
	bool "Google Geralt Variant Board"
	help
	  Build the Ciri variant board. The board follows reference design
	  of Geralt family.

endchoice

source "Kconfig.zephyr"
```
