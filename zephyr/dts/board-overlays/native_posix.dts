/* Copyright 2021 The ChromiumOS Authors
 * Use of this source code is governed by a BSD-style license that can be
 * found in the LICENSE file.
 */

#include <dt-bindings/gpio_defines.h>
#include <dt-bindings/native-posix-gpio.h>

#define GPIO_VOLTAGE_1P8 NATIVE_POSIX_GPIO_VOLTAGE_1P8

/ {
	named-gpios {
		compatible = "named-gpios";

		entering-rw {
			gpios = <&gpio0 1 GPIO_OUTPUT_LOW>;
			enum-name = "GPIO_ENTERING_RW";
		};
	};
};

&gpio0 {
	ngpios = <2>;
};
