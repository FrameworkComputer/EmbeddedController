/* Copyright 2024 The ChromiumOS Authors
 * Use of this source code is governed by a BSD-style license that can be
 * found in the LICENSE file.
 */

/ {
	usbc {
		/* The default policy of USB-C ports in CrOS devices. */
		cros_policy: usbc-policy {
			compatible = "usbc-port-policy";
			unattached_rp_value = "TC_CURRENT_1_5A";
			unattached_cc_mode = "CCOM_RD";
			unattached_try = "DRP_TRY_SRC";
		};
	};
};
