/* Copyright 2023 The ChromiumOS Authors
 * Use of this source code is governed by a BSD-style license that can be
 * found in the LICENSE file.
 */

&binman {
	wp-ro {
		cbi_flash: cbi {
			compatible = "cros-ec,flash-layout";
			type = "fill";
			offset = <0x40000>;
			size = <0>;
			fill-byte = [ff];
			image-size = <256>;
			preserve;
		};
	};
};
