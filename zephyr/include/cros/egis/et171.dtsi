/* Copyright 2025 The ChromiumOS Authors.
 * Use of this source code is governed by a BSD-style license that can be
 * found in the LICENSE file.
 */

#include <cros/binman.dtsi>

/ {
	chosen {
		cros-ec,flash-controller = &flash_controller;
		cros-ec,sha = &crypto;
	};
	soc {
		flash_controller: cros-ec-flash {
			compatible = "andestech,qspi-nor-xip-cros-flash";
		};
	};
};
