/* Copyright 2026 The ChromiumOS Authors.
 * Use of this source code is governed by a BSD-style license that can be
 * found in the LICENSE file.
 */

#include <cros/binman.dtsi>

/ {
	chosen {
		cros-ec,flash = &flash0;
		cros-ec,flash-controller = &flash_controller;
	};
	soc {
		flash_controller: cros-ec-flash {
			compatible = "ft,ft9001-cros-flash";
		};
	};
};
