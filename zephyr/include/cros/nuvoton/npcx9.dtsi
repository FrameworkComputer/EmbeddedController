/*
 * Copyright 2021 The ChromiumOS Authors
 *
 * SPDX-License-Identifier: Apache-2.0
 */

#include <nuvoton/npcx/npcx9.dtsi>
#include <cros/nuvoton/npcx.dtsi>

/ {
	chosen {
		cros-ec,sha = &sha0;
	};

	soc {

	};
};
