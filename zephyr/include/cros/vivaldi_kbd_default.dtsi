/* Copyright 2024 The ChromiumOS Authors
 * Use of this source code is governed by a BSD-style license that can be
 * found in the LICENSE file.
 */

#include <dt-bindings/vivaldi_kbd.h>

/ {
	vivaldi_kbd: vivaldi-kbd {
		status = "disabled";
		compatible = "cros-ec,vivaldi-kbd";
		vivaldi-keys = <
			KBD_RC(0, 2)   /* T1 */
			KBD_RC(3, 2)   /* T2 */
			KBD_RC(2, 2)   /* T3 */
			KBD_RC(1, 2)   /* T4 */
			KBD_RC(3, 4)   /* T5 */
			KBD_RC(2, 4)   /* T6 */
			KBD_RC(1, 4)   /* T7 */
			KBD_RC(2, 9)   /* T8 */
			KBD_RC(1, 9)   /* T9 */
			KBD_RC(0, 4)   /* T10 */
			KBD_RC(0, 1)   /* T11 */
			KBD_RC(1, 5)   /* T12 */
			KBD_RC(3, 5)   /* T13 */
			KBD_RC(0, 9)   /* T14 */
			KBD_RC(0, 11)  /* T15 */
		>;

		kbd_config_0: kbd-config-0 {
			vivaldi-codes = <
				VIVALDI_TK_BACK              /* T1 */
				VIVALDI_TK_FORWARD	     /* T2 */
				VIVALDI_TK_REFRESH	     /* T3 */
				VIVALDI_TK_FULLSCREEN	     /* T4 */
				VIVALDI_TK_OVERVIEW	     /* T5 */
				VIVALDI_TK_BRIGHTNESS_DOWN   /* T6 */
				VIVALDI_TK_BRIGHTNESS_UP     /* T7 */
				VIVALDI_TK_VOL_MUTE	     /* T8 */
				VIVALDI_TK_VOL_DOWN	     /* T9 */
				VIVALDI_TK_VOL_UP	     /* T10 */
			>;
			capabilities = <VIVALDI_KEYBD_CAP_SCRNLOCK_KEY>;
		};
	};
};
