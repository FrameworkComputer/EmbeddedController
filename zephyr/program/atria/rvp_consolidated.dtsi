/* Copyright 2026 The Chromium Authors
 * Use of this source code is governed by a BSD-style
 * license that can be found in the LICENSE file.
 */

 /* Consolidated RVP dtsi file for all RVP variants.
  * This file is included by the individual RVP overlay files.
  */

#include "rvp_battery.dtsi"
#include "rvp_i2c.dtsi"
#include "rvp_ioex_gpio.dtsi"
#include "rvp_pd.dtsi"
#include "rvp_usbc.dtsi"
#include "rvp_runtime_pdc.dtsi"
