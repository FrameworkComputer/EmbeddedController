/* Copyright 2025 The ChromiumOS Authors
 * Use of this source code is governed by a BSD-style license that can be
 * found in the LICENSE file.
 */

/* bluey program common DTS includes */

#include <cros/integrated_fwid.dtsi>

#include "../interrupts.dtsi"
#include "../adc.dtsi"
#include "../i2c.dtsi"
#include "../common.dtsi"
#include "../battery.dtsi"
#include "../psl.dtsi"

/* bluey project DTS includes */

#include "gpios.dtsi"
#include "fan.dtsi"
#include "temp_sensors.dtsi"

/* bluey overrides follow... */

/ {
	named-usbc-port {
		usbc_port0: port0 {
			compatible = "named-usbc-port";
		};
		usbc_port1: port1 {
			compatible = "named-usbc-port";
		};
	};
};

