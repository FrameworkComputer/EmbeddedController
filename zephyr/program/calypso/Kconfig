## zephyr/program/calypso/Kconfig
```kconfig
# Copyright 2026 The ChromiumOS Authors
# Use of this source code is governed by a BSD-style license that can be
# found in the LICENSE file.

config BOARD_MENSA
	bool "Google Mensa baseboard"
	help
	  Build Google Mensa reference board.  The board uses Nuvoton
	  NPCX9 chip as the EC.

config BOARD_C1NV
	bool "Google C1nv baseboard"
	help
	  Build Google C1nv reference board.  The board uses Nuvoton
	  NPCX9 chip as the EC.

module = Mensa
module-str = Mensa board-specific code
source "subsys/logging/Kconfig.template.log_config"

source "Kconfig.zephyr"
```

## zephyr/program/fatcat/Kconfig
```kconfig
# Copyright 2024 The ChromiumOS Authors
# Use of this source code is governed by a BSD-style license that can be
# found in the LICENSE file.

config BOARD_FATCATRVP_NPCX
	bool "Google Fatcat Nuvoton (npcx9m7f) add-in card for the RVP"
	help
	  Build Google Nuvoton npcx9m7f based Fatcat add-in card.
	  This board is for use with the Intel RVP using the
	  MECC 2.1 connector.

config BOARD_FATCATRVP_ITE
	bool "Google Fatcat ITE (it82002) add-in card for the RVP"
	help
	  Build Google ITE it82002 based Fatcat add-in card.
	  This board is for use with the Intel RVP using the
	  MECC 2.1 connector.

config BOARD_FRANCKA
	bool "Google francka"
	help
	  Build Google Francka board. Francka has Intel PTL SoC
	  with NPCX993FA0BX EC.

config BOARD_FELINO
	bool "Google felino"
	help
	  Build Google Felino board. Felino has Intel PTL SoC
	  with it82002aw EC.

config BOARD_FELINO4ES
	bool "Google felino for ES1"
	help
	  Build Google Felino board for ES1. Felino4es has Intel PTL SoC
	  with it82002aw EC.

config BOARD_KINMEN
	bool "Google kinmen"
	help
	  Build Google Kinmen board. Kinmen has Intel PTL SoC
	  with it82002aw EC.

config BOARD_LAPIS
	bool "Google lapis"
	help
	  Build Google Lapis board. Lapis has Intel PTL SoC
	  with rts5915 EC.

config BOARD_MOONSTONE
	bool "Google moonstone"
	help
	  Build Google Moonstone board. Moonstone has Intel PTL SoC
	  with it82002aw EC.

config BOARD_RUBY
	bool "Google ruby"
	help
	  Build Google Ruby board. Ruby has Intel PTL SoC
	  with NPCX997FB0BX EC.

config BOARD_MOONSTONE_ISH
	bool "Google moonstone ISH"
	help
	  Build Google Moonstone ISH firmware.

config BOARD_KINMEN_ISH
	bool "Google kinmen ISH"
	help
	  Build Google Kinmen ISH firmware.

config BOARD_RUBY_ISH
	bool "Google ruby ISH"
	help
	  Build Google Ruby ISH firmware.

config BOARD_FATCAT_ISH_IDLE
	bool "Google fatcat-ish-idle"
	help
	  Build Google fatcat-ish-idle firmware.

module = Fatcat
module-str = Fatcat board-specific code
source "subsys/logging/Kconfig.template.log_config"

source "Kconfig.zephyr"
```

## zephyr/program/framework/Kconfig
```kconfig
# Copyright 2021 The ChromiumOS Authors
# Use of this source code is governed by a BSD-style license that can be
# found in the LICENSE file.

config BOARD_LOTUS
	bool "Framework Lotus Board"
	help
	  Build Framework Lotus reference board. Lotus has AMD SoC
	  with NPCX993FA0BX EC.

config BOARD_AZALEA
	bool "Framework Azalea Board"
	help
	  Build Framework Azalea reference board. Azalea has AMD SoC
	  with NPCX993FA0BX EC.

choice PLATFORM_EC_FRAMEWORK_FAMILY
	prompt "Select the family design in the makefile"

config PLATFORM_EC_FRAMEWORK_LAPTOP_13
	bool "Framework Laptop 13-inch family"
	help
	  Framework Laptop 13-inch family

config PLATFORM_EC_FRAMEWORK_LAPTOP_16
	bool "Framework Laptop 16-inch family"
	help
	  Framework Laptop 16-inch family support gpu and fully customizable input design.

endchoice

module = FRAMEWORK
module-str = Framework board-specific code
source "subsys/logging/Kconfig.template.log_config"

source "Kconfig.zephyr"
```

## zephyr/program/ocelot/Kconfig
```kconfig
# Copyright 2025 The ChromiumOS Authors
# Use of this source code is governed by a BSD-style license that can be
# found in the LICENSE file.

config BOARD_OCELOTRVP_ITE
	bool "Google Ocelot ITE (it82002) add-in card for the RVP"
	help
	  Build Google ITE it82002 based Ocelot add-in card.
	  This board is for use with the Intel RVP using the
	  MECC 2.1 connector.

config BOARD_OCELOTRVP_NPCX
	bool "Google Ocelot Nuvoton (npcx9m7f) add-in card for the RVP"
	help
	  Build Google Nuvoton npcx9m7f based Ocelot add-in card.
	  This board is for use with the Intel RVP using the
	  MECC 2.1 connector.

config BOARD_OCELOTRVP_MCHP
	bool "Google Ocelot with microchip (mec1727) EC for the RVP"
	help
	  Build Microchip EC based Ocelot RVP.
	  This board is for use with the Intel RVP using the
	  on board EC.

config BOARD_OCELOTRVP_RTK
	bool "Google Ocelot Realtek (rtk5915) add-in card for the RVP"
	help
	  Build Realtek rtk5915 based Ocelot add-in card.
	  This board is for use with the Intel RVP using the
	  MECC 2.1 connector.

config BOARD_OJAL
	bool "Google Ocelot with Realtek (rtk5915) EC"
	help
	  Build Google Ojal reference board.
	  This board uses an Intel WCL SoC and RTK EC.

config BOARD_MATSU
	bool "Google Ocelot with ITE (it82002) EC"
	help
	  Build Google Matsu reference board.
	  This board uses an Intel WCL SoC and ITE EC.

config BOARD_KODKOD
	bool "Google Ocelot with Realtek (rtk5915) EC"
	help
	  Build Google Kodkod reference board.
	  This board uses an Intel WCL SoC and RTK EC.

config BOARD_OCICAT
	bool "Google Ocelot with ITE (it82002) EC"
	help
	  Build Google Matsu reference board.
	  This board uses an Intel WCL SoC and ITE EC.

module = Oceolot
module-str = Ocelot board-specific code
source "subsys/logging/Kconfig.template.log_config"

source "Kconfig.zephyr"
```

## zephyr/program/skywalker/Kconfig
```kconfig
# Copyright 2025 The ChromiumOS Authors
# Use of this source code is governed by a BSD-style license that can be
# found in the LICENSE file.

config BOARD_SKYWALKER
	bool "Google Skywalker Board"
	help
	  Build Google Skywalker board. Skywalker has MediaTek SoC
	  with Nuvoton NPCX997FB EC.

config BOARD_LUUKE
	bool "Google Luuke Board"
	help
	  Build Google Luuke board. Skywalker has MediaTek SoC
	  with ITE IT82002 EC.

config BOARD_OBIWAN
	bool "Google Obiwan Board"
	help
	  Build Google Obiwan board. Obiwan has MediaTek SoC
	  with Nuvoton NPCX997FB EC.

config BOARD_YODA
	bool "Google Yoda Board"
	help
	  Build Google Yoda board. Yoda has MediaTek SoC
	  with Nuvoton NPCX997FB EC.

config BOARD_ANAKIN
	bool "Google Anakin Board"
	help
	  Build Google Anakin board. Anakin has MediaTek SoC
	  with ITE IT82002 EC.

config BOARD_BAZE
	bool "Google Baze Board"
	help
	  Build Google Baze board. Skywalker has MediaTek SoC
	  with ITE IT82002 EC.

config BOARD_TARKIN
	bool "Google Tarkin Board"
	help
	  Build Google Tarkin board. Tarkin has MediaTek SoC
	  with ITE IT82002 EC.

config BOARD_PADME
	bool "Google Padme Board"
	help
	  Build Google Padme board. Padme has MediaTek SoC
	  with ITE IT82002 EC.

config BOARD_GROGU
	bool "Google Grogu Board"
	help
	  Build Google Grogu board. Grogu has MediaTek SoC
	  with ITE IT82002 EC.

config BOARD_DOOKU
	bool "Google Dooku Board"
	help
	  Build Google Dooku board. Dooku has MediaTek SoC
	  with ITE IT82002 EC.

config BOARD_VADER
	bool "Google Vader Board"
	help
	  Build Google Vader board. Vader has MediaTek SoC
	  with Nuvoton NPCX997FB EC.

config BOARD_JAINA
	bool "Google Jaina Board"
	help
	  Build Google Jaina board. Jaina has MediaTek SoC
	  with ITE IT82002 EC.
config BOARD_R2D2
	bool "Google R2D2 Board"
	help
	  Build Google R2D2 board. R2D2 has MediaTek SoC
	  with Nuvoton NPCX997FB EC.

config BOARD_SHEEV
	bool "Google Sheev Board"
	help
	  Build Google Sheev board. Sheev has MediaTek SoC
	  with ITE IT82002 EC.

config BOARD_SKYWALKER_SINGLE_USB_TYPEC
	bool "Boards have only one USB-C port"
	default n
	help
	Enable board code for managing DP alt mode on
	the board which has a single USB-C port.

config BOARD_SKYWALKER_PMIC_RESETB_IRQ
	bool "Forward PMIC_RESETB to EC_PWR_S3"
	depends on $(dt_nodelabel_exists,gpio_en_pwr_s3)
	default y
	help
	  Enable this to support the latest hardware design,
	  which requires EC to forward PMIC_RESETB signal to EC_PWR_S3.

module = SKYWALKER
module-str = Skywalker board-specific code
source "subsys/logging/Kconfig.template.log_config"

source "Kconfig.zephyr"
```

## zephyr/program/tanjiro/Kconfig
```kconfig
# Copyright 2025 The ChromiumOS Authors
# Use of this source code is governed by a BSD-style license that can be
# found in the LICENSE file.

config BOARD_TANJIRO
	bool "Google Tanjiro Board"
	help
	  Build Google Rauru reference board. Tanjiro has MediaTek SoC
	  with ITE it82202-bw EC.

config BOARD_SAPPHIRE
        bool "Google Sapphire Board"
        help
          Build Google Sapphire board. This board has MediaTek SoC
          with ITE it82202-ax EC.

module = TANJIRO
module-str = Tanjiro board-specific code
source "subsys/logging/Kconfig.template.log_config"

source "Kconfig.zephyr"
```

## zephyr/shim/chip/egis/Kconfig.egis
```kconfig
# Copyright 2025 The ChromiumOS Authors
# Use of this source code is governed by a BSD-style license that can be
# found in the LICENSE file.

if PLATFORM_EC

config PLATFORM_EC_ET171_ENTER_BOOTLOADER
	bool "Add procedure to enter bootloader for ET171"
	default y if PLATFORM_EC_HOST_COMMAND_ENTER_BOOTLOADER
	depends on SOC_EGIS_ET171
	help
	  Add implementation of chip_enter_bootloader for the ET171 chip
	  needed for the EC_CMD_ENTER_BOOTLOADER host command.

config EGIS_ET171_OTP_KEY
	bool "Enable EGIS ET171 OTP Key functionality"
	depends on HAS_EGIS_ET171_HAL && BORINGSSL_CRYPTO
	help
	  Enable support for reading and validating the One-Time Programmable
	  (OTP) key on EGIS ET171 series chips.

endif # PLATFORM_EC
```

## zephyr/shim/chip/ft90/Kconfig.ft90
```kconfig
# Copyright 2026 The ChromiumOS Authors
# Use of this source code is governed by a BSD-style license that can be
# found in the LICENSE file.

if PLATFORM_EC

config PLATFORM_EC_FT90_ENTER_BOOTLOADER
	bool "Add procedure to enter bootloader for FT90 series"
	default y if PLATFORM_EC_HOST_COMMAND_ENTER_BOOTLOADER
	depends on SOC_SERIES_FT90
	help
	  Add implementation of chip_enter_bootloader for the Focaltech FT90
	  chip series needed for the EC_CMD_ENTER_BOOTLOADER host command.

config FOCALTECH_OTP_KEY
	bool "Enable Focaltech OTP Key functionality"
	depends on BORINGSSL_CRYPTO
	select OTP
	select OTP_PROGRAM
	help
	  Enable support for reading and provisioning the OTP KEY for
	  Focaltech SOCs.

endif # PLATFORM_EC
```

## zephyr/shim/chip/mchp/Kconfig.xec
```kconfig
# Copyright 2022 The ChromiumOS Authors
# Use of this source code is governed by a BSD-style license that can be
# found in the LICENSE file.

if PLATFORM_EC

config CROS_SYSTEM_XEC_PRE_INIT_PRIORITY
	int "System pre-initialization priority"
	default 15
	range 10 19
	depends on SOC_FAMILY_MICROCHIP_MEC
	help
	  This sets the priority of the MCHP XEC chip system initialization.
	  The chip system initialization verifies the integrity of the BBRAM
	  must be a lower priority than CONFIG_BBRAM_INIT_PRIORITY and
	  must be a higher priority than PLATFORM_EC_SYSTEM_PRE_INIT.

config CROS_SYSTEM_XEC_QSPI_LINES
	int "QSPI data lines"
	default 2
	depends on SOC_FAMILY_MICROCHIP_MEC
	help
	  TODO: b/486864443 - this property used to be configured via
	  devicetree, but an upstream change eliminated the QSPI property.

	  This option hard codes the number of QSPI data lines. 1 data line
	  is full-duplex MOSI/MISO on the MOSI signal.  2 or 4 data lines
	  set dual or quad I/O modes.

endif # PLATFORM_EC
```

## zephyr/subsys/adsp_comms/Kconfig
```kconfig
# Copyright 2026 The ChromiumOS Authors
# Use of this source code is governed by a BSD-style license that can be
# found in the LICENSE file.

config PLATFORM_EC_ADSP_CHARGE_MANAGER
	bool "ADSP charge manager support"
	select PLATFORM_EC_BATTERY_STATUS_CUSTOM
	help
	  Enable ADSP charge manager support, including I2C port switching
	  between controller and target modes on chipset state transitions.
	  Note: This charge manager functionality is achieved via ADSP
	  communications.

if PLATFORM_EC_ADSP_CHARGE_MANAGER

config ADSP_COMMS_STACK_SIZE
	int "ADSP comms task stack size"
	default 1024
	help
	  The stack size for the ADSP communications task.

config ADSP_COMMS_PRIORITY
	int "ADSP comms task priority"
	default 5
	help
	  The priority for the ADSP communications task.

config ADSP_COMMS_MSGQ_SIZE
	int "ADSP comms message queue size"
	default 16
	help
	  The number of messages that can be stored in the ADSP communications
	  message queue.

endif # PLATFORM_EC_ADSP_CHARGE_MANAGER
```

## zephyr/subsys/ascp/Kconfig
```kconfig
# Copyright 2026 The ChromiumOS Authors
# Use of this source code is governed by a BSD-style license that can be
# found in the LICENSE file.

config ASCP
	bool "Enable ASCP support"
	help
	  Enables support for ASCP (Authentication Service Control Protocol).

config ASCP_MEM_MAP
	bool "Enable ASCP memory mapped platform"
	help
	  Enables support for ASCP HW platforms where ASCP data is available in memory.
	default y
	depends on DT_HAS_CROS_EC_ASCP_MEM_MAP_ENABLED
	select ASCP

config ASCP_REPLACE_S_GOOG
	bool "Replace s_goog if it matches a certain value"
	depends on ASCP_MEM_MAP
	default y if ASCP_S_GOOG_MATCH_FILE != "" && ASCP_S_GOOG_REPLACE_FILE != ""
	help
	  Enable this option to replace s_goog in the claim response if it
	  matches a predefined value. The values are provided via binary files.

config ASCP_S_GOOG_MATCH_FILE
	string "Path to the binary file containing the s_goog value to match"
	depends on ASCP_MEM_MAP
	help
	  Path to a 64-byte binary file containing the s_goog value to match.

config ASCP_S_GOOG_REPLACE_FILE
	string "Path to the binary file containing the s_goog value to replace with"
	depends on ASCP_MEM_MAP
	help
	  Path to a 64-byte binary file containing the value to replace s_goog with.
```
