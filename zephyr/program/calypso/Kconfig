## zephyr/subsys/fingerprint/alg/Kconfig
```kconfig
# Copyright 2023 The ChromiumOS Authors
# Use of this source code is governed by a BSD-style license that can be
# found in the LICENSE file.

config FP_FPC_BEP_ALGORITHM
	bool "FPC BEP matching algorithm"
	default y if FINGERPRINT_SENSOR_FPC1025
	help
	  Enable FPC BEP matching algorithm. To work properly, FPC private
	  library is required.

config FP_ELAN_ELAN80SERIES_ALGORITHM
	  bool
	  help
	    Enable ELAN ELAN80SERIES matching algorithm. To work properly, ELAN
		private library is required.

config FP_ELAN_ELAN80SG_ALGORITHM
      bool "ELAN ELAN80SG matching algorithm"
      default y if FINGERPRINT_SENSOR_ELAN80SG
      select FP_ELAN_ELAN80SERIES_ALGORITHM
      help
        Enable ELAN ELAN80SG matching algorithm. To work properly, ELAN
        private library is required.

config FP_ELAN_ELANI80SA_ALGORITHM
      bool "ELAN ELANI80SA matching algorithm"
      default y if FINGERPRINT_SENSOR_ELANI80SA
      select FP_ELAN_ELAN80SERIES_ALGORITHM
      help
        Enable ELAN ELANI80SA matching algorithm. To work properly, ELAN
        private library is required.

config FP_FPC_LIBFP_ALGORITHM
	bool "FPC LIBFP matching algorithm"
	default y if FINGERPRINT_SENSOR_FPC1145
	help
	  Enable FPC LIBFP matching algorithm. To work properly, FPC private
	  library is required.

config FP_EGIS_EGIS630_ALGORITHM
	bool "EGIS EGIS630 matching algorithm"
	default y if FINGERPRINT_SENSOR_EGIS630
	help
	  Enable EGIS EGIS630 matching algorithm. To work properly, EGIS private
	  library is required.

config FP_EGIS_EGIS660_ALGORITHM
	bool "EGIS_EGIS660 matching algorithm"
	default y if FINGERPRINT_SENSOR_EGIS660
	help
	  Enable EGIS EGIS660 matching algorithm. To work properly, EGIS private
	  library is required.

config FP_FT98XX_ALGORITHM
	bool "FT98XX matching algorithm"
	default y if FINGERPRINT_SENSOR_FT98XX
	help
	  Enable Focaltech FT98XX matching algorithm. To work properly, Focaltech
	  private library is required.

config FP_ALGORITHM_TEMPLATE_SIZE
	int "Size of template size"
	default 5092 if FINGERPRINT_SENSOR_FPC1025 && FP_FPC_BEP_ALGORITHM
	default 47552 if FINGERPRINT_SENSOR_FPC1145 && FP_FPC_LIBFP_ALGORITHM
	default 20480 if FINGERPRINT_SENSOR_EGIS630 && FP_EGIS_EGIS630_ALGORITHM
	default 18004 if FINGERPRINT_SENSOR_EGIS660 && FP_EGIS_EGIS660_ALGORITHM
	default 19320 if FINGERPRINT_SENSOR_ELAN80SG && FP_ELAN_ELAN80SG_ALGORITHM
	default 34800 if FINGERPRINT_SENSOR_ELANI80SA && FP_ELAN_ELANI80SA_ALGORITHM
	default 86016 if FINGERPRINT_SENSOR_FT98XX && FP_FT98XX_ALGORITHM
	default 0
	help
	  Constant value corresponding to the maximum template size.
	  Client template memory allocation must have this size.
	  This includes extra memory for template update.

	  For example, for FPC1025 sensor template size is 5092 bytes which
	  consists of template size + alignment padding + size of template
	  size variable.

config FP_MAX_FINGER_COUNT
	  int "Maximum number of loaded finger templates"
	  default 5 if FINGERPRINT_SENSOR_FPC1025 && FP_FPC_BEP_ALGORITHM
	  default 5 if FINGERPRINT_SENSOR_FPC1145 && FP_FPC_LIBFP_ALGORITHM
	  default 3 if FINGERPRINT_SENSOR_EGIS630 && FP_EGIS_EGIS630_ALGORITHM
	  default 3 if FINGERPRINT_SENSOR_EGIS660 && FP_EGIS_EGIS660_ALGORITHM
	  default 3 if FINGERPRINT_SENSOR_ELAN80SG && FP_ELAN_ELAN80SG_ALGORITHM
	  default 3 if FINGERPRINT_SENSOR_ELANI80SA && FP_ELAN_ELANI80SA_ALGORITHM
	  default 3 if FINGERPRINT_SENSOR_FT98XX && FP_FT98XX_ALGORITHM
	  default 5
	  help
		Max number of templates stored / matched against. This limit comes
		from memory constraints and matching time.

config HAVE_BEP_PRIVATE_DRIVER
	bool
	default n
	help
	  If enabled, it indicates that BEP private driver is present.

config HAVE_LIBFP_PRIVATE_DRIVER
	bool
	default n
	help
	  If enabled, it indicates that LIBFP private driver is present.

config HAVE_EGIS630_PRIVATE_ALGORITHM
	bool
	default n
	help
	  If enabled, it indicates that EGIS630 private algorithm is present.

config HAVE_EGIS660_PRIVATE_ALGORITHM
	bool
	default n
	help
	  If enabled, it indicates that EGIS660 private algorithm is present.

config HAVE_ELAN80SERIES_PRIVATE_ALGORITHM
	bool
	help
	  If enabled, it indicates that ELAN80SERIES private algorithm is present.

config HAVE_FT_LOCKER_PRIVATE_ALGORITHM
	bool
	default n
	help
	  If enabled, it indicates that focaltech private algorithm is present.

config LIBFP_PRIVATE_DRIVER_HEAP_SIZE
	int "Size of heap for FPC1145 driver"
	depends on HAVE_LIBFP_PRIVATE_DRIVER
	default 393216
	help
	  Size of heap to be used by FPC private library. The default vaule has
	  been established experimentally.
```

## zephyr/test/ap_power/testcase.yaml
```yaml
common:
  platform_allow:
  - native_sim
tests:
  ap_power.alderlake:
    extra_dtc_overlay_files:
    - boards/native_sim.overlay
    - boards/alderlake.dts
    extra_configs:
    - CONFIG_TEST_AP_POWER_ADL=y
    - CONFIG_EMUL_POWER_SIGNALS=y
    - CONFIG_X86_NON_DSX_PWRSEQ_ADL=y
    - CONFIG_AP_PWRSEQ_S0IX=y
    - CONFIG_AP_X86_INTEL_ADL=y
    - CONFIG_PLATFORM_EC_HOST_INTERFACE_ESPI_VW_SLP_S4=y
    - CONFIG_PLATFORM_EC_HOST_INTERFACE_ESPI_VW_SLP_S5=y
    - CONFIG_AP_PWRSEQ_DRIVER=n
  ap_power.atriarvp:
    extra_dtc_overlay_files:
    - boards/native_sim.overlay
    - boards/atriarvp_native_sim.overlay
    extra_configs:
    - CONFIG_TEST_AP_POWER_ATRIARVP=y
    - CONFIG_EMUL_POWER_SIGNALS=y
    - CONFIG_X86_NON_DSX_PWRSEQ_MTL=y
    - CONFIG_AP_PWRSEQ_S0IX=y
    - CONFIG_AP_X86_INTEL_MTL=y
    - CONFIG_PLATFORM_EC_HOST_INTERFACE_ESPI_VW_SLP_S5=y
    - CONFIG_AP_PWRSEQ_DRIVER=y
  ap_power.atriarvp.rec:
    extra_dtc_overlay_files:
    - boards/native_sim.overlay
    - boards/atriarvp_native_sim.overlay
    extra_configs:
    - CONFIG_TEST_AP_POWER_ATRIARVP=y
    - CONFIG_TEST_AP_POWER_RECOVERY_MODE=y
    - CONFIG_EMUL_POWER_SIGNALS=y
    - CONFIG_X86_NON_DSX_PWRSEQ_MTL=y
    - CONFIG_AP_PWRSEQ_S0IX=y
    - CONFIG_AP_X86_INTEL_MTL=y
    - CONFIG_PLATFORM_EC_HOST_INTERFACE_ESPI_VW_SLP_S5=y
    - CONFIG_AP_PWRSEQ_DRIVER=y
  ap_power.brox:
    extra_dtc_overlay_files:
    - boards/native_sim.overlay
    - boards/brox_native_sim.overlay
    extra_configs:
    - CONFIG_TEST_AP_POWER_BROX=y
    - CONFIG_EMUL_POWER_SIGNALS=y
    - CONFIG_X86_NON_DSX_PWRSEQ_ADL=y
    - CONFIG_AP_PWRSEQ_S0IX=y
    - CONFIG_AP_X86_INTEL_ADL=y
    - CONFIG_PLATFORM_EC_HOST_INTERFACE_ESPI_VW_SLP_S5=y
    - CONFIG_AP_PWRSEQ_DRIVER=n
  ap_power.meteorlake:
    extra_dtc_overlay_files:
    - boards/native_sim.overlay
    - boards/meteorlake.dts
    extra_configs:
    - CONFIG_TEST_AP_POWER_MTL=y
    - CONFIG_EMUL_POWER_SIGNALS=y
    - CONFIG_X86_NON_DSX_PWRSEQ_MTL=y
    - CONFIG_AP_PWRSEQ_S0IX=y
    - CONFIG_AP_X86_INTEL_MTL=y
    - CONFIG_PLATFORM_EC_HOST_INTERFACE_ESPI_VW_SLP_S4=y
    - CONFIG_PLATFORM_EC_HOST_INTERFACE_ESPI_VW_SLP_S5=y
    - CONFIG_X86_NON_DSX_PWRSEQ_CONSOLE=y
    - CONFIG_AP_PWRSEQ_DRIVER=n
  ap_power_drv.alderlake:
    extra_dtc_overlay_files:
    - boards/native_sim.overlay
    - boards/alderlake.dts
    extra_configs:
    - CONFIG_TEST_AP_POWER_ADL=y
    - CONFIG_EMUL_POWER_SIGNALS=y
    - CONFIG_X86_NON_DSX_PWRSEQ_ADL=y
    - CONFIG_AP_PWRSEQ_S0IX=y
    - CONFIG_AP_X86_INTEL_ADL=y
    - CONFIG_PLATFORM_EC_HOST_INTERFACE_ESPI_VW_SLP_S4=y
    - CONFIG_PLATFORM_EC_HOST_INTERFACE_ESPI_VW_SLP_S5=y
    - CONFIG_AP_PWRSEQ_DRIVER=y
  ap_power_drv.alderlake.rec:
    extra_dtc_overlay_files:
    - boards/native_sim.overlay
    - boards/alderlake.dts
    extra_configs:
    - CONFIG_TEST_AP_POWER_ADL=y
    - CONFIG_TEST_AP_POWER_RECOVERY_MODE=y
    - CONFIG_EMUL_POWER_SIGNALS=y
    - CONFIG_X86_NON_DSX_PWRSEQ_ADL=y
    - CONFIG_AP_PWRSEQ_S0IX=y
    - CONFIG_AP_X86_INTEL_ADL=y
    - CONFIG_PLATFORM_EC_HOST_INTERFACE_ESPI_VW_SLP_S4=y
    - CONFIG_PLATFORM_EC_HOST_INTERFACE_ESPI_VW_SLP_S5=y
    - CONFIG_AP_PWRSEQ_DRIVER=y
  ap_power_drv.meteorlake:
    extra_dtc_overlay_files:
    - boards/native_sim.overlay
    - boards/meteorlake.dts
    extra_configs:
    - CONFIG_TEST_AP_POWER_MTL=y
    - CONFIG_EMUL_POWER_SIGNALS=y
    - CONFIG_X86_NON_DSX_PWRSEQ_MTL=y
    - CONFIG_AP_PWRSEQ_S0IX=y
    - CONFIG_AP_X86_INTEL_MTL=y
    - CONFIG_PLATFORM_EC_HOST_INTERFACE_ESPI_VW_SLP_S4=y
    - CONFIG_PLATFORM_EC_HOST_INTERFACE_ESPI_VW_SLP_S5=y
    - CONFIG_AP_PWRSEQ_DRIVER=y
  ap_power_drv.meteorlake.rec:
    extra_dtc_overlay_files:
    - boards/native_sim.overlay
    - boards/meteorlake.dts
    extra_configs:
    - CONFIG_TEST_AP_POWER_MTL=y
    - CONFIG_TEST_AP_POWER_RECOVERY_MODE=y
    - CONFIG_EMUL_POWER_SIGNALS=y
    - CONFIG_X86_NON_DSX_PWRSEQ_MTL=y
    - CONFIG_AP_PWRSEQ_S0IX=y
    - CONFIG_AP_X86_INTEL_MTL=y
    - CONFIG_PLATFORM_EC_HOST_INTERFACE_ESPI_VW_SLP_S4=y
    - CONFIG_PLATFORM_EC_HOST_INTERFACE_ESPI_VW_SLP_S5=y
    - CONFIG_AP_PWRSEQ_DRIVER=y
  ap_power.ocelotrvp:
    extra_dtc_overlay_files:
    - boards/native_sim.overlay
    - boards/ocelotrvp_native_sim.overlay
    extra_configs:
    - CONFIG_TEST_AP_POWER_OCELOTRVP=y
    - CONFIG_EMUL_POWER_SIGNALS=y
    - CONFIG_X86_NON_DSX_PWRSEQ_MTL=y
    - CONFIG_AP_PWRSEQ_S0IX=y
    - CONFIG_AP_X86_INTEL_MTL=y
    - CONFIG_PLATFORM_EC_HOST_INTERFACE_ESPI_VW_SLP_S3=y
    - CONFIG_PLATFORM_EC_HOST_INTERFACE_ESPI_VW_SLP_S4=y
    - CONFIG_PLATFORM_EC_HOST_INTERFACE_ESPI_VW_SLP_S5=y
    - CONFIG_AP_PWRSEQ_DRIVER=y
```

## zephyr/test/charger/testcase.yaml
```yaml
# Copyright 2024 The ChromiumOS Authors
# Use of this source code is governed by a BSD-style license that can be
# found in the LICENSE file.

common:
  platform_allow:
    - native_sim
tests:
  # ISL923x common tests
  isl923x.extpower.nissa.craask:
    extra_configs:
      - CONFIG_TEST_BOARD_CRAASK=y
      - CONFIG_TEST_EXTPOWER=y

  isl923x.extpower.nissa.craaskov:
    extra_dtc_overlay_files:
      - boards/native_sim.overlay
      - boards/craaskov_xivu.overlay
    extra_configs:
      - CONFIG_TEST_BOARD_CRAASKOV=y
      - CONFIG_TEST_EXTPOWER=y

  isl923x.extpower.nissa.gothrax:
    extra_configs:
      - CONFIG_TEST_BOARD_GOTHRAX=y
      - CONFIG_TEST_EXTPOWER=y
    extra_dtc_overlay_files:
      - boards/native_sim.overlay
      - boards/charger.gothrax.overlay

  isl923x.extpower.nissa.nivviks:
    extra_configs:
      - CONFIG_TEST_BOARD_NIVVIKS=y
      - CONFIG_TEST_EXTPOWER=y

  isl923x.extpower.nissa.pirrha:
    extra_configs:
      - CONFIG_TEST_BOARD_PIRRHA=y
      - CONFIG_TEST_EXTPOWER=y

  isl923x.extpower.nissa.pujjo:
    extra_configs:
      - CONFIG_TEST_BOARD_PUJJO=y
      - CONFIG_TEST_EXTPOWER=y

  isl923x.extpower.nissa.uldren:
    extra_configs:
      - CONFIG_TEST_BOARD_ULDREN=y
      - CONFIG_TEST_EXTPOWER=y

  isl923x.extpower.nissa.xivu:
    extra_dtc_overlay_files:
      - boards/native_sim.overlay
      - boards/craaskov_xivu.overlay
    extra_configs:
      - CONFIG_TEST_BOARD_XIVU=y
      - CONFIG_TEST_EXTPOWER=y

  charge.manager:
    extra_dtc_overlay_files:
      - boards/native_sim.overlay
    extra_configs:
      - CONFIG_LINK_TEST_SUITE_CHARGE=y
      - CONFIG_TEST_CHARGE_MANAGER=y
      - CONFIG_TEST_BOARD_NATIVE_SIM=y

  charge.ramp:
    extra_dtc_overlay_files:
      - boards/native_sim.overlay
    extra_configs:
      - CONFIG_LINK_TEST_SUITE_CHARGE=y
      - CONFIG_TEST_CHARGE_RAMP=y
      - CONFIG_SYSTEM_FAKE=y
      - CONFIG_PLATFORM_EC_CHARGE_RAMP_SW=y
      - CONFIG_TEST_BOARD_NATIVE_SIM=y

  charge.state:
    extra_dtc_overlay_files:
      - boards/native_sim.overlay
      - boards/isl95522.overlay
    extra_configs:
      - CONFIG_LINK_TEST_SUITE_CHARGE=y
      - CONFIG_PLATFORM_EC_CHARGER_ISL95522=y
      - CONFIG_TEST_CHARGE_STATE=y
      - CONFIG_TEST_BOARD_NATIVE_SIM=y
      - CONFIG_SHIMMED_TASKS=y

  charge.acokref:
    extra_dtc_overlay_files:
      - boards/native_sim.overlay
      - boards/isl9241.overlay
    extra_configs:
      - CONFIG_LINK_TEST_SUITE_CHARGE=y
      - CONFIG_PLATFORM_EC_CHARGER_ISL95522=n
      - CONFIG_PLATFORM_EC_CHARGER_ISL9241=y
      - CONFIG_TEST_CHARGE_ACOKREF=y
      - CONFIG_TEST_BOARD_NATIVE_SIM=y
      - CONFIG_SHIMMED_TASKS=y
      - CONFIG_PLATFORM_EC_CHARGER_SET_ACOKREF=y

  charge.no_acokref:
    extra_dtc_overlay_files:
      - boards/native_sim.overlay
      - boards/isl9241.overlay
    extra_configs:
      - CONFIG_LINK_TEST_SUITE_CHARGE=y
      - CONFIG_PLATFORM_EC_CHARGER_ISL95522=n
      - CONFIG_PLATFORM_EC_CHARGER_ISL9241=y
      - CONFIG_TEST_CHARGE_ACOKREF=y
      - CONFIG_TEST_BOARD_NATIVE_SIM=y
      - CONFIG_SHIMMED_TASKS=y
      - CONFIG_PLATFORM_EC_CHARGER_SET_ACOKREF=n

  charge.state_prevent_power_on:
    extra_dtc_overlay_files:
      - boards/native_sim.overlay
    extra_configs:
      - CONFIG_LINK_TEST_SUITE_CHARGE=y
      - CONFIG_TEST_CHARGE_STATE_PREVENT_POWER_ON=y
      - CONFIG_TEST_BOARD_NATIVE_SIM=y

  charge.seeding:
    extra_dtc_overlay_files:
      - boards/native_sim.overlay
    extra_configs:
      - CONFIG_LINK_TEST_SUITE_CHARGE=y
      - CONFIG_TEST_CHARGE_MANAGER_SEEDING=y

  charge.seeding.dedicated:
    extra_dtc_overlay_files:
      - boards/native_sim.overlay
    extra_configs:
      - CONFIG_LINK_TEST_SUITE_CHARGE=y
      - CONFIG_TEST_CHARGE_MANAGER_SEEDING=y
      - CONFIG_PLATFORM_EC_DEDICATED_CHARGE_PORT=y
```

## zephyr/test/fingerprint/task/testcase.yaml
```yaml
# Copyright 2024 The ChromiumOS Authors
# Use of this source code is governed by a BSD-style license that can be
# found in the LICENSE file.

common:
  platform_allow:
  - native_sim
tests:
  fingerprint.task.capture:
    extra_configs:
    - CONFIG_LINK_TEST_SUITE_FINGERPRINT_CAPTURE=y
    extra_conf_files:
    - prj.conf

  fingerprint.task.enroll:
    extra_configs:
    - CONFIG_LINK_TEST_SUITE_FINGERPRINT_ENROLL=y
    extra_conf_files:
    - prj.conf

  fingerprint.task.finger_presence:
    extra_configs:
    - CONFIG_LINK_TEST_SUITE_FINGERPRINT_FINGER_PRESENCE=y
    extra_conf_files:
    - prj.conf

  fingerprint.task.init:
    extra_configs:
    - CONFIG_LINK_TEST_SUITE_FINGERPRINT_INIT=y
    extra_conf_files:
    - prj.conf

  fingerprint.task.match:
    extra_configs:
    - CONFIG_LINK_TEST_SUITE_FINGERPRINT_MATCH=y
    extra_conf_files:
    - prj.conf

  fingerprint.task.shim:
    extra_configs:
    - CONFIG_LINK_TEST_SUITE_FINGERPRINT_SHIM=y
    extra_conf_files:
    - prj.conf

  fingerprint.task.template:
    extra_configs:
    - CONFIG_LINK_TEST_SUITE_FINGERPRINT_TEMPLATE=y
    extra_conf_files:
    - prj.conf

  fingerprint.task.utils:
    extra_configs:
    - CONFIG_LINK_TEST_SUITE_FINGERPRINT_UTILS=y
    extra_conf_files:
    - prj.conf

  fingerprint.task.debug:
    extra_configs:
    - CONFIG_LINK_TEST_SUITE_FINGERPRINT_DEBUG=y
    - CONFIG_FINGERPRINT_SHELL=y
    extra_conf_files:
    - prj.conf

  fingerprint.task.commands:
    extra_configs:
    - CONFIG_LINK_TEST_SUITE_FINGERPRINT_COMMANDS=y
    - CONFIG_PLATFORM_EC_FINGERPRINT_VENDOR_COMMAND=y
    extra_conf_files:
    - prj.conf

  fingerprint.task.ascp:
    extra_configs:
    - CONFIG_LINK_TEST_SUITE_FINGERPRINT_ASCP=y
    - CONFIG_ASCP=y
    extra_conf_files:
    - prj.conf

  fingerprint.task.frame.size:
    extra_configs:
    - CONFIG_LINK_TEST_SUITE_FINGERPRINT_FRAME_SIZE=y
    extra_conf_files:
    - prj.conf

  fingerprint.task.fp_info:
    extra_configs:
    - CONFIG_LINK_TEST_SUITE_FINGERPRINT_FP_INFO=y
    extra_conf_files:
    - prj.conf

  fingerprint.task.btn_ign_out:
    extra_configs:
    - CONFIG_LINK_TEST_SUITE_FINGERPRINT_BTN_IGN_OUT=y
    - CONFIG_CROS_EC_RW=y
    extra_conf_files:
    - prj.conf
    extra_dtc_overlay_files:
    - btn_ign.dtsi

  fingerprint.task.led:
    extra_configs:
    - CONFIG_LINK_TEST_SUITE_FINGERPRINT_LED=y
    - CONFIG_CROS_EC_RW=y
    - CONFIG_PLATFORM_EC_FP_LED=y
    - CONFIG_LED=y
    - CONFIG_LED_PWM=y
    - CONFIG_PWM=y
    extra_conf_files:
    - prj.conf
    extra_dtc_overlay_files:
    - fp_led.dtsi
```
