## zephyr/test/framework/testcase.yaml
```yaml
common:
  platform_allow:
  - native_sim
tests:
  framework.uefi_app_mode:
    extra_conf_files:
    - prj.conf
    extra_dtc_overlay_files:
    - boards/native_sim.overlay
    tags:
    - framework
```

## zephyr/test/jump_data/testcase.yaml
```yaml
# Copyright 2026 The ChromiumOS Authors
# Use of this source code is governed by a BSD-style license that can be
# found in the LICENSE file.

common:
  platform_allow:
    - native_sim
tests:
  jump_data.default:
    extra_configs:
      - CONFIG_PLATFORM_EC_PRESERVED_END_OF_RAM_SIZE=1024
    tags:
      - common
      - system
  jump_data.rw:
    extra_configs:
      - CONFIG_PLATFORM_EC_PRESERVED_END_OF_RAM_SIZE=1024
    extra_args:
      - EXTRA_CFLAGS=-DSECTION_IS_RW
    tags:
      - common
      - system
```

## zephyr/test/mtk_power/testcase.yaml
```yaml
common:
  platform_allow:
  - native_sim
tests:
  mtk_power.default: {}
  mtk_power.double_wdt:
    extra_configs:
      - CONFIG_PLATFORM_EC_POWERSEQ_MTK_DOUBLE_WDT=y
```
