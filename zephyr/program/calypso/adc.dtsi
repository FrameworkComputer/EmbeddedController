/* Copyright 2025 The ChromiumOS Authors
 * Use of this source code is governed by a BSD-style license that can be
 * found in the LICENSE file.
 */

#include <zephyr/dt-bindings/adc/adc.h>

/ {
	named-adc-channels {
		compatible = "named-adc-channels";

		vph_pwr {
			enum-name = "ADC_VPH_PWR";
			io-channels = <&adc0 11>;
			/* Measured VPH power through 47/57 voltage divider */
			mul = <57>;
			div = <47>;
		};
	};
};

&adc0 {
	status = "okay";
	pinctrl-0 = <&adc0_chan11_gpc7>;
	pinctrl-names = "default";
};
