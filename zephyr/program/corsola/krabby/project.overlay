/* Copyright 2022 The ChromiumOS Authors
 * Use of this source code is governed by a BSD-style license that can be
 * found in the LICENSE file.
 */

/* Corsola program common DTS includes */

#include "../common.dtsi"
#include "../power_signal.dtsi"
#include "../usba.dtsi"
#include "../ite_adc.dtsi"
#include "../ite_gpio.dtsi"
#include "../ite_keyboard.dtsi"
#include "../ite_i2c.dtsi"
#include "../ite_interrupts.dtsi"
#include "../ite_led.dtsi"
#include "../ite_motionsense.dtsi"
#include "../ite_usbc.dtsi"
#include "../ite_shi.dtsi"


/ {
	batteries {
		default_battery: c235 {
			compatible = "celxpert,c235-41", "battery-smart";
		};
	};
};
