/* Copyright 2022 The ChromiumOS Authors
 * Use of this source code is governed by a BSD-style license that can be
 * found in the LICENSE file.
 */

/ {
	usba_port_enable_list: usba-port-enable-list {
		compatible = "cros-ec,usba-port-enable-pins";
		enable-pins = <&en_pp5000_usb_a0_vbus>;
	};
};
