/* Copyright 2022 The ChromiumOS Authors
 * Use of this source code is governed by a BSD-style license that can be
 * found in the LICENSE file.
 */

/* steelix usba port enable config */
&usba_port_enable_list {
	enable-pins = <&en_pp5000_usb_a0_vbus
		       &en_pp5000_usb_a1_vbus>;
};
