/* Copyright 2024 The ChromiumOS Authors
 * Use of this source code is governed by a BSD-style license that can be
 * found in the LICENSE file.
 */

/ {
	gpio-interrupts {
		compatible = "cros-ec,gpio-interrupts";

		int_ioex_kbd_intr_n: ioex_kbd_intr_n {
			irq-pin = <&gpio_c_ioex_kbd_intr_r>;
			flags = <GPIO_INT_EDGE_FALLING>;
			handler = "io_expander_it8801_interrupt";
		};
	};
};
