/* Copyright 2024 The ChromiumOS Authors
 * Use of this source code is governed by a BSD-style license that can be
 * found in the LICENSE file.
 */

/*
 * TODO (b/370100724): verify prescalers
 */

&pwm1 {
	prescaler-cx = <PWM_PRESCALER_C4>;
};

&pwm2 {
	prescaler-cx = <PWM_PRESCALER_C4>;
};

&pwm3 {
	prescaler-cx = <PWM_PRESCALER_C4>;
};

&pwm5 {
	prescaler-cx = <PWM_PRESCALER_C4>;
};
