/* Copyright 2025 The ChromiumOS Authors
 * Use of this source code is governed by a BSD-style license that can be
 * found in the LICENSE file.
 */

/*
 * Define nodelabel aliases needed for fan devicetree.
 */
gpio_fan_control: &gpio_en_pp5000_fan {};
pwm_fan: &pwm0 {};
tach_fan: &tach1 {};

#include "../../intelrvp/ptlrvp/fan.dtsi"
