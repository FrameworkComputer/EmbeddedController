/* Copyright 2024 The ChromiumOS Authors
 * Use of this source code is governed by a BSD-style license that can be
 * found in the LICENSE file.
 */

&kbd {
	col-size = <17>;
	actual-key-mask = <
		0x08 /* C0 */
		0xff /* C1 */
		0xff /* C2 */
		0xff /* C3 */
		0xff /* C4 */
		0xff /* C5 */
		0xfe /* C6 */
		0xa0 /* C7 */
		0xff /* C8 */
		0xf6 /* C9 */
		0x01 /* C10 */
		0xff /* C11 */
		0xc0 /* C12 */
		0x40 /* C13 */
		0x0a /* C14 */
		0x40 /* C15 */
		0x01 /* C16 */
	>;
};
