/* Copyright 2024 The ChromiumOS Authors
 * Use of this source code is governed by a BSD-style license that can be
 * found in the LICENSE file.
 */

/* fatcat program common DTS includes */

#include <cros/integrated_fwid.dtsi>

#include "../fatcat_stub.dts"

/* francka project DTS includes */

#include <cros/cbi_flash.dtsi>

#include "adc.dtsi"
#include "gpios.dtsi"
#include "i2c.dtsi"

/* francka overrides follow... */

&cbi_flash {
	/*
	 * CBI section size is 0x1000 bytes, the CBI portion lies at the end of
	 * EC_RO section. WP_RO section size is 0x40000 bytes, EC_RO will be
	 * trimmed down to 0x3e000 and CBI will be added at 0x3e000.
	 */
	offset = <0x3e000>;
	size = <0x1000>;
};

/* AP interface */
&espi0 {
	status = "okay";
	pinctrl-0 = <&espi_lpc_gp46_47_51_52_53_54_55_57>;
	pinctrl-names = "default";
};
