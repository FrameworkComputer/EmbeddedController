/* Copyright 2025 The ChromiumOS Authors
 * Use of this source code is governed by a BSD-style license that can be
 * found in the LICENSE file.
 */

&pwm1 {
	status = "okay";
	prescaler-cx = <PWM_PRESCALER_C4>;
	pinctrl-0 = <&pwm1_gpa1_default>;
	pinctrl-names = "default";
};

&pwm2 {
	status = "okay";
	prescaler-cx = <PWM_PRESCALER_C4>;
	pinctrl-0 = <&pwm2_gpa2_default>;
	pinctrl-names = "default";
};

&pwm3 {
	status = "okay";
	prescaler-cx = <PWM_PRESCALER_C4>;
	pinctrl-0 = <&pwm3_gpa3_default>;
	pinctrl-names = "default";
};