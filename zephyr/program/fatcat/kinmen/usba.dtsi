/* Copyright 2025 The ChromiumOS Authors
 * Use of this source code is governed by a BSD-style license that can be
 * found in the LICENSE file.
 */

 / {
	usba {
		compatible = "cros-ec,usba-port-enable-pins";
		enable-pins = <&gpio_en_pp5000_usba>;
		status = "okay";
	};
 };
