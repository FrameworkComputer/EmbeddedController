/* Copyright 2025 The ChromiumOS Authors
 * Use of this source code is governed by a BSD-style license that can be
 * found in the LICENSE file.
 */

/ {
	fans {
		compatible = "cros-ec,fans";
		fan_0 {
			pwms = <&pwm5 0 PWM_KHZ(25) PWM_POLARITY_NORMAL>;
			tach = <&tach0>;
			rpm-min = <960>;
			rpm-start = <1200>;
			rpm-max = <4800>;
			rpm-deviation = <1>;
			pgood-gpio = <&gpio_all_sys_pwrgd>;
		};
	};
};

/* Fan tachometer sensor */
&tach0 {
	status = "okay";
	pinctrl-0 = <&tacho0_gpio052>;
	pinctrl-names = "default";
	pulses-per-round = <2>;
};
