/* Copyright 2025 The ChromiumOS Authors
 * Use of this source code is governed by a BSD-style license that can be
 * found in the LICENSE file.
 */

 /* moonstone-ish project DTSI includes */
#include "gpio.dtsi"
#include "motionsense.dtsi"
#include <cros/cbi_ufsc_std_schema.dtsi>
#include <cros/cbi_ufsc_oem_schema.dtsi>
#include "../moonstone/moonstone_ec_ufsc.dtsi"
#include "../kinmen-ish/i2c.dtsi"
#include "../kinmen-ish/ish.dtsi"
