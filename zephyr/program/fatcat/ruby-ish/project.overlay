/* Copyright 2025 The ChromiumOS Authors
 * Use of this source code is governed by a BSD-style license that can be
 * found in the LICENSE file.
 */

 /* ruby-ish project DTSI includes */
#include "gpio.dtsi"
#include "i2c.dtsi"
#include "ish.dtsi"
#include "motionsense.dtsi"
