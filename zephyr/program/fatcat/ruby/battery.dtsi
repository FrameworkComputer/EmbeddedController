/* Copyright 2025 The ChromiumOS Authors
 * Use of this source code is governed by a BSD-style license that can be
 * found in the LICENSE file.
 */

/ {
	batteries {
		default_battery: smp_l24m4pk5 {
			compatible = "smp,l24m4pk5", "battery-smart";
		};
		byd_l25b4pk5 {
			compatible = "byd,l25b4pk5", "battery-smart";
		};
	};
};
