/* Copyright 2025 The ChromiumOS Authors
 * Use of this source code is governed by a BSD-style license that can be
 * found in the LICENSE file.
 */

/ {
/* Ruby-specific fw_config fields. */
	ruby-fw-config {
		compatible = "cros-ec,cbi-fw-config";
	};
};
