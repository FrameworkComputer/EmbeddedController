/* Copyright 2026 The ChromiumOS Authors.
 * Use of this source code is governed by a BSD-style license that can be
 * found in the LICENSE file.
 */

/{
	pwmleds {
		compatible = "pwm-leds";

		fp_led: fp_led {
			pwms = <&pwm0 1 PWM_MSEC(20) PWM_POLARITY_NORMAL>;
		};
	};

	aliases {
		pwm-fp-led = &fp_led;
	};
};
