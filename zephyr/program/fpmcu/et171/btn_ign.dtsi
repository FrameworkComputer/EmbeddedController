/* Copyright 2026 The ChromiumOS Authors
 * Use of this source code is governed by a BSD-style license that can be
 * found in the LICENSE file.
 */

/ {
	aliases {
		gpio-btn-ign-out = &gpio_btn_ign_out;
	};

	gpio-leds {
		/* Common pattern in Zephyr for GPIO outputs */
		compatible = "gpio-leds";

		gpio_btn_ign_out: gpio_btn_ign_out {
			gpios = <&gpio0 2 GPIO_ACTIVE_HIGH>;
		};
	};
};
