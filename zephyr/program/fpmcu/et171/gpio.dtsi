/* Copyright 2023 The ChromiumOS Authors.
 * Use of this source code is governed by a BSD-style license that can be
 * found in the LICENSE file.
 */

#include <dt-bindings/gpio_defines.h>

/ {
	named-gpios {
		compatible = "named-gpios";

		entering-rw {
			enum-name = "GPIO_ENTERING_RW";
		};
	};
};
