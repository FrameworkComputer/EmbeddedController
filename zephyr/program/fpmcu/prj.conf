## CMakeLists.txt
```
# Copyright 2023 The ChromiumOS Authors
# Use of this source code is governed by a BSD-style license that can be
# found in the LICENSE file.

cmake_minimum_required(VERSION 3.13.1)

find_package(Zephyr REQUIRED HINTS "${ZEPHYR_BASE}")

# USAGE FAULT on int overflow
zephyr_compile_options(-ftrapv)

# Include directory with POSIX headers from Zephyr.
# We could enable CONFIG_POSIX_API, but it selects so many features that are
# not necessary.
zephyr_include_directories(${ZEPHYR_BASE}/include/zephyr/posix)

set(EXPECTED_ROLLBACK_VERSION 1)

if (DEFINED CONFIG_BOARD_BLOONCHIPPER)
	# Expected rollback version is 0 on bloonchipper.
	set(EXPECTED_ROLLBACK_VERSION 0)
	add_subdirectory(bloonchipper)
	project(bloonchipper)
endif()

if (DEFINED CONFIG_BASEBOARD_HELIPILOT)
	# Expected rollback version is 0 on helipilot.
	set(EXPECTED_ROLLBACK_VERSION 0)
	add_subdirectory(helipilot)
	project(helipilot)
endif()

if (DEFINED CONFIG_BOARD_ET171)
	add_subdirectory(et171)
	project(et171)
endif()

if (DEFINED CONFIG_BOARD_EM32F967)
	add_subdirectory(em32f967)
	project(em32f967)
endif()

if (DEFINED CONFIG_BOARD_FT9001)
	add_subdirectory(ft9001)
	project(ft9001)
endif()

if(NOT CONFIG_PLATFORM_EC_ROLLBACK_VERSION EQUAL EXPECTED_ROLLBACK_VERSION)
	message(FATAL_ERROR "Rollback version has changed! Expected ${EXPECTED_ROLLBACK_VERSION}, but ${CONFIG_PLATFORM_EC_ROLLBACK_VERSION} is set.")
endif()

zephyr_library_sources_ifdef(CONFIG_EC_HOST_CMD "src/fp_transport.c")
```

## Kconfig
```
# Copyright 2023 The ChromiumOS Authors
# Use of this source code is governed by a BSD-style license that can be
# found in the LICENSE file.

config BOARD_FINGERPRINT
	bool
	help
	  Indicates that this is the FPMCU board. This config is enabled in RO
	  and RW, so it can be used to control fingerprint flag in EC features.

config BOARD_BLOONCHIPPER
	bool "Bloonchipper FPMCU Board"
	select HAS_COVERAGE_SUPPORT
	select BOARD_FINGERPRINT
	select FINGERPRINT_SUBSYSTEM if CROS_EC_RW
	select FINGERPRINT_SENSOR if CROS_EC_RW
	select FINGERPRINT_SHELL if CROS_EC_RW
	select PLATFORM_EC_FINGERPRINT if CROS_EC_RW

	# Make sure RSA parameters for bloonchipper are correct.
	depends on PLATFORM_EC_RSA_KEY_SIZE = 3072
	depends on PLATFORM_EC_RSA_EXPONENT_3
	help
	  Build the bloonchipper FPMCU board. The board uses STM32F412CG MCU
	  and FPC1025 sensor.

if BOARD_BLOONCHIPPER

config BLOONCHIPPER_EC_RO_QUIRKS
	bool "Quirks required by bloonchipper EC RO"
	default n
	help
	  Include additional code that fixes problems when using EC RO and
	  Zephyr RW.

endif

config BASEBOARD_HELIPILOT
	bool "Helipilot FPMCU Baseboard"
	select HAS_COVERAGE_SUPPORT
	select BOARD_FINGERPRINT
	select FINGERPRINT_SUBSYSTEM if CROS_EC_RW
	select FINGERPRINT_SENSOR if CROS_EC_RW
	select FINGERPRINT_SHELL if CROS_EC_RW
	select PLATFORM_EC_FINGERPRINT if CROS_EC_RW

	# Make sure RSA parameters for helipilot are correct.
	depends on PLATFORM_EC_RSA_KEY_SIZE = 3072
	depends on PLATFORM_EC_RSA_EXPONENT_3
	help
	  Build the helipilot FPMCU Baseboard. The Baseboard uses NPCX99FPA0BX MCU
	  in combination with a variety of fingerprint sensors including FPC1025,
	  ELAN80SG, EGIS630, etc.

if BASEBOARD_HELIPILOT

config HELIPILOT_EC_RO_QUIRKS
	bool "Quirks required by helipilot EC RO"
	default n
	help
	  Include additional code that fixes problems when using EC RO and
	  Zephyr RW.

endif

# Override default RSA parameters.
# Make sure that these configs are placed ABOVE 'source "Kconfig.zephyr"' line.
config PLATFORM_EC_RSA_KEY_SIZE
	default 3072

config PLATFORM_EC_RSA_EXPONENT_3
	default y

# NPCX header options, TODO: have these on the upstream board defconfig
choice NPCX_HEADER_SPI_MAX_CLOCK_CHOICE
	default NPCX_HEADER_SPI_MAX_CLOCK_50
endchoice

choice NPCX_HEADER_SPI_READ_MODE_CHOICE
	default NPCX_HEADER_SPI_READ_MODE_DUAL
endchoice

choice NPCX_HEADER_CORE_CLOCK_SPI_CLOCK_RATIO_CHOICE
	default NPCX_HEADER_CORE_CLOCK_SPI_CLOCK_RATIO_2
endchoice

config BOARD_ET171
	bool "Sanok FPMCU Board"
	select HAS_COVERAGE_SUPPORT
	select BOARD_FINGERPRINT
	select FINGERPRINT_SUBSYSTEM if CROS_EC_RW
	select FINGERPRINT_SENSOR if CROS_EC_RW
	select FINGERPRINT_SHELL if CROS_EC_RW
	select PLATFORM_EC_FINGERPRINT if CROS_EC_RW
	# Enable PM only in RW to reduce RO size and avoid any potential problems
	select PM if CROS_EC_RW

	# Make sure RSA parameters for RWSIG are correct.
	depends on PLATFORM_EC_RSA_KEY_SIZE = 3072
	depends on PLATFORM_EC_RSA_EXPONENT_3
	help
	  Build the FPMCU board based on ET171 chip

config BOARD_EM32F967
	bool "EM32F967 based FPMCU Board"
	select HAS_COVERAGE_SUPPORT
	select BOARD_FINGERPRINT
	select FINGERPRINT_SUBSYSTEM if CROS_EC_RW
	select FINGERPRINT_SENSOR if CROS_EC_RW
	select FINGERPRINT_SHELL if CROS_EC_RW
	select PLATFORM_EC_FINGERPRINT if CROS_EC_RW

	# Make sure RSA parameters for RWSIG are correct.
	depends on PLATFORM_EC_RSA_KEY_SIZE = 3072
	depends on PLATFORM_EC_RSA_EXPONENT_3
	help
	  Build the FPMCU board based on EM32F967 chip.

# Make NUM_IRQS configurable, bloonchipper needs to override it.
config NUM_IRQS
	int "Maximun number of IRQs"

config BOARD_FT9001
	bool "FT9001 based FPMCU Board"
	select HAS_COVERAGE_SUPPORT
	select BOARD_FINGERPRINT
	select FINGERPRINT_SUBSYSTEM if CROS_EC_RW
	select FINGERPRINT_SENSOR if CROS_EC_RW
	select FINGERPRINT_SHELL if CROS_EC_RW
	select PLATFORM_EC_FINGERPRINT if CROS_EC_RW
	select PM if CROS_EC_RW
	select PM_DEVICE if CROS_EC_RW

	# Make sure RSA parameters for RWSIG are correct.
	depends on PLATFORM_EC_RSA_KEY_SIZE = 3072
	depends on PLATFORM_EC_RSA_EXPONENT_3
	help
	  Build the FPMCU board based on FT9001 chip.

rsource "et171/Kconfig"
source "Kconfig.zephyr"
```

## prj.conf
```kconfig
# Copyright 2023 The ChromiumOS Authors
# Use of this source code is governed by a BSD-style license that can be
# found in the LICENSE file.

## Zephyr Configuration

# Disable CHECK_INIT_PRIORITIES because we are compiling firmware using Clang
# with LTO enabled for EC code. With LTO enabled, Clang emits object files in
# LLVM IR bitcode format (instead of ELF format) which is not supported by
# check_init_priorities.py.
CONFIG_CHECK_INIT_PRIORITIES=n

# Use C11 standard to have _Static_assert() compiler builtin.
# Zephyr will use it for BUILD_ASSERT() implementation (instead of silently
# ignoring them).
CONFIG_STD_C11=y

# Peripherials
CONFIG_BBRAM=y
CONFIG_FLASH=y
CONFIG_SPI=y
CONFIG_WATCHDOG=y

# FPU
CONFIG_FPU=y

# Logging
CONFIG_LOG_MODE_IMMEDIATE=y
CONFIG_LOG_PRINTK=y
CONFIG_LOG_RUNTIME_FILTERING=n

# Enable console buffer log backend for timberslide.
# Reduce output to keep more lines in buffer and change timestamp format as
# required by timberslide.
CONFIG_PLATFORM_EC_LOG_BACKEND_CONSOLE_BUFFER=y
CONFIG_PLATFORM_EC_LOG_BACKEND_CONSOLE_BUFFER_REDUCED=y
CONFIG_PLATFORM_EC_LOG_CUSTOM_TIMESTAMP=y
CONFIG_LOG_TIMESTAMP_64BIT=y

# Shell
CONFIG_SHELL_HELP=y
CONFIG_SHELL_HISTORY=y
CONFIG_SHELL_PROMPT_UART="fpmcu:~$ "
CONFIG_SHELL_TAB=y
CONFIG_SHELL_TAB_AUTOCOMPLETION=y

# Shell commands
CONFIG_FLASH_SHELL=y
CONFIG_WDT_SHELL=n

## Cros EC configuration
CONFIG_CROS_EC=y
CONFIG_PLATFORM_EC=y

# MKBP
CONFIG_PLATFORM_EC_MKBP_EVENT=y
CONFIG_PLATFORM_EC_MKBP_USE_GPIO=y

CONFIG_SHIMMED_TASKS=y

# Enable support for random number generator
CONFIG_PLATFORM_EC_RANDOM=y

# RWSIG
CONFIG_PLATFORM_EC_RWSIG=y

# BoringSSL support
CONFIG_BORINGSSL_CRYPTO=y
CONFIG_BORINGSSL_HARDWARE_ENTROPY=y

# Rollback support
CONFIG_PLATFORM_EC_ROLLBACK=y
CONFIG_PLATFORM_EC_ROLLBACK_SECRET_SIZE=32

# Use Newlib libc.
# If compiling using the LLVM toolchain it will use version provided by
# the compiler.
# If compiling using Zephyr SDK, it should use version provided by the SDK.
CONFIG_NEWLIB_LIBC=y

# Malloc heap size. Must be power of 2 because of MPU requirements.
CONFIG_NEWLIB_LIBC_MIN_REQUIRED_HEAP_SIZE=2048

# Set size of kernel memory pool
# pthread_setspecific (enabled with CONFIG_POSIX_THREADS) allocates memory from
# kernel memory pool to store thread local data of
# sizeof(struct pthread_key_data) bytes for every unique <key, thread>:
# https://github.com/zephyrproject-rtos/zephyr/blob/9c2983926a4c95d6896d0c9aa63dfcc9c42a6d97/lib/posix/options/key.c#L210-L211
# The only use of pthread_setspecific that we have is in BoringSSL, which uses a
# single pthread_key_t:
# https://crsrc.org/o/src/third_party/boringssl/crypto/thread_pthread.c;l=98-107;drc=04c3d40f0695b07b9795e8a69a3babeab52b861f.
# However, HEAP_MEM_POOL_ADD_SIZE_POSIX_THREADS, defaults to 256, which forces
# that as a minimum value due to this logic:
# https://github.com/zephyrproject-rtos/zephyr/blob/e1f258d8e21f30d9272b65bf59a0030519adf82e/kernel/Kconfig#L757-L763
CONFIG_HEAP_MEM_POOL_SIZE=256

# Enable POSIX API required by BoringSSL.
# Please note that we don't enable CONFIG_POSIX_API because it selects so many
# options, including experimental features. The POSIX headers are included in
# CMakeLists.txt file.
# pthreads, semaphores, etc. depends on CONFIG_POSIX_SYSTEM_INTERFACES.
CONFIG_POSIX_SYSTEM_INTERFACES=y
CONFIG_POSIX_READER_WRITER_LOCKS=y
CONFIG_POSIX_TIMERS=y
CONFIG_POSIX_THREADS=y
# POSIX_C_LIB_EXT is needed for getentropy().
CONFIG_POSIX_C_LIB_EXT=y

# C++
CONFIG_CPP=y
CONFIG_STD_CPP20=y
CONFIG_REQUIRES_FULL_LIBCPP=y

# Disabled features
CONFIG_PLATFORM_EC_ACPI=n
CONFIG_PLATFORM_EC_BACKLIGHT_LID=n
CONFIG_PLATFORM_EC_BOOT_NO_SLEEP=n
CONFIG_PLATFORM_EC_CBI=n
CONFIG_PLATFORM_EC_CHIPSET_RESET_HOOK=n
CONFIG_PLATFORM_EC_CONSOLE_CMD_CHARGEN=n
# sleepmask is not used in FPMCU
CONFIG_PLATFORM_EC_CONSOLE_CMD_SLEEPMASK=n
# Disable the hibernate functionality
CONFIG_PLATFORM_EC_HIBERNATE=n
CONFIG_PLATFORM_EC_KEYBOARD=n
CONFIG_PLATFORM_EC_PORT80=n
CONFIG_PLATFORM_EC_SWITCH=n
CONFIG_PLATFORM_EC_VBOOT_EFS2=n
CONFIG_PLATFORM_EC_VBOOT_HASH=n
CONFIG_PLATFORM_EC_VSTORE=n

# Disable thread monitor to save space
CONFIG_THREAD_MONITOR=n

# Enable the upstream Host Commands
# Enable a proper backend and adjust buffers in the board specific config file
CONFIG_EC_HOST_CMD=y

# Enable support for saving final status of Host Command that sent
# EC_HOST_CMD_IN_PROGRESS. CONFIG_EC_HOST_CMD_IN_PROGRESS_STATUS
# provides necessary functions used by EC_CMD_GET_COMMS_STATUS and
# EC_CMD_RESEND_RESPONSE. Both host commands are enabled by
# CONFIG_PLATFORM_EC_HOST_COMMAND_STATUS.
CONFIG_EC_HOST_CMD_IN_PROGRESS_STATUS=y
CONFIG_PLATFORM_EC_HOST_COMMAND_STATUS=y

# Increase stack size for the main task.
# After initialization the main task is reused as hostcmd task to save RAM.
CONFIG_MAIN_STACK_SIZE=6144

# Enable Flash Erase HC v1 used to update fpmcu firmware
CONFIG_PLATFORM_EC_FLASH_DEFERRED_ERASE=y

# Do not print exception info and zero the general purpose registers not to leak
# secrets
CONFIG_EXCEPTION_DEBUG=n
CONFIG_PLATFORM_EC_PANIC_STRIP_GPR=y

# FPMCU doesn't use HOOK_SECOND
CONFIG_PLATFORM_EC_HOOK_SECOND=n

# Allow unaligned access for FPMCU
CONFIG_TRAP_UNALIGNED_ACCESS=n

# Allow usage of "%l" and "%i"
CONFIG_PLATFORM_EC_PRINTF_LONG_IS_32BITS=y

# CME
CONFIG_PLATFORM_EC_CME_VERSION=1
```

## prj_hw_tests.conf
```kconfig
# Copyright 2024 The ChromiumOS Authors
# Use of this source code is governed by a BSD-style license that can be
# found in the LICENSE file.

CONFIG_HW_TEST=y
#CONFIG_ASSERT=y increases the flash usage by 41kB
CONFIG_ASSERT=n
CONFIG_TASK_HOSTCMD_THREAD_MAIN=y
CONFIG_ZTEST_SHELL=y
# Tests are run on dev board so limit HC realated configs to save memory
# which is needed in RO for tests
CONFIG_PLATFORM_EC_HOSTCMD_CONSOLE=n
CONFIG_PLATFORM_EC_LOG_BACKEND_CONSOLE_BUFFER=n
CONFIG_PLATFORM_EC_LOG_BACKEND_CONSOLE_BUFFER_REDUCED=n
# Some console commands are disabled in the helipilot user image to
# save flash space. Re-enable them for unit test images
CONFIG_PLATFORM_EC_CONSOLE_CMD_CRASH=y
CONFIG_PLATFORM_EC_CONSOLE_CMD_CRASH_NESTED=y
# Limit Shell features to save flash for test code
CONFIG_SHELL_HISTORY=n
CONFIG_SHELL_TAB=n
CONFIG_SHELL_TAB_AUTOCOMPLETION=n
```

## src/fp_transport.c
```c
/* Copyright 2025 The ChromiumOS Authors
 * Use of this source code is governed by a BSD-style license that can be
 * found in the LICENSE file.
 */

#include <zephyr/drivers/gpio.h>

#include <fpsensor/fpsensor_detect.h>
#include <gpio_signal.h>

enum fp_transport_type get_fp_transport_type(void)
{
#ifdef CONFIG_EC_HOST_CMD_BACKEND_USB
	return FP_TRANSPORT_TYPE_USB;
#else /* CONFIG_EC_HOST_CMD_BACKEND_USB */
	static enum fp_transport_type ret = FP_TRANSPORT_TYPE_UNKNOWN;

	if (ret == FP_TRANSPORT_TYPE_UNKNOWN) {
		gpio_pin_set_dt(GPIO_DT_FROM_NODELABEL(div_highside), 1);
		k_usleep(1);
		switch (gpio_pin_get_dt(
			GPIO_DT_FROM_NODELABEL(transport_sel))) {
		case 0:
			ret = FP_TRANSPORT_TYPE_UART;
			break;
		case 1:
			ret = FP_TRANSPORT_TYPE_SPI;
			break;
		default:
			ret = FP_TRANSPORT_TYPE_UNKNOWN;
			break;
		}
	}

	return ret;
#endif /* CONFIG_EC_HOST_CMD_BACKEND_USB */
}
```
