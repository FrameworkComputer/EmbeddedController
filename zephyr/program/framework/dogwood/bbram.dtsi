/* Copyright 2024 The ChromiumOS Authors
 * Use of this source code is governed by a BSD-style license that can be
 * found in the LICENSE file.
 */

/ {
	named-bbram-regions {
		compatible = "named-bbram-regions";
		bios_function {
			offset = <0x47>;
			size = <0x01>;
		};
	};
};
