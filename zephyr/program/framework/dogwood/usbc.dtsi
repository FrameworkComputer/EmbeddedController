/* Copyright 2024 The ChromiumOS Authors
 * Use of this source code is governed by a BSD-style license that can be
 * found in the LICENSE file.
 */

/ {
	typec-port {
		#address-cells = <1>;
		#size-cells = <0>;

		/*
		 * In the Zephyer OS, the CONFIG_USB_PD_PORT_MAX_COUNT will
		 * check the device tree compatible "named-usbc-port"
		 */
		usbc_port0: port0@0 {
			compatible = "named-usbc-port";
			reg = <0>;
		};
		usbc_port1: port1@1 {
			compatible = "named-usbc-port";
			reg = <1>;
		};
	};
};
