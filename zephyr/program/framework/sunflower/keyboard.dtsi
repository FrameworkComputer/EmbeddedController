/* Copyright 2024 The Chromium OS Authors. All rights reserved.
 * Use of this source code is governed by a BSD-style license that can be
 * found in the LICENSE file.
 */

/ {
	cros-keyscan {
		compatible = "cros-keyscan";

		output-settle = <80>;
		debounce-down = <9000>;
		debounce-up = <30000>;
		poll-timeout = <100000>;

		actual-key-mask = <
			0x08	/* C0 */
			0xff	/* C1 */
			0xff	/* C2 */
			0xff	/* C3 */
			0xff	/* C4 */
			0xff	/* C5 */
			0xff	/* C6 */
			0xa1	/* C7 */
			0xff	/* C8 */
			0xff	/* C9 */
			0x01	/* C10 */
			0xff	/* C11 */
			0xff	/* C12 */
			0x40	/* C13 */
			0x0a	/* C14 */
			0x40	/* C15 */
			0x01	/* C16 */
			0xc4	/* C17 */
			>;
	};
};
