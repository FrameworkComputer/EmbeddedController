/* Copyright 2022 The ChromiumOS Authors
 * Use of this source code is governed by a BSD-style license that can be
 * found in the LICENSE file.
 */

/ {
	displight {
		compatible = "cros-ec,displight";
		pwms = <&pwm5 0 PWM_HZ(4800) PWM_POLARITY_NORMAL>;
		generic-pwm-channel = <1>;
	};
};

&pwm5 {
	status = "okay";
	pinctrl-0 = <&pwm5_gpb7>;
	pinctrl-names = "default";
};
