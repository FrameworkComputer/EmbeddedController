## CMakeLists.txt
```
# Copyright 2022 The ChromiumOS Authors
# Use of this source code is governed by a BSD-style license that can be
# found in the LICENSE file.

cmake_minimum_required(VERSION 3.13.1)

find_package(Zephyr REQUIRED HINTS "${ZEPHYR_BASE}")

if (NOT DEFINED CONFIG_BOARD_INTEL_ISH_5_8_0)
project(intelrvp)

cros_ec_library_include_directories(include)
cros_ec_library_include_directories("${PLATFORM_EC}/driver/charger")
cros_ec_library_include_directories("${PLATFORM_EC}/driver/ppc")
cros_ec_library_include_directories("${PLATFORM_EC}/driver/tcpm")
cros_ec_library_include_directories("${PLATFORM_EC}/driver/usb_mux")
zephyr_library_sources("src/intelrvp.c")
zephyr_library_sources("src/intel_rvp_board_id.c")
endif()

zephyr_library_sources_ifdef(CONFIG_PLATFORM_EC_KEYBOARD_STRAUSS "src/kbd_strauss.c")

if((DEFINED CONFIG_BOARD_ADLRVP_MCHP) OR (DEFINED CONFIG_BOARD_ADLRVP_NPCX))
  add_subdirectory(adlrvp)
  zephyr_library_sources_ifdef(CONFIG_PLATFORM_EC_USBC "src/usb_pd_policy_mecc_1_0.c")
  zephyr_library_sources_ifdef(CONFIG_PLATFORM_EC_USBC "src/chg_usb_pd_mecc_1_0.c")
  zephyr_library_sources_ifdef(CONFIG_PLATFORM_EC_USBC "src/chg_usb_pd.c")
  zephyr_library_sources_ifdef(CONFIG_PLATFORM_EC_LED_PWM "src/intel_rvp_led.c")
endif()

if((DEFINED CONFIG_BOARD_MTLRVP_M1723) OR (DEFINED CONFIG_BOARD_MTLRVP_MCHP) OR
    (DEFINED CONFIG_BOARD_MTLRVP_NPCX) OR (DEFINED CONFIG_BOARD_MTLRVP_PD))
  add_subdirectory(mtlrvp)
  zephyr_library_sources_ifdef(CONFIG_PLATFORM_EC_USB_PD_TCPMV2 "src/usb_pd_policy_mecc_1_1.c")
  zephyr_library_sources_ifdef(CONFIG_PLATFORM_EC_USB_PD_TCPMV2 "src/chg_usb_pd_mecc_1_1.c")
  zephyr_library_sources_ifdef(CONFIG_PLATFORM_EC_USB_PD_TCPMV2 "src/chg_usb_tcpc.c")
  zephyr_library_sources_ifdef(CONFIG_PLATFORM_EC_DEDICATED_CHARGE_PORT "src/dc_jack.c")
endif()

if(DEFINED CONFIG_BOARD_PTLRVP_COMMON)
  add_subdirectory(ptlrvp)
  zephyr_library_sources_ifdef(CONFIG_PLATFORM_EC_DEDICATED_CHARGE_PORT "src/dc_jack.c")
endif()

if(DEFINED CONFIG_BOARD_PTLGCS)
  zephyr_library_sources("src/kbd_gcs.c")
endif()

add_subdirectory_ifdef(CONFIG_BOARD_INTEL_ISH_5_8_0 ish)
```

## Kconfig
```
# Copyright 2022 The ChromiumOS Authors
# Use of this source code is governed by a BSD-style license that can be
# found in the LICENSE file.

config BOARD_ADLRVP_MCHP
	bool "Intel ADLRVP_MCHP board"
	depends on SOC_MEC172X_NSZ
	help
	  Build Intel ADLRVP_MCHP reference board. This board has Intel ADL RVP
	  SoC with MEC1727 EC.

config BOARD_ADLRVP_NPCX
	bool "Intel ADLRVP_NPCX board"
	depends on SOC_NPCX9M7F
	help
	  Build Intel ADLRVP_NPCX reference board. This board has Intel ADL RVP
	  SoC with NPCX9M37F EC.

config BOARD_MTLRVP_M1723
	bool "Intel MTLRVP_MCHP board"
	depends on SOC_MEC172X_NSZ
	help
	  Build Intel MTLRVP_MCHP reference board. This board has Intel MTL RVP
	  SoC with MEC1723 EC

config BOARD_MTLRVP_MCHP
	bool "Intel MTLRVP_MCHP board"
	depends on SOC_MEC172X_NSZ
	help
	  Build Intel MTLRVP_MCHP reference board. This board has Intel MTL RVP
	  SoC with MEC1727 EC

config BOARD_MTLRVP_NPCX
	bool "Intel MTLRVP_NPCX board"
	depends on SOC_NPCX9M3F
	help
	  Build Intel MTLRVP_NPCX reference board. This board is Intel MTL RVP
	  SOC with NPCX_NPCX9M3F

config BOARD_PTLRVP_COMMON
	bool "Intel PTLRVP common"
	help
	  Build Intel PTLRVP common files. This config can be used by different
	  MECC vendors using PTLRVP for the EC enablement.

config BOARD_PTLRVP_NPCX
	bool "Intel PTLRVP_NPCX board"
	depends on SOC_NPCX9M7F
	select BOARD_PTLRVP_COMMON
	help
	  Build Intel PTLRVP_NPCX reference board. This board is Intel PTL RVP
	  SOC with SOC_NPCX9M7F.

config BOARD_PTLRVP_MCHP
	bool "Intel PTLRVP_MCHP board"
	depends on SOC_MEC172X_NSZ
	select BOARD_PTLRVP_COMMON
	help
	  Build Intel PTLRVP_MCHP reference board. This board is Intel PTL RVP
	  SOC with SOC_MEC172X_NSZ.

config BOARD_PTLGCS
	bool "Intel PTLRVP_MCHP board"
	depends on SOC_MEC172X_NSZ
	select BOARD_PTLRVP_COMMON
	help
	  Build Intel PTL Generic Chassis System (GCS). This board is Intel PTL
	  GCS SOC with SOC_MEC172X_NSZ.

# Override the default USB-C stack choice baseed on the board type.
# This must be done before including Kconfig.zephyr below.
choice PLATFORM_EC_USBC_STACK
	default PLATFORM_EC_USB_PD_CONTROLLER \
		if BOARD_MTLRVP_PD || BOARD_PTLRVP_COMMON
endchoice

source "Kconfig.zephyr"
```

## prj.conf
```kconfig
# Copyright 2022 The ChromiumOS Authors
# Use of this source code is governed by a BSD-style license that can be
# found in the LICENSE file.


CONFIG_CROS_EC=y
CONFIG_PLATFORM_EC_LTO=y
CONFIG_PLATFORM_EC=y
CONFIG_PLATFORM_EC_POWER_BUTTON=y
CONFIG_PLATFORM_EC_LID_SWITCH=y
CONFIG_PLATFORM_EC_EXTPOWER_GPIO=y

# Battery
CONFIG_PLATFORM_EC_BATTERY_CUT_OFF=y
CONFIG_PLATFORM_EC_BATTERY_FUEL_GAUGE=y
CONFIG_PLATFORM_EC_BATTERY_PRESENT_GPIO=y
CONFIG_PLATFORM_EC_BATTERY_REVIVE_DISCONNECT=y
CONFIG_PLATFORM_EC_CHARGER_MIN_POWER_MW_FOR_POWER_ON_WITH_BATT=15000
CONFIG_PLATFORM_EC_CHARGER_MIN_POWER_MW_FOR_POWER_ON=15001
CONFIG_PLATFORM_EC_CHARGER_MIN_INPUT_CURRENT_LIMIT=512

#Power Sequencing
CONFIG_PLATFORM_EC_BOARD_RESET_AFTER_POWER_ON=y

# Host command
CONFIG_PLATFORM_EC_HOSTCMD_AP_RESET=y
CONFIG_PLATFORM_EC_PORT80=y

# USB-C and PD
CONFIG_PLATFORM_EC_USB_VID=0x18d1
CONFIG_PLATFORM_EC_USB_PID=0x8086
CONFIG_PLATFORM_EC_USB_PD_REQUIRE_AP_MODE_ENTRY=y
CONFIG_PLATFORM_EC_TCPC_INTERRUPT=n

# eSPI
CONFIG_ESPI=y
CONFIG_PLATFORM_EC_HOST_INTERFACE_ESPI_VW_SLP_S3=y
CONFIG_PLATFORM_EC_HOST_INTERFACE_ESPI_VW_SLP_S4=y
CONFIG_PLATFORM_EC_HOST_INTERFACE_ESPI_VW_SLP_S5=y

# Keyboard
CONFIG_PLATFORM_EC_KEYBOARD_PROTOCOL_8042=y
CONFIG_PLATFORM_EC_KEYBOARD_COL2_INVERTED=y
CONFIG_PLATFORM_EC_VOLUME_BUTTONS=y
CONFIG_PLATFORM_EC_CMD_BUTTON=n

# Shell Commands
CONFIG_SHELL_HELP=y
CONFIG_SHELL_HISTORY=y
CONFIG_SHELL_TAB=y
CONFIG_SHELL_TAB_AUTOCOMPLETION=y
CONFIG_KERNEL_SHELL=y

CONFIG_SYSTEM_BOOT_TIME_LOGGING=y

# TODO
# Below conf are disabled to compile successfully
# These will be enabled in upcoming CLs
CONFIG_PLATFORM_EC_BACKLIGHT_LID=n
```

## program.conf
```kconfig
# Copyright 2022 The ChromiumOS Authors
# Use of this source code is governed by a BSD-style license that can be
# found in the LICENSE file.


CONFIG_CROS_EC=y
CONFIG_PLATFORM_EC=y
CONFIG_PLATFORM_EC_POWER_BUTTON=y
CONFIG_PLATFORM_EC_LID_SWITCH=y
CONFIG_PLATFORM_EC_EXTPOWER_GPIO=y

# Postcode
CONFIG_PLATFORM_EC_PORT80=y
CONFIG_PLATFORM_EC_PORT80_4_BYTE=y

# Battery
CONFIG_PLATFORM_EC_BATTERY_CUT_OFF=y
CONFIG_PLATFORM_EC_BATTERY_FUEL_GAUGE=y
CONFIG_PLATFORM_EC_BATTERY_PRESENT_GPIO=y
CONFIG_PLATFORM_EC_BATTERY_REVIVE_DISCONNECT=y
CONFIG_PLATFORM_EC_CHARGER_MIN_POWER_MW_FOR_POWER_ON_WITH_BATT=15000
CONFIG_PLATFORM_EC_CHARGER_MIN_POWER_MW_FOR_POWER_ON=15001

#Power Sequencing
CONFIG_PLATFORM_EC_BOARD_RESET_AFTER_POWER_ON=y

# Host command
CONFIG_PLATFORM_EC_HOSTCMD_AP_RESET=y
CONFIG_PLATFORM_EC_PORT80=y

# USB-C and PD
CONFIG_PLATFORM_EC_USB_VID=0x18d1
CONFIG_PLATFORM_EC_USB_PID=0x8086
CONFIG_PLATFORM_EC_USB_PD_REQUIRE_AP_MODE_ENTRY=y
CONFIG_PLATFORM_EC_TCPC_INTERRUPT=n

# eSPI
CONFIG_ESPI=y
CONFIG_PLATFORM_EC_HOST_INTERFACE_ESPI_VW_SLP_S3=y
CONFIG_PLATFORM_EC_HOST_INTERFACE_ESPI_VW_SLP_S4=y
CONFIG_PLATFORM_EC_HOST_INTERFACE_ESPI_VW_SLP_S5=y

# Keyboard
CONFIG_PLATFORM_EC_KEYBOARD_PROTOCOL_8042=y
CONFIG_PLATFORM_EC_VOLUME_BUTTONS=y
CONFIG_PLATFORM_EC_CMD_BUTTON=n

# Shell Commands
CONFIG_SHELL_HELP=y
CONFIG_SHELL_HISTORY=y
CONFIG_SHELL_TAB=y
# Disable autocompletion to save space
CONFIG_SHELL_TAB_AUTOCOMPLETION=n
CONFIG_KERNEL_SHELL=y

CONFIG_SYSTEM_BOOT_TIME_LOGGING=y

# TODO
# Below conf are disabled to compile successfully
# These will be enabled in upcoming CLs
CONFIG_PLATFORM_EC_BACKLIGHT_LID=n
```

## zephyr_ap_pwrseq.conf
```kconfig
# Copyright 2022 The ChromiumOS Authors
# Use of this source code is governed by a BSD-style license that can be
# found in the LICENSE file.

# Zephyr Inbuilt AP Power Sequencing Config
CONFIG_X86_NON_DSX_PWRSEQ_CONSOLE=y
CONFIG_X86_NON_DSX_PWRSEQ_HOST_CMD=y
CONFIG_AP_PWRSEQ_S0IX=y
```

## include/intel_rvp_board_id.h
```c
/* Copyright 2022 The ChromiumOS Authors
 * Use of this source code is governed by a BSD-style license that can be
 * found in the LICENSE file.
 */

#ifndef __INTEL_RVP_BOARD_ID_H
#define __INTEL_RVP_BOARD_ID_H

#include <zephyr/drivers/gpio.h>

#define DT_DRV_COMPAT intel_rvp_board_id

#define RVP_ID_HAS_BOM_GPIOS DT_NODE_HAS_PROP(DT_DRV_INST(0), bom_gpios)

#define RVP_ID_HAS_FAB_GPIOS DT_NODE_HAS_PROP(DT_DRV_INST(0), fab_gpios)

#if RVP_ID_HAS_BOM_GPIOS
extern const struct gpio_dt_spec bom_id_config[];
#endif

#if RVP_ID_HAS_FAB_GPIOS
extern const struct gpio_dt_spec fab_id_config[];
#endif

extern const struct gpio_dt_spec board_id_config[];

#endif /* __INTEL_RVP_BOARD_ID_H */
```

## include/intelrvp.h
```c
/* Copyright 2022 The ChromiumOS Authors
 * Use of this source code is governed by a BSD-style license that can be
 * found in the LICENSE file.
 */
#ifndef __INTELRVP_BOARD_H
#define __INTELRVP_BOARD_H

#include "compiler.h"
#include "gpio_signal.h"
#include "stdbool.h"

/* RVP ID read retry count */
#define RVP_VERSION_READ_RETRY_CNT 2

#define DC_JACK_MAX_VOLTAGE_MV 19000

FORWARD_DECLARE_ENUM(tcpc_rp_value);

/* TCPC AIC Config for MECC1.0 */
struct mecc_1_0_tcpc_aic_gpio_config_t {
	/* TCPC interrupt */
	enum gpio_signal tcpc_alert;
	/* PPC interrupt */
	enum gpio_signal ppc_alert;
	/* PPC interrupt handler */
	void (*ppc_intr_handler)(int port);
};
extern const struct mecc_1_0_tcpc_aic_gpio_config_t mecc_1_0_tcpc_aic_gpios[];

/* TCPC AIC Config for MECC1.1 */
struct mecc_1_1_tcpc_aic_gpio_config_t {
	/* TCPC interrupt */
	enum gpio_signal tcpc_alert;
};
extern const struct mecc_1_1_tcpc_aic_gpio_config_t mecc_1_1_tcpc_aic_gpios[];

void board_charging_enable(int port, int enable);
void board_vbus_enable(int port, int enable);
void board_set_vbus_source_current_limit(int port, enum tcpc_rp_value rp);
void board_dc_jack_interrupt(enum gpio_signal signal);
bool is_typec_port(int port);

#ifdef CONFIG_ZTEST
void board_charge_init(void);
#endif

#endif /* __INTELRVP_BOARD_H */
```

## include/kbd_gcs.h
```c
/* Copyright 2025 The ChromiumOS Authors
 * Use of this source code is governed by a BSD-style license that can be
 * found in the LICENSE file.
 */

/* Keyboard configuration */

#ifndef __KBD_GCS_H
#define __KBD_GCS_H

/*
 * KEYBOARD_COLS_MAX has the build time column size. It's used to allocate
 * exact spaces for arrays. Actual keyboard scanning is done using
 * keyboard_cols, which holds a runtime column size.
 */
#undef KEYBOARD_COLS_MAX

#define KEYBOARD_COLS_MAX 16

#endif /* __KBD_GCS_H */
```

## include/kbd_strauss.h
```c
/* Copyright 2025 The ChromiumOS Authors
 * Use of this source code is governed by a BSD-style license that can be
 * found in the LICENSE file.
 */

/* Keyboard configuration */

#ifndef __KBD_STRAUSS_H
#define __KBD_STRAUSS_H

/*
 * KEYBOARD_COLS_MAX has the build time column size. It's used to allocate
 * exact spaces for arrays. Actual keyboard scanning is done using
 * keyboard_cols, which holds a runtime column size.
 */
#undef KEYBOARD_COLS_MAX

#define KEYBOARD_COLS_MAX 17

#endif /* __KBD_STRAUSS_H */
```

## include/keyboard_customization.h
```c
/* Copyright 2025 The ChromiumOS Authors
 * Use of this source code is governed by a BSD-style license that can be
 * found in the LICENSE file.
 */
/* Keyboard configuration */

#ifndef __KEYBOARD_CUSTOMIZATION_H
#define __KEYBOARD_CUSTOMIZATION_H

#ifdef CONFIG_PLATFORM_EC_KEYBOARD_STRAUSS
#include "kbd_strauss.h"
#elif defined(CONFIG_BOARD_PTLGCS)
#include "kbd_gcs.h"
#endif

#endif /* __KEYBOARD_CUSTOMIZATION_H */
```

## src/chg_usb_pd.c
```c
/* Copyright 2019 The ChromiumOS Authors
 * Use of this source code is governed by a BSD-style license that can be
 * found in the LICENSE file.
 */

/* Common USB PD charge configuration */

#include "charge_manager.h"
#include "charge_state.h"
#include "gpio.h"
#include "hooks.h"
#include "tcpm/tcpci.h"

#ifdef CONFIG_ZEPHYR
#include "intelrvp.h"
#endif /* CONFIG_ZEPHYR */

#define CPRINTF(format, args...) cprintf(CC_USBPD, format, ##args)
#define CPRINTS(format, args...) cprints(CC_USBPD, format, ##args)

bool is_typec_port(int port)
{
#if CONFIG_DEDICATED_CHARGE_PORT_COUNT > 0
	return !(port == DEDICATED_CHARGE_PORT || port == CHARGE_PORT_NONE);
#else
	return !(port == CHARGE_PORT_NONE);
#endif /* CONFIG_DEDICATED_CHARGE_PORT_COUNT > 0 */
}

static inline int board_dc_jack_present(void)
{
#if CONFIG_DEDICATED_CHARGE_PORT_COUNT > 0
	return gpio_get_level(GPIO_DC_JACK_PRESENT);
#else
	return 0;
#endif
}

#if CONFIG_DEDICATED_CHARGE_PORT_COUNT > 0
static void board_dc_jack_handle(void)
{
	struct charge_port_info charge_dc_jack;

	/* System is booted from DC Jack */
	if (board_dc_jack_present()) {
		charge_dc_jack.current = (CONFIG_USB_PD_MAX_POWER_MW * 1000) /
					 DC_JACK_MAX_VOLTAGE_MV;
		charge_dc_jack.voltage = DC_JACK_MAX_VOLTAGE_MV;
	} else {
		charge_dc_jack.current = 0;
		charge_dc_jack.voltage = USB_CHARGER_VOLTAGE_MV;
	}

	charge_manager_update_charge(CHARGE_SUPPLIER_DEDICATED,
				     DEDICATED_CHARGE_PORT, &charge_dc_jack);
}
#endif

void board_dc_jack_interrupt(enum gpio_signal signal)
{
#if CONFIG_DEDICATED_CHARGE_PORT_COUNT > 0
	board_dc_jack_handle();
#endif
}

static void board_charge_init(void)
{
	int port, supplier;
	struct charge_port_info charge_init = {
		.current = 0,
		.voltage = USB_CHARGER_VOLTAGE_MV,
	};

	/* Initialize all charge suppliers to seed the charge manager */
	for (port = 0; port < CHARGE_PORT_COUNT; port++) {
		for (supplier = 0; supplier < CHARGE_SUPPLIER_COUNT; supplier++)
			charge_manager_update_charge(supplier, port,
						     &charge_init);
	}

#if CONFIG_DEDICATED_CHARGE_PORT_COUNT > 0
	board_dc_jack_handle();
#endif /* CONFIG_DEDICATED_CHARGE_PORT_COUNT > 0 */
}
DECLARE_HOOK(HOOK_INIT, board_charge_init, HOOK_PRIO_DEFAULT);

int board_set_active_charge_port(int port)
{
	int i;
	/* charge port is a realy physical port */
	int is_real_port = (port >= 0 && port < CHARGE_PORT_COUNT);
	/* check if we are source vbus on that port */
	int source = board_vbus_source_enabled(port);

	if (is_real_port && source) {
		CPRINTS("Skip enable p%d", port);
		return EC_ERROR_INVAL;
	}

#if CONFIG_DEDICATED_CHARGE_PORT_COUNT > 0
	/*
	 * Do not enable Type-C port if the DC Jack is present.
	 * When the Type-C is active port, hardware circuit will
	 * block DC jack from enabling +VADP_OUT.
	 */
	if (port != DEDICATED_CHARGE_PORT && board_dc_jack_present()) {
		CPRINTS("DC Jack present, Skip enable p%d", port);
		return EC_ERROR_INVAL;
	}
#endif /* CONFIG_DEDICATED_CHARGE_PORT_COUNT */

	/* Make sure non-charging ports are disabled */
	for (i = 0; i < CONFIG_USB_PD_PORT_MAX_COUNT; i++) {
		if (i == port)
			continue;

		board_charging_enable(i, 0);
	}

	/* Enable charging port */
	if (is_typec_port(port))
		board_charging_enable(port, 1);

	CPRINTS("New chg p%d", port);

	return EC_SUCCESS;
}
```

## src/chg_usb_pd_mecc_1_1.c
```c
/* Copyright 2022 The ChromiumOS Authors
 * Use of this source code is governed by a BSD-style license that can be
 * found in the LICENSE file.
 */

/* Intel-RVP family-specific configuration */

#include "console.h"
#include "gpio/gpio_int.h"
#include "hooks.h"
#include "include/gpio.h"
#include "intelrvp.h"
#include "ioexpander.h"
#include "system.h"
#include "tcpm/tcpci.h"
#include "usbc_ppc.h"

#define CPRINTF(format, args...) cprintf(CC_USBPD, format, ##args)
#define CPRINTS(format, args...) cprints(CC_USBPD, format, ##args)

uint16_t tcpc_get_alert_status(void)
{
	uint16_t status = 0;
	int i;

	/* Check which port has the ALERT line set */
	for (i = 0; i < CONFIG_USB_PD_PORT_MAX_COUNT; i++) {
		/* No alerts for embdeded TCPC */
		if (tcpc_config[i].bus_type == EC_BUS_TYPE_EMBEDDED) {
			continue;
		}

		if (!gpio_get_level(mecc_1_1_tcpc_aic_gpios[i].tcpc_alert)) {
			status |= PD_STATUS_TCPC_ALERT_0 << i;
		}
	}

	return status;
}

void board_charging_enable(int port, int enable)
{
	int rv;

	if (board_port_has_ppc(port)) {
		rv = ppc_vbus_sink_enable(port, enable);
	} else {
		rv = tcpc_config[port].drv->set_snk_ctrl(port, enable);
	}

	if (rv) {
		CPRINTS("C%d: sink path %s failed", port,
			enable ? "en" : "dis");
	}
}
```

## src/chg_usb_tcpc.c
```c
/* Copyright 2024 The ChromiumOS Authors
 * Use of this source code is governed by a BSD-style license that can be
 * found in the LICENSE file.
 */

#include "charge_manager.h"
#include "hooks.h"
#include "intelrvp.h"
#include "tcpm/tcpci.h"

#include <zephyr/logging/log.h>

LOG_MODULE_REGISTER(chg_usb_tcpc, LOG_LEVEL_INF);

int board_set_active_charge_port(int port)
{
	int i;
	/* charge port is a realy physical port */
	int is_real_port = (port >= 0 && port < CHARGE_PORT_COUNT);
	/* check if we are source vbus on that port */
	int source = board_vbus_source_enabled(port);

	if (is_real_port && source) {
		LOG_ERR("Skip enable p%d", port);
		return EC_ERROR_INVAL;
	}

#if CONFIG_DEDICATED_CHARGE_PORT_COUNT > 0
	/*
	 * Do not enable Type-C port if the DC Jack is present.
	 * When the Type-C is active port, hardware circuit will
	 * block DC jack from enabling +VADP_OUT.
	 */
	if (port != DEDICATED_CHARGE_PORT && board_is_dc_jack_present()) {
		LOG_ERR("DC Jack present, Skip enable p%d", port);
		return EC_ERROR_INVAL;
	}
#endif /* CONFIG_DEDICATED_CHARGE_PORT_COUNT */

	/* Make sure non-charging ports are disabled */
	for (i = 0; i < CONFIG_USB_PD_PORT_MAX_COUNT; i++) {
		if (i != port) {
			board_charging_enable(i, 0);
		}
	}

	/* Enable charging port */
	if (is_typec_port(port)) {
		board_charging_enable(port, 1);
	}

	LOG_INF("New chg p%d", port);

	return EC_SUCCESS;
}
```

## src/dc_jack.c
```c
/* Copyright 2024 The ChromiumOS Authors
 * Use of this source code is governed by a BSD-style license that can be
 * found in the LICENSE file.
 */

/* DC Jack configuration */

#include "charge_manager.h"
#include "gpio.h"
#include "gpio/gpio_int.h"
#include "hooks.h"
#include "intelrvp.h"
#include "tcpm/tcpci.h"

#include <zephyr/init.h>

static struct k_work dc_jack_handle;

bool is_typec_port(int port)
{
	return !(port == DEDICATED_CHARGE_PORT || port == CHARGE_PORT_NONE);
}

int board_is_dc_jack_present(void)
{
	return gpio_pin_get_dt(GPIO_DT_FROM_NODELABEL(std_adp_prsnt));
}

static void board_dc_jack_handler(struct k_work *dc_jack_work)
{
	struct charge_port_info charge_dc_jack;

	/* System is booted from DC Jack */
	if (board_is_dc_jack_present()) {
		charge_dc_jack.current =
			min((CONFIG_PLATFORM_EC_USB_PD_MAX_POWER_MW * 1000) /
				    DC_JACK_MAX_VOLTAGE_MV,
			    CONFIG_PLATFORM_EC_USB_PD_MAX_CURRENT_MA);
		charge_dc_jack.voltage = DC_JACK_MAX_VOLTAGE_MV;
	} else {
		charge_dc_jack.current = 0;
		charge_dc_jack.voltage = 0;
	}

	charge_manager_update_charge(CHARGE_SUPPLIER_DEDICATED,
				     DEDICATED_CHARGE_PORT, &charge_dc_jack);
}

void board_dc_jack_interrupt(enum gpio_signal signal)
{
	k_work_submit(&dc_jack_handle);
}

test_export_static void board_charge_init(void)
{
	k_work_init(&dc_jack_handle, board_dc_jack_handler);

	/* Handler not deffered during Board charge initialization */
	board_dc_jack_handler(NULL);
	gpio_enable_dt_interrupt(GPIO_INT_FROM_NODELABEL(int_dc_jack_present));
}
#ifdef CONFIG_USB_PDC_POWER_MGMT
static int board_charge_sys_init(void)
{
	board_charge_init();
	return 0;
}
SYS_INIT(board_charge_sys_init, APPLICATION, CONFIG_APPLICATION_INIT_PRIORITY);
#else
DECLARE_HOOK(HOOK_INIT, board_charge_init, HOOK_PRIO_POST_CHARGE_MANAGER);
#endif
```

## src/intel_rvp_board_id.c
```c
/* Copyright 2022 The ChromiumOS Authors
 * Use of this source code is governed by a BSD-style license that can be
 * found in the LICENSE file.
 */

#include "intel_rvp_board_id.h"

#include <zephyr/devicetree.h>

#define DT_DRV_COMPAT intel_rvp_board_id

BUILD_ASSERT(DT_NUM_INST_STATUS_OKAY(DT_DRV_COMPAT) <= 1,
	     "Unsupported RVP Board ID instance");

#define RVP_ID_GPIO_DT_SPEC_GET(idx, node_id, prop) \
	GPIO_DT_SPEC_GET_BY_IDX(node_id, prop, idx),

#define RVP_ID_CONFIG_LIST(node_id, prop)                                \
	LISTIFY(DT_PROP_LEN(node_id, prop), RVP_ID_GPIO_DT_SPEC_GET, (), \
		node_id, prop)

#if DT_HAS_COMPAT_STATUS_OKAY(DT_DRV_COMPAT)
#if RVP_ID_HAS_BOM_GPIOS
const struct gpio_dt_spec bom_id_config[] = { RVP_ID_CONFIG_LIST(DT_DRV_INST(0),
								 bom_gpios) };
#endif

#if RVP_ID_HAS_FAB_GPIOS
const struct gpio_dt_spec fab_id_config[] = { RVP_ID_CONFIG_LIST(DT_DRV_INST(0),
								 fab_gpios) };
#endif

const struct gpio_dt_spec board_id_config[] = { RVP_ID_CONFIG_LIST(
	DT_DRV_INST(0), board_gpios) };
#endif /* #if DT_HAS_COMPAT_STATUS_OKAY */
```

## src/intel_rvp_led.c
```c
/* Copyright 2022 The ChromiumOS Authors
 * Use of this source code is governed by a BSD-style license that can be
 * found in the LICENSE file.
 */

#include "battery.h"
#include "charge_manager.h"
#include "charge_state.h"
#include "chipset.h"
#include "common.h"
#include "console.h"
#include "ec_commands.h"
#include "extpower.h"
#include "hooks.h"
#include "led_common.h"
#include "led_pwm.h"
#include "pwm.h"
#include "timer.h"
#include "util.h"

/* Battery percentage thresholds to blink at different rates. */
#define LOW_BATTERY_PERCENTAGE 10
#define NORMAL_BATTERY_PERCENTAGE 90

#define LED_OFF -1

#define LED_PULSE_TICK (125 * USEC_PER_MSEC)

#define LED_FAST_PULSE_PERIOD (250 / 125) /* 250 ms */
#define LED_SLOW_PULSE_PERIOD ((2 * USEC_PER_MSEC) / 125) /* 2 sec  */

struct led_pulse_data {
	bool led_is_pulsing;
	uint8_t led_pulse_period;
	uint8_t led_tick_count;
};

static struct led_pulse_data rvp_led[CONFIG_LED_PWM_COUNT];

static void pulse_led_deferred(void);
DECLARE_DEFERRED(pulse_led_deferred);

static void pulse_led_deferred(void)
{
	int i = 0;
	bool call_deferred = false;

	for (i = 0; i < CONFIG_LED_PWM_COUNT; i++) {
		if (!rvp_led[i].led_is_pulsing) {
			rvp_led[i].led_tick_count = 0;
			continue;
		}

		/*
		 * LED will be in ON state first half of the pulse period
		 * and in OFF state in second half of the pulse period.
		 */
		if (rvp_led[i].led_tick_count <
		    (rvp_led[i].led_pulse_period >> 1))
			set_pwm_led_color(i, EC_LED_COLOR_GREEN);
		else
			set_pwm_led_color(i, LED_OFF);

		rvp_led[i].led_tick_count = (rvp_led[i].led_tick_count + 1) %
					    rvp_led[i].led_pulse_period;
		call_deferred = true;
	}

	if (call_deferred)
		hook_call_deferred(&pulse_led_deferred_data, LED_PULSE_TICK);
}

static void pulse_leds(enum pwm_led_id id, int period)
{
	rvp_led[id].led_pulse_period = period;
	rvp_led[id].led_is_pulsing = true;

	pulse_led_deferred();
}

static void update_charger_led(enum pwm_led_id id)
{
	enum led_pwr_state chg_st = led_pwr_get_state();

	/*
	 * The colors listed below are the default, but can be overridden.
	 *
	 * Fast Flash = Charging error
	 * Slow Flash = Discharging
	 * LED on     = Charging
	 * LED off    = No Charger connected
	 */
	if (chg_st == LED_PWRS_CHARGE || chg_st == LED_PWRS_CHARGE_NEAR_FULL) {
		/* Charging: LED ON */
		rvp_led[id].led_is_pulsing = false;
		set_pwm_led_color(id, EC_LED_COLOR_GREEN);
	} else if (chg_st == LED_PWRS_DISCHARGE ||
		   chg_st == LED_PWRS_DISCHARGE_FULL) {
		if (extpower_is_present()) {
			/* Discharging:
			 * Flash slower (2 second period, 100% duty cycle)
			 */
			pulse_leds(id, LED_SLOW_PULSE_PERIOD);
		} else {
			/* No Charger connected: LED OFF */
			rvp_led[id].led_is_pulsing = false;
			set_pwm_led_color(id, LED_OFF);
		}
	} else if (chg_st == LED_PWRS_ERROR) {
		/* Charging error:
		 * Flash faster (250 ms period, 100% duty cycle)
		 */
		pulse_leds(id, LED_FAST_PULSE_PERIOD);
	} else {
		/* LED OFF */
		rvp_led[id].led_is_pulsing = false;
		set_pwm_led_color(id, LED_OFF);
	}
}

static void update_battery_led(enum pwm_led_id id)
{
	/*
	 * Fast Flash = Low Battery
	 * Slow Flash = Normal Battery
	 * LED on     = Full Battery
	 * LED off    = No Battery
	 */
	if (battery_is_present() == BP_YES) {
		int batt_percentage = charge_get_percent();

		if (batt_percentage < LOW_BATTERY_PERCENTAGE) {
			/* Low Battery:
			 * Flash faster (250 ms period, 100% duty cycle)
			 */
			pulse_leds(id, LED_FAST_PULSE_PERIOD);
		} else if (batt_percentage < NORMAL_BATTERY_PERCENTAGE) {
			/* Normal Battery:
			 * Flash slower (2 second period, 100% duty cycle)
			 */
			pulse_leds(id, LED_SLOW_PULSE_PERIOD);
		} else {
			/* Full Battery: LED ON */
			rvp_led[id].led_is_pulsing = false;
			set_pwm_led_color(id, EC_LED_COLOR_GREEN);
		}
	} else {
		/* No Battery: LED OFF */
		rvp_led[id].led_is_pulsing = false;
		set_pwm_led_color(id, LED_OFF);
	}
}

static void init_rvp_leds_off(void)
{
	/* Turn off LEDs such that they are in a known state with zero duty. */
	set_pwm_led_color(PWM_LED0, LED_OFF);
	set_pwm_led_color(PWM_LED1, LED_OFF);
}
DECLARE_HOOK(HOOK_INIT, init_rvp_leds_off, HOOK_PRIO_POST_PWM);

static void update_led(void)
{
	update_battery_led(PWM_LED0);
	update_charger_led(PWM_LED1);
}
DECLARE_HOOK(HOOK_SECOND, update_led, HOOK_PRIO_DEFAULT);
```

## src/intelrvp.c
```c
/* Copyright 2022 The ChromiumOS Authors
 * Use of this source code is governed by a BSD-style license that can be
 * found in the LICENSE file.
 */

/* TODO: b/218904113: Convert to using Zephyr GPIOs */
#include "gpio.h"
#include "hooks.h"

#ifndef CONFIG_PLATFORM_EC_SHARED_SPI_FLASH
static void board_init(void)
{
	/* Enable SOC SPI */
	gpio_pin_set_dt(GPIO_DT_FROM_NODELABEL(ec_spi_oe_mecc), 1);
}
DECLARE_HOOK(HOOK_INIT, board_init, HOOK_PRIO_LAST);
#endif

__override void intel_x86_sys_reset_delay(void)
{
	/*
	 * From MAX6818 Data sheet, Range of 'Debounce Duaration' is
	 * Minimum - 20 ms, Typical - 40 ms, Maximum - 80 ms.
	 * See b/153128296.
	 */
	k_busy_wait(60 * USEC_PER_MSEC);
}
```
