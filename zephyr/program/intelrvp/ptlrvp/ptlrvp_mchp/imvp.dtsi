/* Copyright 2026 The ChromiumOS Authors
 * Use of this source code is governed by a BSD-style license that can be
 * found in the LICENSE file.
 */

#include <dt-bindings/imvp.h>
#include "i2c.dts"

&cros_imvp {
	update-data = <
		RT3645_UPDATE_ENTRY(RT3645_PAGE_4, ICCMAX_HC_SR_KTON_REG, 0xC1)
		RT3645_UPDATE_ENTRY(RT3645_PAGE_4, VBOOT_EN_RIMON_MSB_REG, 0x15)
		RT3645_UPDATE_ENTRY(RT3645_PAGE_4, RLL_REG, 0xA0)
		RT3645_UPDATE_ENTRY(RT3645_PAGE_4, COMP_MODE_PZ_REG, 0xC0)
		RT3645_UPDATE_ENTRY(RT3645_PAGE_4, SOCP_TH_ANTIOVS_TH_REG, 0x6B)
		RT3645_UPDATE_ENTRY(RT3645_PAGE_4, DEM_SHRINK_TON_REG, 0xD1)
		RT3645_UPDATE_ENTRY(RT3645_PAGE_4, SVID_DCLL_REG, 0xD8)
		RT3645_UPDATE_ENTRY(RT3645_PAGE_5, ZCD_I_TH_HYS_REG, 0x89)
		RT3645_UPDATE_ENTRY(RT3645_PAGE_6, ZCD_I_TH_HYS_REG, 0x89)
		RT3645_UPDATE_ENTRY(RT3645_PAGE_9, VSEN_COMP_LPF_REG, 0x3B)
		RT3645_UPDATE_ENTRY(RT3645_PAGE_9, DVID_ENHANCE_SPM_EN_REG, 0xBF)
		RT3645_UPDATE_ENTRY(RT3645_PAGE_A, ICCMAX_REG, 0x7C)
		RT3645_UPDATE_ENTRY(RT3645_PAGE_A, RIMON_REG, 0x90)
		RT3645_UPDATE_ENTRY(RT3645_PAGE_A, DVID_ENHANCE_SPM_EN_REG, 0x75)
		RT3645_UPDATE_ENTRY(RT3645_PAGE_B, DVID_ENHANCE_SPM_EN_REG, 0xAC)
		RT3645_UPDATE_ENTRY(RT3645_PAGE_C, DVID_ENHANCE_SPM_EN_REG, 0x8E)
		RT3645_UPDATE_ENTRY(RT3645_PAGE_D, SPM_TH2_A_B_REG, 0xDC)
		RT3645_UPDATE_ENTRY(RT3645_PAGE_D, SPM_HYS_DVIDUP_PH_A_REG, 0x50)
		RT3645_UPDATE_ENTRY(RT3645_PAGE_D, SPS_OFS_A_SPM_HYS_B_REG, 0x2B)
		RT3645_UPDATE_ENTRY(RT3645_PAGE_D, DVIDUP_PH_B_DVIDDN_PH_SET_REG, 0x40)
		RT3645_UPDATE_ENTRY(RT3645_PAGE_D, SPS_OFS_B_REG, 0xB8)
		>;
	update-crc = <0x12>;
};

