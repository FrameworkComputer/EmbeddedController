/* Copyright 2026 The ChromiumOS Authors
 * Use of this source code is governed by a BSD-style license that can be
 * found in the LICENSE file.
 */

#include "pd.dtsi"

&pdc_rtk_c0 {
	zephyr,deferred-init;
};

&pdc_rtk_c1 {
	zephyr,deferred-init;
};

&pdc_rtk_c2 {
	zephyr,deferred-init;
};
