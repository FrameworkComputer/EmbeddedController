/* Copyright 2026 The ChromiumOS Authors
 * Use of this source code is governed by a BSD-style license that can be
 * found in the LICENSE file.
 */

#include "usbc.dtsi"

&usbc_p0 {
	zephyr,deferred-init;
};

&usbc_p1 {
	zephyr,deferred-init;
};

&usbc_p2 {
	zephyr,deferred-init;
};
