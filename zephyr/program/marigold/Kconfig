## zephyr/projects/volteer/volteer/boards/arm/volteer/volteer_defconfig
```kconfig
# Copyright 2021 The Chromium OS Authors. All rights reserved.
# Use of this source code is governed by a BSD-style license that can be
# found in the LICENSE file.

# Zephyr Kernel Configuration
CONFIG_SOC_SERIES_NPCX7=y

# Platform Configuration
CONFIG_SOC_NPCX7M6FB=y # Actually NPCX7M6FC; C just has 512K Flash
CONFIG_BOARD_VOLTEER=y

# NPCX BootLoader Table Configuration
CONFIG_PLATFORM_EC_RO_HEADER_CORE_CLOCK_SPI_CLOCK_RATIO_2=y
CONFIG_PLATFORM_EC_RO_HEADER_SPI_MAX_CLOCK_50=y
CONFIG_PLATFORM_EC_RO_HEADER_SPI_READ_MODE_DUAL=y

# Serial Drivers
CONFIG_SERIAL=y
CONFIG_UART_INTERRUPT_DRIVEN=y

# Enable console
CONFIG_CONSOLE=y
CONFIG_UART_CONSOLE=y

# Pinmux Driver
CONFIG_PINMUX=y

# GPIO Controller
CONFIG_GPIO=y

# Clock configuration
CONFIG_CLOCK_CONTROL=y

# WATCHDOG configuration
CONFIG_WATCHDOG=y
# Set the delay time for printing panic data.
# 1 cycle is about 32ms. 500ms is about 16 cycles.
CONFIG_WDT_NPCX_DELAY_CYCLES=16

# PLL configuration
CONFIG_CLOCK_NPCX_OSC_CYCLES_PER_SEC=90000000
CONFIG_CLOCK_NPCX_APB1_PRESCALER=6
CONFIG_CLOCK_NPCX_APB2_PRESCALER=6
CONFIG_CLOCK_NPCX_APB3_PRESCALER=6

CONFIG_SYS_CLOCK_HW_CYCLES_PER_SEC=15000000

# The following are valid for all:
# Code RAM base for NPCX797FC
CONFIG_CROS_EC_PROGRAM_MEMORY_BASE=0x10070000
CONFIG_CROS_EC_RAM_BASE=0x200c0000
CONFIG_CROS_EC_DATA_RAM_SIZE=0x00010000
CONFIG_CROS_EC_RAM_SIZE=0x0000f800

# Image size: MAX (1/2 Flash size, Code RAM size)
# For NPCX796FC: Flash = 512 KiB, Code Ram 192 KiB
# For NPCX797FC: Flash = 512 KiB, Code Ram 320 KiB
CONFIG_CROS_EC_RO_MEM_OFF=0x0
CONFIG_CROS_EC_RO_SIZE=0x40000
# RW firmware in program memory - Identical to RO, only one image loaded at a
# time.
CONFIG_CROS_EC_RW_MEM_OFF=0x0
CONFIG_CROS_EC_RW_SIZE=0x40000

CONFIG_CROS_EC_HOOK_TICK_INTERVAL=200000

# ADC
# The resolution and oversamplig values are fixed by the NPCX ADC driver
CONFIG_PLATFORM_EC_ADC_RESOLUTION=10
CONFIG_PLATFORM_EC_ADC_OVERSAMPLING=0

CONFIG_FLASH_SIZE=512
```

## zephyr/shim/chip/npcx/Kconfig.npcx
```kconfig
# Copyright 2021 The ChromiumOS Authors
# Use of this source code is governed by a BSD-style license that can be
# found in the LICENSE file.

if PLATFORM_EC

config CROS_SYSTEM_NPCX_PRE_INIT_PRIORITY
	int "System pre-initialization priority"
	default 15
	range 10 19
	depends on SOC_FAMILY_NPCX
	help
	  This sets the priority of the NPCX chip system initialization. The
	  chip system initialization verifies the integrity of the BBRAM and
	  must be a lower priority than CONFIG_BBRAM_INIT_PRIORITY and
	  must be a higher priority than PLATFORM_EC_SYSTEM_PRE_INIT.

config PLATFORM_EC_CONSOLE_CMD_GPIODBG
	bool "Console command: gpiodbg"
	depends on SOC_FAMILY_NPCX
	help
	  Enable the "gpiodbg" command. This lists all IO pads used on platform
	  and turns on/off specific pad's input buffer to observe leakage
	  current through it.

	  Example:
	     gpiodbg list

	     IDX|ON| GPIO | Name
	     ---+--+------+----------
	     00 |* | io03 | recovery_l
	     01 |* | io93 | wp_l
	     02 |* | iod2 | ac_present
	     03 |* | io00 | power_button_l
	     04 |* | io01 | lid_open
	     05 |* | io36 | entering_rw
	     06 |* | io50 | pch_wake_l
	     07 |* | ioc7 | pgood_fan
	     08 |* | ioa5 | spi_cs_l
	     09 |* | io64 | board_version1
	     10 |* | io65 | board_version2
	     11 |* | io66 | board_version3
	     12 |* | io52 | unused pin
	     13 |* | io54 | unused pin

	     gpiodbg off 11
	     gpiodbg list

	     IDX|ON| GPIO | Name
	     ---+--+------+----------
	     00 |* | io03 | recovery_l
	     01 |* | io93 | wp_l
	     02 |* | iod2 | ac_present
	     03 |* | io00 | power_button_l
	     04 |* | io01 | lid_open
	     05 |* | io36 | entering_rw
	     06 |* | io50 | pch_wake_l
	     07 |* | ioc7 | pgood_fan
	     08 |* | ioa5 | spi_cs_l
	     09 |* | io64 | board_version1
	     10 |* | io65 | board_version2
	     11 |  | io66 | board_version3
	     12 |* | io52 | unused pin
	     13 |* | io54 | unused pin

endif # PLATFORM_EC
```

## zephyr/subsys/Kconfig
```kconfig
# Copyright 2022 The ChromiumOS Authors
# Use of this source code is governed by a BSD-style license that can be
# found in the LICENSE file.

rsource "ap_pwrseq/Kconfig"
rsource "host_service/Kconfig"
rsource "usb_dc/Kconfig"
rsource "pd_controller/Kconfig.usbc_altmode"
rsource "fingerprint/Kconfig"
```

## zephyr/subsys/ap_pwrseq/Kconfig
```kconfig
# Copyright 2022 The ChromiumOS Authors
# Use of this source code is governed by a BSD-style license that can be
# found in the LICENSE file.

menuconfig AP_PWRSEQ
	bool "AP Power sequencing support"
	default y
	depends on DT_HAS_INTEL_AP_PWRSEQ_ENABLED && !TEST_DISABLE_AP_PWRSEQ
	help
	  Enables AP power sequencing support with
	  embedded controller. This includes normal shutdown, critical
	  shutdown and reset handling.

if AP_PWRSEQ

module = AP_PWRSEQ
module-str = AP power sequencing
source "subsys/logging/Kconfig.template.log_config"

config AP_PWRSEQ_DRIVER
	bool "AP Power sequencing driver support"
	default y
	select SMF
	select SMF_ANCESTOR_SUPPORT
	select EVENTS
	help
	  AP power sequence driver establishes an underlaying framework to
	  easily add or extend AP Power Sequence action handler routines, it is
	  designed to follow the zephyr's State Machine Framework (SMF).

	  This version of power sequencing offers improved APIs when compared
	  to the alternatives and is meant to be the long-term default
	  solution. If in doubt, leave it enabled.

config AP_PWRSEQ_POWER_SIGNALS
	bool
	help
	  Enables power signals implementation for AP Power Sequence.

config AP_PWRSEQ_SIGNAL_ADC
	bool
	default y
	depends on DT_HAS_INTEL_AP_PWRSEQ_ADC_ENABLED
	select SENSOR
	help
	  Helper symbol to enable ADC based power sequencing.

config AP_PWRSEQ_SIGNAL_EXTERNAL
	bool
	default y
	depends on DT_HAS_INTEL_AP_PWRSEQ_EXTERNAL_ENABLED
	help
	  Helper symbol to enable external signal based power sequencing.

config AP_PWRSEQ_SIGNAL_GPIO
	bool
	default y
	depends on DT_HAS_INTEL_AP_PWRSEQ_GPIO_ENABLED
	help
	  Helper symbol to enable GPIO based power sequencing.

config AP_PWRSEQ_SIGNAL_VW
	bool
	default y
	depends on DT_HAS_INTEL_AP_PWRSEQ_VW_ENABLED
	help
	  Helper symbol to enable virtual wire (VW) based power sequencing.

config AP_PWRSEQ_SIGNAL_DEBUG_NAMES
	bool "Debug power sequence names"
	default y if PLATFORM_EC_BRINGUP
	help
	  Enable this option to allow display of the more descriptive
	  dbg-name based signal names.
	  Disable this option to just show the enum-name of the signals.
	  Enabled by default during bringup.

	  Disabling the option will save around 520 bytes of flash space.

config AP_PWRSEQ_AUTOSTART
	bool "Start the power sequence thread automatically"
	default n
	help
	  This option starts the AP power sequence task
	  at initialisation. If not set, ap_pwrseq_thread_start()
	  needs to be called to start the task.

	  Disable this option if there is other board or module
	  initialization that must occur before the AP power sequence
	  thread is started.

config AP_PWRSEQ_STACK_SIZE
	int "AP pwrseq stack size (in bytes)"
	help
	  This option specifies the size of the stack used by the
	  AP power sequencing state machine thread handler.
	  This must be set in a board configuration. If a default
	  is set here, it cannot be overridden (if necessary), since
	  this Kconfig appears before the EC chip specific stack
	  sizes.

config AP_PWRSEQ_THREAD_PRIORITY
	int "AP pwrseq thread priority"
	default 12
	help
	  This option determines AP power sequence thread priority, this number
	  must be selected in such way thread priority is in the middle of all
	  the enabled threads.

config X86_NON_DSX_PWRSEQ
	bool
	default n
	select AP_PWRSEQ_POWER_SIGNALS
	select HAS_TASK_POWERBTN
	select GPIO_GET_CONFIG
	help
	  This option enables Non Deep Sleep Well power sequencing for
	  Intel x86 chips.
	  Enabling this automatically enables HAS_TASK_POWERBTN since this task
	  is required to handle power button pressed/released by user.
	  Enabling this also enables retrieving the GPIO config feature
	  so that the value of output GPIOs can be determined.

config X86_NON_DSX_PWRSEQ_ADL
	bool "x86 Non Deep Sx power sequencing on ADL"
	depends on AP_X86_INTEL_ADL
	select X86_NON_DSX_PWRSEQ
	default n
	help
	  This enables AP power sequencing support for Intel Alderlake
	  family of chipset.

config X86_NON_DSX_PWRSEQ_MTL
	bool "x86 Non Deep Sx power sequencing on MTL"
	depends on AP_X86_INTEL_MTL
	select X86_NON_DSX_PWRSEQ
	default n
	help
	  This enables AP power sequencing support for Intel Meteorlake
	  family of chipset.

config X86_NON_DSX_PWRSEQ_CONSOLE
	bool "Console commands for x86 Non Deep Sx power sequencing"
	depends on X86_NON_DSX_PWRSEQ
	default n
	help
	  This option enables Non Deep Sleep Well power sequencing shell
	  console commands to debug.

config X86_NON_DSX_PWRSEQ_HOST_CMD
	bool "Host commands for x86 Non Deep Sx power sequencing"
	depends on X86_NON_DSX_PWRSEQ
	default y
	help
	  This option enables Non Deep Sleep Well power sequencing host
	  commands to debug.

config AP_PWRSEQ_HOST_SLEEP
	bool "Handle host sleep state changes"
	help
	  Enable AP power sequencing to receive and process host command
	  host sleep state changes.

config AP_PWRSEQ_S0IX
	bool "Enable power state S0ix for Intel x86 chipset"
	select AP_PWRSEQ_HOST_SLEEP
	default n
	help
	  This option enables power state S0ix for Intel x86 chipset. As
	  required, AP_PWRSEQ_HOST_SLEEP for host sleep event handling is
	  enabled.

config AP_PWRSEQ_S0IX_ERROR_RECOVERY
	bool "Detect failure to enter or exit Sleep state"
	depends on AP_PWRSEQ_HOST_SLEEP
	help
	  Enables detection of the AP failing to go to sleep, perhaps due to a
	  bug in the internal SoC periodic housekeeping code.

	  Failure information is reported via the EC_CMD_HOST_SLEEP_EVENT host
	  command.

config AP_PWRSEQ_S0IX_COUNTER
	bool "Enable S0ix counter"
	depends on AP_PWRSEQ_S0IX
	depends on AP_PWRSEQ_HOST_SLEEP
	default y
	help
	  Enables counter which increases at every transitions to S0ix state.
	  Counter can be read via host command.

config AP_PWRSEQ_DEBUG_MODE_COMMAND
	bool "Console commands to enable/disable AP debug mode"
	depends on X86_NON_DSX_PWRSEQ
	default y
	help
	  Intel debugger puts SOC in boot halt mode for step debugging,
	  during this time EC may lose Sx lines, This option enables console
	  command to enable debug mode and prevent force shutdown.

config AP_SLP_S0_DEBUG
	bool "SLP_S0 debug"
	depends on AP_PWRSEQ_S0IX
	help
	  Enable debugging of SLP_S0 timeouts.  This option enables
	  the host command EC_CMD_SET_ALARM_SLP_S0_DBG and the console
	  command  'slp_s0_debug_alarm'.

	  These commands set a debug alarm time in seconds. If the debug
	  alarm expires, the EC generates an RTC wake event to the host.

	  If the sleep timeout expires before the debug alarm, then the
	  debug alarm is cancelled.


endif

config AP_EVENTS
	bool "Enable AP events"
	default y
	help
	  Helper symbol to enable Application Processor(AP) events.
```

## zephyr/subsys/emul/ap_pwrseq/Kconfig
```kconfig
# Copyright 2022 The ChromiumOS Authors
# Use of this source code is governed by a BSD-style license that can be
# found in the LICENSE file.

if ZTEST

config EMUL_POWER_SIGNALS
	bool "Enable Power Signals Emulator"
	select AP_PWRSEQ_POWER_SIGNALS
	help
	  Power signals emulator imitates the behavior of power signals
	  that interact with the EC within a given platform. It enables testing
	  AP Power Sequence execution in a virtual environment.

if EMUL_POWER_SIGNALS

module = EMUL_POWER_SIGNALS
module-str = Power Signals Emulator
source "subsys/logging/Kconfig.template.log_config"

config EMUL_POWER_SIGNALS_WORK_QUEUE_STACK_SIZE
	int "Power Signals Emulator internal work queue stack size"
	default 1024
	help
	  Power Signal Emulator has its own dedicated work queue, this defines
	  work queue thread stack size.

config EMUL_POWER_SIGNALS_WORK_QUEUE_PRIO
	int "Power Signals Emulator internal work queue thread priority"
	default 0
	help
	  Defines work queue thread thread priority.

endif # EMUL_POWER_SIGNALS

config EMUL_AP_PWRSEQ_DRIVER
	bool "Enable Ap Power Sequence Emulator"
	depends on AP_PWRSEQ_DRIVER
	help
	  AP Power sequence emulator provides minimum functionality for testing
	  power sequence action handlers while using existing API's and macros.
endif # ZTEST
```
