## zephyr/program/marigold/Kconfig
```kconfig
# Copyright 2021 The ChromiumOS Authors
# Use of this source code is governed by a BSD-style license that can be
# found in the LICENSE file.

config BOARD_MARIGOLD
	bool "Framework Marigold Board"
	help
	  Build Framework Marigold reference board. Marigold has AMD SoC
	  with NPCX993FA0BX EC.

module = MARIGOLD
module-str = Marigold board-specific code
source "subsys/logging/Kconfig.template.log_config"

source "Kconfig.zephyr"
```

## zephyr/program/myst/Kconfig
```kconfig
# Copyright 2023 The ChromiumOS Authors
# Use of this source code is governed by a BSD-style license that can be
# found in the LICENSE file.

config BOARD_MYST
	bool "Google Myst Board"
	help
	  Build Google Myst reference board.  This board uses an AMD SoC
	  and NPCX9 EC

module = MYST
module-str = Myst board-specific code
source "subsys/logging/Kconfig.template.log_config"

source "Kconfig.zephyr"
```

## zephyr/program/nissa/Kconfig
```kconfig
# Copyright 2021 The ChromiumOS Authors
# Use of this source code is governed by a BSD-style license that can be
# found in the LICENSE file.

config NISSA_SUB_BOARD
	bool "Nissa sub-board support"
	default y
	help
	  Enable the sub-board support for Nissa boards.
	  This uses a common fw_config bitfield to select
	  one of a number of option sub-boards with different
	  hardware configurations.

config NISSA_BOARD_HAS_HDMI_SUPPORT
	bool "Board supports HDMI sub-boards"
	default $(dt_nodelabel_enabled,gpio_hdmi_sel)
	help
	  Enable board code for managing the state of HDMI connections
	  on a sub-board.

config BOARD_NIVVIKS
	bool "Google Nivviks Board"
	help
	  Build Google Nivviks reference board. Nivviks has Intel ADL-N SoC
	  with NPCX993FA0BX EC.

config BOARD_NEREID
	bool "Google Nereid Board"
	help
	  Build Google Nereid reference board. Nereid has Intel ADL-N SoC
	  with IT81302 EC.

config BOARD_NEREID_CX
	bool "Google Nereid Board with IT81302 CX"
	help
	  Build Google Nereid reference board, but with IT81302 CX EC rather
	  than IT81302 BX.

config BOARD_NOKRIS
        bool "Google Nokris Board"
        help
          Build Google Nokris reference board. Nokris has Intel ADL-N SoC
          with NPCX993FA0BX EC.

config BOARD_CRAASK
	bool "Google Craask Board"
	help
	  Build Google Craask board. Craask has Intel ADL-N SoC
	  with NPCX993FA0BX EC.

config BOARD_PUJJO
	bool "Google Pujjo Board"
	help
	  Build Google Pujjo board. Pujjo has Intel ADL-N SoC
	  with NPCX993FA0BX EC.

config BOARD_XIVU
        bool "Google Xivu Board"
        help
          Build Google Xivu board. Xivu has Intel ADL-N SoC
          with NPCX993FA0BX EC.

config BOARD_XIVUR
        bool "Google Xivur Board"
        help
          Build Google Xivur board. Xivur has Intel ADL-N SoC
          with NPCX993FA0BX EC.

config BOARD_JOXER
	bool "Google Joxer Board"
	help
	  Build Google Joxer reference board. Joxer has Intel ADL-N SoC
	  with IT81302 EC.

config BOARD_YAVIKS
	bool "Google Yaviks Board"
	help
	  Build Google Yaviks board. Yaviks has Intel ADL-N SoC
	  with IT81302 EC.

config BOARD_YAVILLA
	bool "Google Yavilla Board"
	help
	  Build Google Yavilla board. Yavilla has Intel ADL-N SoC
	  with IT81302 EC.

config BOARD_ULDREN
	bool "Google Uldren Board"
	help
	  Build Google Uldren reference board. Uldren has Intel ADL-N SoC
	  with NPCX993FA0BX EC.

config BOARD_GOTHRAX
	bool "Google Gothrax Board"
	help
	  Build Google Gothrax reference board. Gothrax has Intel ADL-N SoC
	  with IT81302 EC.

config BOARD_CRAASKOV
	bool "Google Craaskov Board"
	help
	  Build Google Craaskov reference board. Craaskov has Intel ADL-N SoC
	  with NPCX993FA0BX EC.

config BOARD_QUANDISO
	bool "Google Quandiso Board"
	help
	  Build Google Quandiso board. Quandiso has Intel ADL-N SoC
	  with IT81302 EC.

config BOARD_PIRRHA
	bool "Google Pirrha Board"
	help
	  Build Google Pirrha reference board. Pirrha has Intel ADL-N SoC
	  with IT81302 EC.


module = NISSA
module-str = Nissa board-specific code
source "subsys/logging/Kconfig.template.log_config"

source "Kconfig.zephyr"
```

## zephyr/program/ovis/Kconfig
```kconfig
# Copyright 2023 The ChromiumOS Authors
# Use of this source code is governed by a BSD-style license that can be
# found in the LICENSE file.

config BOARD_OVIS
	bool "Google Ovis Baseboard"
	help
	  Build Google Ovis reference board.  The board uses Nuvoton
	  NPCX9 chip as the EC.
config BOARD_DEKU
	bool "Google Deku Board"
	help
	  Build Google Deku reference board.  The board uses Nuvoton
	  NPCX9 chip as the EC.

module = OVIS
module-str = Ovis board-specific code
source "subsys/logging/Kconfig.template.log_config"

source "Kconfig.zephyr"
```

## zephyr/program/rauru/Kconfig
```kconfig
# Copyright 2023 The ChromiumOS Authors
# Use of this source code is governed by a BSD-style license that can be
# found in the LICENSE file.

config RAURU_BOARD_HAS_HDMI_SUPPORT
	bool "Board supports HDMI sub-boards"
	default $(dt_nodelabel_enabled,gpio_en_hdmi_pwr)
	help
	  Enable board code for managing the state of HDMI connections on
	  the board.

config RAURU_DUAL_DP_PIPELINE
	bool "Board supports dual dp pipeline"
	default !$(dt_nodelabel_enabled,gpio_dp_path_hdmi_en)
	help
	  Enable board code for managing dp_alt_mode on
	  the board.

config BOARD_RAURU
	bool "Google Rauru Board"
	help
	  Build Google Rauru reference board. Rauru has MediaTek SoC
	  with ITE it82202-ax EC.

config BOARD_RAURU_PDC
	bool "Google Rauru Board with PDC sub-board"
	help
	  Build Google Rauru reference board with PDC sub-board. Rauru has
	  MediaTek SoC with ITE it82202-ax EC.

config BOARD_NAVI
	bool "Google Navi Board"
	help
	  Build Google Navi board. Navi has MediaTek SoC
	  with ITE it82202-ax EC.

config BOARD_HYLIA
	bool "Google Hylia Board"
	help
	  Build Google Hylia board. Hylia has MediaTek SoC
	  with ITE it82202-ax EC.

config RAURU_BOARD_PANEL_BACKLIGHT_SEQUENCE_CUSTOM
	bool "Rauru Platform Board Panel Backlight Sequence Customization"
	default n
	help
	  Redefine the rauru board panel backlight control sequence.


module = RAURU
module-str = Rauru board-specific code
source "subsys/logging/Kconfig.template.log_config"

source "Kconfig.zephyr"
```

## zephyr/program/roach/Kconfig
```kconfig
# Copyright 2023 The ChromiumOS Authors
# Use of this source code is governed by a BSD-style license that can be
# found in the LICENSE file.

config BOARD_ROACH
	bool "Google Roach Board"
	help
	  Build Google Roach reference board. Roach is a keyboard EC
	  using ITE it82202-ax.

config BOARD_AXII
	bool "Google Axii Board"
	help
	  Build Google Axii board. Axii is a test fixture for testing
	  Roach devices.

source "Kconfig.zephyr"
```

## zephyr/program/trulo/Kconfig
```kconfig
# Copyright 2024 The ChromiumOS Authors
# Use of this source code is governed by a BSD-style license that can be
# found in the LICENSE file.

config BOARD_TRULO
	bool "Google Trulo Board"
	help
	  Build Google Trulo reference board.  This board uses an Intel TWL SoC
	  and NUVATON EC

config BOARD_PUJJOCENTO
	bool "Google Pujjocento Board"
	help
	  Build Google Pujjocento reference board.  This board uses an Intel TWL SoC
	  and NPCX997FB0BX EC

config BOARD_PUJJOLO
	bool "Google Pujjolo Board"
	help
	  Build Google Pujjolo reference board.  This board uses an Intel TWL SoC
	  and Nuvoton EC

config BOARD_ULDRENITE
	bool "Google Uldrenite Board"
	help
	  Build Google Uldrenite reference board.  This board uses an Intel TWL SoC
	  and NPCX997FB0BX EC

module = Trulo
module-str = Trulo board-specific code
source "subsys/logging/Kconfig.template.log_config"

choice PLATFORM_EC_USBC_STACK
	default PLATFORM_EC_USB_PD_CONTROLLER
endchoice

source "Kconfig.zephyr"
```

## zephyr/projects/asurada/boards/riscv/asurada/Kconfig.defconfig
```kconfig
# Copyright 2021 The Chromium OS Authors. All rights reserved.
# Use of this source code is governed by a BSD-style license that can be
# found in the LICENSE file.

if BOARD_ASURADA

config BOARD
	default "asurada"

config TASK_PD_STACK_SIZE
	default 1280

endif # BOARD_ASURADA
```

## zephyr/projects/brya/Kconfig
```kconfig
# Copyright 2022 The Chromium OS Authors. All rights reserved.
# Use of this source code is governed by a BSD-style license that can be
# found in the LICENSE file.

config BOARD_BRYA
	bool "Google Brya Baseboard"
	help
	  Build Google Brya reference board. The board uses the Nuvuton NPCX9
	  chip as the EC.

source "Kconfig.zephyr"
```

## zephyr/projects/brya/boards/arm/brya/brya_defconfig
```kconfig
# Copyright 2021 The Chromium OS Authors. All rights reserved.
# Use of this source code is governed by a BSD-style license that can be
# found in the LICENSE file.

# Zephyr Kernel Configuration
CONFIG_SOC_SERIES_NPCX9=y

# Platform Configuration
CONFIG_SOC_NPCX9M3F=y
CONFIG_BOARD_BRYA=y

# Enable NPCX firmware header generator
CONFIG_NPCX_HEADER=y
CONFIG_NPCX_HEADER_SPI_MAX_CLOCK_50=y
CONFIG_NPCX_HEADER_SPI_READ_MODE_DUAL=y
CONFIG_NPCX_HEADER_CORE_CLOCK_SPI_CLOCK_RATIO_2=y

# Serial Drivers
CONFIG_SERIAL=y
CONFIG_UART_INTERRUPT_DRIVEN=y

# Enable console
CONFIG_CONSOLE=y
CONFIG_UART_CONSOLE=y

# Pinmux Driver
CONFIG_PINMUX=y

# GPIO Controller
CONFIG_GPIO=y

# Clock configuration
CONFIG_CLOCK_CONTROL=y

# System clock
CONFIG_SYS_CLOCK_HW_CYCLES_PER_SEC=15000000

# Code RAM base for NPCX9M3F
CONFIG_CROS_EC_PROGRAM_MEMORY_BASE=0x10080000
CONFIG_CROS_EC_RAM_BASE=0x200c0000
CONFIG_CROS_EC_DATA_RAM_SIZE=0x0000f800
CONFIG_CROS_EC_RAM_SIZE=0x0000f800

CONFIG_FLASH_SIZE=512
CONFIG_CROS_EC_RO_MEM_OFF=0x0
CONFIG_CROS_EC_RO_SIZE=0x40000
CONFIG_CROS_EC_RW_MEM_OFF=0x40000
CONFIG_CROS_EC_RW_SIZE=0x40000

# Power Management
CONFIG_SOC_POWER_MANAGEMENT=y
CONFIG_PM=y
CONFIG_PM_POLICY_APP=y
CONFIG_UART_CONSOLE_INPUT_EXPIRED=y
CONFIG_SOC_POWER_MANAGEMENT_TRACE=y

# WATCHDOG configuration
CONFIG_WATCHDOG=y
```

## zephyr/projects/delbin/boards/arm/delbin/Kconfig.board
```kconfig
# Copyright 2021 The Chromium OS Authors. All rights reserved.
# Use of this source code is governed by a BSD-style license that can be
# found in the LICENSE file.

config BOARD_DELBIN
	bool "Google Delbin EC"
	depends on SOC_NPCX7M6FB # Actually NPCX7M6FC; C has 512K Flash
```

## zephyr/projects/drawcia_riscv/Kconfig
```kconfig
# Copyright 2021 The Chromium OS Authors. All rights reserved.
# Use of this source code is governed by a BSD-style license that can be
# found in the LICENSE file.

config BOARD_DRAWCIA_RISCV
	bool "Google Drawcia Board"
	help
	  Build reworked Google Drawcia reference board with ITE81302.
	  This chip is a pin-compatible chip for the existing EC, but
	  is the RISCV version.

source "Kconfig.zephyr"
```

## zephyr/projects/it8xxx2_evb/boards/riscv/it8xxx2_evb/it8xxx2_evb_defconfig
```kconfig
# Copyright 2021 The Chromium OS Authors. All rights reserved.
# Use of this source code is governed by a BSD-style license that can be
# found in the LICENSE file.

# Zephyr Kernel Configuration
CONFIG_SOC_SERIES_RISCV32_IT8XXX2=y

# Platform Configuration
CONFIG_SOC_IT8XXX2=y
CONFIG_BOARD_IT8XXX2_EVB=y

# Serial Drivers
CONFIG_SERIAL=y
CONFIG_UART_INTERRUPT_DRIVEN=y

# Enable console
CONFIG_CONSOLE=y
CONFIG_UART_CONSOLE=y
CONFIG_UART_NS16550=y

# Pinmux Driver
CONFIG_PINMUX=y
CONFIG_PINMUX_ITE_IT8XXX2=y

# GPIO Controller
CONFIG_GPIO=y
CONFIG_GPIO_ITE_IT8XXX2=y

# Clock configuration
CONFIG_CLOCK_CONTROL=y

# WATCHDOG configuration
CONFIG_WATCHDOG=n

# I2C Controller
CONFIG_I2C_ITE_IT8XXX2=n

CONFIG_ITE_IT8XXX2_TIMER=y

CONFIG_SYS_CLOCK_HW_CYCLES_PER_SEC=32768
CONFIG_SYS_CLOCK_TICKS_PER_SEC=1000

# Code RAM base for IT8XXX2
CONFIG_CROS_EC_PROGRAM_MEMORY_BASE=0x80000000
CONFIG_CROS_EC_RAM_BASE=0x80100000
CONFIG_CROS_EC_DATA_RAM_SIZE=0x00100000
CONFIG_CROS_EC_RAM_SIZE=0x0000f000


CONFIG_CROS_EC_RO_MEM_OFF=0x0
CONFIG_CROS_EC_RO_SIZE=0x80000
CONFIG_CROS_EC_RW_MEM_OFF=0x0
CONFIG_CROS_EC_RW_SIZE=0x80000
```

## zephyr/projects/kohaku/boards/arm/kohaku/Kconfig.board
```kconfig
# Copyright 2021 The Chromium OS Authors. All rights reserved.
# Use of this source code is governed by a BSD-style license that can be
# found in the LICENSE file.

config BOARD_KOHAKU
	bool "Google Kohaku EC"
	depends on SOC_NPCX7M6FC
	# NPCX doesn't actually have enough ram for coverage, but this will
	# allow generating initial 0 line coverage.
	select HAS_COVERAGE_SUPPORT
```

## zephyr/projects/kohaku/boards/arm/kohaku/Kconfig.defconfig
```kconfig
# Copyright 2021 The Chromium OS Authors. All rights reserved.
# Use of this source code is governed by a BSD-style license that can be
# found in the LICENSE file.

if BOARD_KOHAKU

config BOARD
	default "kohaku"

endif # BOARD_KOHAKU
```

## zephyr/projects/trogdor/boards/arm/trogdor/Kconfig.defconfig
```kconfig
# Copyright 2021 The Chromium OS Authors. All rights reserved.
# Use of this source code is governed by a BSD-style license that can be
# found in the LICENSE file.

if BOARD_TROGDOR

config BOARD
	default "trogdor"

endif # BOARD_TROGDOR
```

## zephyr/projects/volteer/boards/arm/volteer/Kconfig.board
```kconfig
# Copyright 2021 The Chromium OS Authors. All rights reserved.
# Use of this source code is governed by a BSD-style license that can be
# found in the LICENSE file.

# Note: this Zephyr board more closely represents the Chrome OS
# concept of a baseboard.  Zephyr boards and Chrome OS boards do not
# have a 1:1 mapping.
config BOARD_VOLTEER
	bool "Google Volteer Baseboard"
	depends on SOC_NPCX7M6FC || SOC_NPCX7M7FC
	# NPCX doesn't actually have enough ram for coverage, but this will
	# allow generating initial 0 line coverage.
	select HAS_COVERAGE_SUPPORT
```

## zephyr/projects/volteer/boards/arm/volteer/Kconfig.defconfig
```kconfig
# Google Volteer EC

# Copyright 2020 The Chromium OS Authors
# SPDX-License-Identifier: Apache-2.0

if BOARD_VOLTEER

config BOARD
	default "volteer"

endif # BOARD_VOLTEER
```

## zephyr/projects/volteer/boards/arm/volteer/volteer_defconfig
```kconfig
# Copyright 2021 The Chromium OS Authors. All rights reserved.
# Use of this source code is governed by a BSD-style license that can be
# found in the LICENSE file.

# Zephyr Kernel Configuration
CONFIG_SOC_SERIES_NPCX7=y
CONFIG_SOC_NPCX7M7FC=y

# Platform Configuration
CONFIG_BOARD_VOLTEER=y

# Serial Drivers
CONFIG_SERIAL=y
CONFIG_UART_INTERRUPT_DRIVEN=y

# Enable console
CONFIG_CONSOLE=y
CONFIG_UART_CONSOLE=y

# Pinmux Driver
CONFIG_PINMUX=y

# GPIO Controller
CONFIG_GPIO=y

# Clock configuration
CONFIG_CLOCK_CONTROL=y

# WATCHDOG configuration
CONFIG_WATCHDOG=y

# ADC
# The resolution and oversamplig values are fixed by the NPCX ADC driver
CONFIG_ADC=y
CONFIG_ADC_SHELL=n

# Power Management
CONFIG_SOC_POWER_MANAGEMENT=y
CONFIG_PM_POLICY_APP=y
CONFIG_UART_CONSOLE_INPUT_EXPIRED=y
CONFIG_SOC_POWER_MANAGEMENT_TRACE=y
```

## zephyr/projects/volteer/delbin/boards/arm/delbin/Kconfig.defconfig
```kconfig
# Copyright 2021 The Chromium OS Authors. All rights reserved.
# Use of this source code is governed by a BSD-style license that can be
# found in the LICENSE file.

if BOARD_DELBIN

config BOARD
	default "delbin"

endif # BOARD_DELBIN
```
