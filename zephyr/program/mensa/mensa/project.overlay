/* Copyright 2026 The ChromiumOS Authors
 * Use of this source code is governed by a BSD-style license that can be
 * found in the LICENSE file.
 */

/* mensa program common DTS includes */

#include <cros/integrated_fwid.dtsi>

#include "../mensa_stub.dtsi"
#include "../psl.dtsi"

/* mensa project DTS includes */

#include <cros/cbi_flash.dtsi>

/* mensa overrides follow... */

&cbi_flash {
	/*
	 * CBI section size is 0x1000 bytes, the CBI portion lies at the end of
	 * EC_RO section.
	 */
	offset = <0x3e000>;
	size = <0x1000>;
};
