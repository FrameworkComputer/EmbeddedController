/* Copyright 2022 The ChromiumOS Authors
 * Use of this source code is governed by a BSD-style license that can be
 * found in the LICENSE file.
 */

#include "../cbi.dtsi"
#include "../ite_espi.dtsi"

#include "generated.dtsi"
#include "keyboard.dtsi"
#include "motionsense.dtsi"
#include "overlay.dtsi"
#include "power_signals.dtsi"
#include "pwm_leds.dtsi"
