/* Copyright 2024 The ChromiumOS Authors
 * Use of this source code is governed by a BSD-style license that can be
 * found in the LICENSE file.
 */

/* brox-ish project DTSI includes */
#include "gpio.dtsi"
#include "i2c.dtsi"
#include "interrupts_motionsense.dtsi"
#include "ish.dtsi"
#include "../orisa/motionsense.dtsi"
