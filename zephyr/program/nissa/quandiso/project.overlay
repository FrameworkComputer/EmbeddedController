/* Copyright 2023 The ChromiumOS Authors
 * Use of this source code is governed by a BSD-style license that can be
 * found in the LICENSE file.
 */

#include "../ite_espi.dtsi"

#include "cbi.dtsi"
#include "fan.dtsi"
#include "gpio.dtsi"
#include "keyboard.dtsi"
#include "motionsense.dtsi"
#include "overlay.dtsi"
#include "power_signals.dtsi"
