/* Copyright 2025 The ChromiumOS Authors
 * Use of this source code is governed by a BSD-style license that can be
 * found in the LICENSE file.
 */

 / {
	batteries {
		default_battery: atc_atc {
			compatible = "atc,atc", "battery-smart";
		};
	};
 };