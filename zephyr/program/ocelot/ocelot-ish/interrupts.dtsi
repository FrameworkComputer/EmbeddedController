/* Copyright 2025 The ChromiumOS Authors
 * Use of this source code is governed by a BSD-style license that can be
 * found in the LICENSE file.
 */

/ {
	gpio_interrupts: gpio-interrupts {
		compatible = "cros-ec,gpio-interrupts";

		int_lid_accel: int-lid-accel {
			irq-pin = <&gpio_accel_db_int_l>;
			flags = <GPIO_INT_EDGE_FALLING>;
			handler = "bma4xx_interrupt";
		};
		int_base_accel: int-base-accel {
			irq-pin = <&gpio_accel_mb_int_l>;
			flags = <GPIO_INT_EDGE_FALLING>;
			handler = "bmi3xx_interrupt";
		};
	};
};
