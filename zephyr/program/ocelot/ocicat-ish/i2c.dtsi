/* Copyright 2025 The ChromiumOS Authors
 * Use of this source code is governed by a BSD-style license that can be
 * found in the LICENSE file.
 */

/ {
	named-i2c-ports {
		compatible = "named-i2c-ports";

		i2c_ec_i2c_sensor_r: ec_i2c_sensor_r {
			i2c-port = <&i2c2>;
			enum-names = "I2C_PORT_SENSOR";
		};
	};
};
