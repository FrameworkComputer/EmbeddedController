/* Copyright 2025 The ChromiumOS Authors
 * Use of this source code is governed by a BSD-style license that can be
 * found in the LICENSE file.
 */

/ {
	gpio_interrupts: gpio-interrupts {
		compatible = "cros-ec,gpio-interrupts";

		int_imu: ec_imu {
			irq-pin = <&gpio_imu_int_l>;
			flags = <GPIO_INT_EDGE_FALLING>;
			handler = "bmi260_interrupt";
		};
		int_lid_imu: lid_imu {
			irq-pin = <&gpio_acc_int_l>;
			flags = <GPIO_INT_EDGE_FALLING>;
			handler = "bma4xx_interrupt";
		};
	};
};
