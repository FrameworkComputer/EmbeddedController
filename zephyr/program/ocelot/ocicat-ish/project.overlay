/* Copyright 2025 The ChromiumOS Authors
 * Use of this source code is governed by a BSD-style license that can be
 * found in the LICENSE file.
 */

/* wcl-ish project DTSI includes */
#include "gpio.dtsi"
#include "i2c.dtsi"
#include "interrupts.dtsi"
#include "ish.dtsi"
#include "motionsense.dtsi"

&i2c_ec_i2c_sensor_r {
	i2c-port = <&i2c2>;
};

&i2c2 {
	status = "okay";
	dsp_client: dsp-client@29 {
		compatible = "cros,dsp-client";
		reg = <0x29>;
		int-gpios = <&gpio0 1 GPIO_ACTIVE_LOW>;
	};
};
