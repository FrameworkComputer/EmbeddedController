/* Copyright 2026 The ChromiumOS Authors
 * Use of this source code is governed by a BSD-style license that can be
 * found in the LICENSE file.
 */

#include <dt-bindings/imvp.h>
#include "rvp_i2c.dtsi"

&imvp_rt3645 {
	update-data = <
		RT3645_UPDATE_ENTRY(RT3645_PAGE_5, RLL_REG, 0xA5)
		RT3645_UPDATE_ENTRY(RT3645_PAGE_5, DEM_SHRINK_TON_REG, 0xC1)
		RT3645_UPDATE_ENTRY(RT3645_PAGE_9, ICCMAX_REG, 0x32)
		RT3645_UPDATE_ENTRY(RT3645_PAGE_9, ICCMAX_HC_SR_KTON_REG, 0x27)
		RT3645_UPDATE_ENTRY(RT3645_PAGE_9, RIMON_REG, 0xAF)
		RT3645_UPDATE_ENTRY(RT3645_PAGE_9, RLL_REG, 0xD0)
		RT3645_UPDATE_ENTRY(RT3645_PAGE_9, DVID_ENHANCE_SPM_EN_REG, 0xAD)
		RT3645_UPDATE_ENTRY(RT3645_PAGE_9, AR_TH_REG, 0xF9)
		RT3645_UPDATE_ENTRY(RT3645_PAGE_A, ICCMAX_HC_SR_KTON_REG, 0x2A)
		RT3645_UPDATE_ENTRY(RT3645_PAGE_A, DVID_ENHANCE_SPM_EN_REG, 0x89)
		RT3645_UPDATE_ENTRY(RT3645_PAGE_A, AR_TH_REG, 0xFA)
		RT3645_UPDATE_ENTRY(RT3645_PAGE_B, ICCMAX_REG, 0x24)
		RT3645_UPDATE_ENTRY(RT3645_PAGE_B, ICCMAX_HC_SR_KTON_REG, 0x28)
		RT3645_UPDATE_ENTRY(RT3645_PAGE_B, RIMON_REG, 0xF2)
		RT3645_UPDATE_ENTRY(RT3645_PAGE_B, RLL_REG, 0x00)
		RT3645_UPDATE_ENTRY(RT3645_PAGE_B, COMP_GAIN_REG, 0x3E)
		RT3645_UPDATE_ENTRY(RT3645_PAGE_B, COMP_MODE_PZ_REG, 0x3c)
		RT3645_UPDATE_ENTRY(RT3645_PAGE_B, VSEN_COMP_LPF_REG, 0x2B)
		RT3645_UPDATE_ENTRY(RT3645_PAGE_B, DVID_ENHANCE_SPM_EN_REG, 0x03)
		RT3645_UPDATE_ENTRY(RT3645_PAGE_B, AR_TH_REG, 0xF7)
		RT3645_UPDATE_ENTRY(RT3645_PAGE_B, DEM_SHRINK_TON_REG, 0x11)
		RT3645_UPDATE_ENTRY(RT3645_PAGE_B, ZCD_VID_R_TH_REG, 0xF8)
		RT3645_UPDATE_ENTRY(RT3645_PAGE_B, ZCD_I_TH_HYS_REG, 0xBF)
		RT3645_UPDATE_ENTRY(RT3645_PAGE_B, DVID_TAU_AQR_TH_REG, 0x4F)
		RT3645_UPDATE_ENTRY(RT3645_PAGE_B, RIPPLE_COMP_SVID_ADDR_REG, 0x01)
		RT3645_UPDATE_ENTRY(RT3645_PAGE_B, SVID_DCLL_REG, 0x00)
		RT3645_UPDATE_ENTRY(RT3645_PAGE_C, ICCMAX_HC_SR_KTON_REG, 0x29)
		RT3645_UPDATE_ENTRY(RT3645_PAGE_C, VSEN_COMP_LPF_REG, 0x30)
		RT3645_UPDATE_ENTRY(RT3645_PAGE_C, DVID_ENHANCE_SPM_EN_REG, 0xED)
		RT3645_UPDATE_ENTRY(RT3645_PAGE_C, AR_TH_REG, 0xF9)
		RT3645_UPDATE_ENTRY(RT3645_PAGE_C, RIPPLE_COMP_SVID_ADDR_REG, 0x13)
		RT3645_UPDATE_ENTRY(RT3645_PAGE_D, SPM_HYS_DVIDUP_PH_A_REG , 0x70)
		RT3645_UPDATE_ENTRY(RT3645_PAGE_D, DVIDUP_PH_B_DVIDDN_PH_SET_REG, 0x40)
		>;
	update-crc = <0x92>;
};
