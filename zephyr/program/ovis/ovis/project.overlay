/* Copyright 2023 The ChromiumOS Authors
 * Use of this source code is governed by a BSD-style license that can be
 * found in the LICENSE file.
 */

/* Ovis program common DTSI includes */
#include "../fan.dtsi"
#include "../generated.dtsi"
#include "../interrupts.dtsi"
#include "../power_signals.dtsi"
#include "../ovis.dtsi"
#include "../usbc.dtsi"

/* Ovis project DTS includes */
#include "led_pins.dtsi"
#include "temp_sensors.dtsi"
/*
 * TODO(b/285166688): need led_policy.dtsi once that has been
 * implemented to match Ovis requirements
 */
