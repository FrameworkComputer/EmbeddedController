/* Copyright 2023 The ChromiumOS Authors
 * Use of this source code is governed by a BSD-style license that can be
 * found in the LICENSE file.
 */

/ {
	gpio-interrupts {
		compatible = "cros-ec,gpio-interrupts";

		int_tchpad: tchpad {
			irq-pin = <&tchpad_int_odl>;
			flags = <GPIO_INT_EDGE_FALLING>;
			handler = "touchpad_interrupt";
		};
	};
};
