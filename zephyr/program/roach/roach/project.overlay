/* Copyright 2023 The ChromiumOS Authors
 * Use of this source code is governed by a BSD-style license that can be
 * found in the LICENSE file.
 */

/* Roach program common DTS includes */

#include "../adc.dtsi"
#include "../gpio.dtsi"
#include "../uart.dtsi"
#include "../i2c.dtsi"
#include "../interrupts.dtsi"
#include "../keyboard.dtsi"
#include "../pwm.dtsi"
#include "../rwsig.dtsi"

&i2c0 {
	touchpad@15 {
		/* not tested, don't care on reference board */
		logical_max_x = <2644>;
		logical_max_y = <1440>;
		physical_max_x = <839>;
		physical_max_y = <457>;
	};
};
