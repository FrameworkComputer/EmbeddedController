/* Copyright 2022 The ChromiumOS Authors
 * Use of this source code is governed by a BSD-style license that can be
 * found in the LICENSE file.
 */

/* Skyrim program common DTS includes */
#include "../adc.dtsi"
#include "../fan.dtsi"
#include "../gpio.dtsi"
#include "../interrupts.dtsi"
#include "../keyboard.dtsi"
#include "../usbc.dtsi"

/* Morthal project DTS includes*/
#include "morthal.dtsi"
#include "battery.dtsi"
#include "led_pins.dtsi"
#include "led_policy.dtsi"
#include "motionsense.dtsi"
