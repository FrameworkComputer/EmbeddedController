/* Copyright 2025 The ChromiumOS Authors
 * Use of this source code is governed by a BSD-style license that can be
 * found in the LICENSE file.
 */

/* Adds the &alt1_no_lpc_espi setting over the NPCX9 default setting. */
&{/def-io-conf-list} {
	pinmux = <&alt0_gpio_no_spip
		  &alt0_gpio_no_fpip
		  &alt1_no_pwrgd
		  &alt1_no_lpc_espi
		  &alta_no_peci_en
		  &altd_npsl_in1_sl
		  &altd_npsl_in2_sl
		  &altd_psl_in3_sl
		  &altd_psl_in4_sl
		  &alt7_no_ksi0_sl
		  &alt7_no_ksi1_sl
		  &alt7_no_ksi2_sl
		  &alt7_no_ksi3_sl
		  &alt7_no_ksi4_sl
		  &alt7_no_ksi5_sl
		  &alt7_no_ksi6_sl
		  &alt7_no_ksi7_sl
		  &alt8_no_kso00_sl
		  &alt8_no_kso01_sl
		  &alt8_no_kso02_sl
		  &alt8_no_kso03_sl
		  &alt8_no_kso04_sl
		  &alt8_no_kso05_sl
		  &alt8_no_kso06_sl
		  &alt8_no_kso07_sl
		  &alt9_no_kso08_sl
		  &alt9_no_kso09_sl
		  &alt9_no_kso10_sl
		  &alt9_no_kso11_sl
		  &alt9_no_kso12_sl
		  &alt9_no_kso13_sl
		  &alt9_no_kso14_sl
		  &alt9_no_kso15_sl
		  &alta_no_kso16_sl
		  &alta_no_kso17_sl
		  &altg_psl_gpo_sl>;
};
