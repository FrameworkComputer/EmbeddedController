/* Copyright 2025 The ChromiumOS Authors
 * Use of this source code is governed by a BSD-style license that can be
 * found in the LICENSE file.
 */
#include <dt-bindings/battery.h>

&spi0 {
	status = "okay";
	pinctrl-0 = <&spi_ssce0_default &spi_smosi_default>;
	pinctrl-names = "default";

	spi0_dev0: spi0_dev@0 {
		reg = <0>;
		chain-length = <5>;
		reset-delay = <205>;
		spi-max-frequency = <6000000>;
		bits-per-symbol = <8>;
		spi-one-frame = <0xF8>;        // 0b11111000 for a '1' bit
		spi-zero-frame = <0xC0>;       // 0b11000000 for a '0' bit
	};
};
