/* Copyright 2025 The ChromiumOS Authors
 * Use of this source code is governed by a BSD-style license that can be
 * found in the LICENSE file.
 */

#include "../cbi.dtsi"
#include "../uldrenite/cbi.dtsi"
#include "gpio.dtsi"
#include "i2c.dtsi"
#include "motionsense.dtsi"

/ {
	chosen {
		zephyr,sram = &sram;
		zephyr,console = &uart0;
		zephyr,shell-uart = &uart0;
		zephyr,flash = &sram;
	};
};