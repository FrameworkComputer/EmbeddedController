/* Copyright 2022 The Chromium OS Authors. All rights reserved.
 * Use of this source code is governed by a BSD-style license that can be
 * found in the LICENSE file.
 */

/ {
	model = "Google Brya Baseboard";

	chosen {
		cros,rtc = &mtc;
	};

	ec-console {
		compatible = "ec-console";
		disabled = "events", "lpc", "hostcmd";
	};
};

/* host interface */
&espi0 {
	status = "okay";
	pinctrl-0 = <&espi_lpc_gp46_47_51_52_53_54_55_57>;
	pinctrl-names = "default";
};
