/* Copyright 2022 The Chromium OS Authors. All rights reserved.
 * Use of this source code is governed by a BSD-style license that can be
 * found in the LICENSE file.
 */

/ {
	batteries {
		default_battery: batgqa05l22 {
			compatible = "powertech,batgqa05l22";
		};
		lgc_ac17a8m {
			compatible = "lgc,ac17a8m";
		};
	};
};
