/* Copyright 2022 The Chromium OS Authors. All rights reserved.
 * Use of this source code is governed by a BSD-style license that can be
 * found in the LICENSE file.
 */

/ {
	named-pwms {
		compatible = "named-pwms";

		pwm_fan: fan {
			pwms = <&pwm5 0 0>;
			frequency = <1000>;
		};
	};
};

/* Fan control */
&pwm5 {
	status = "okay";
	drive-open-drain;
};
