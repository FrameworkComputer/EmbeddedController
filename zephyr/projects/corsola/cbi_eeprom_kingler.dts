/* Copyright 2021 The Chromium OS Authors. All rights reserved.
 * Use of this source code is governed by a BSD-style license that can be
 * found in the LICENSE file.
 */

 &i2c_pwr_cbi {
	cbi_eeprom: eeprom@50 {
		compatible = "atmel,at24";
		reg = <0x50>;
		label = "EEPROM_CBI";
		size = <2048>;
		pagesize = <16>;
		address-width = <8>;
		timeout = <5>;
	};
};
