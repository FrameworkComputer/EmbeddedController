/* Copyright 2022 The ChromiumOS Authors.
 * Use of this source code is governed by a BSD-style license that can be
 * found in the LICENSE file.
 */

&int_base_imu {
	irq-pin = <&base_imu_int_l>;
	flags = <GPIO_INT_EDGE_FALLING>;
	handler = "motion_interrupt";
};
