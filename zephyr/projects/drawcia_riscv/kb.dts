/* Copyright 2021 The Chromium OS Authors. All rights reserved.
 * Use of this source code is governed by a BSD-style license that can be
 * found in the LICENSE file.
 */

/ {
	/* Override keyboard scanning */
	soc {
		/delete-node/ kscan@f01d00;

		cros_kb_raw: cros-kb-raw@f01d00 {
			compatible = "ite,it8xxx2-cros-kb-raw";
			reg = <0x00f01d00 0x29>;
			label = "CROS_KB_RAW_0";
			interrupt-parent = <&intc>;
			interrupts = <13 IRQ_TYPE_LEVEL_HIGH>;
			status = "disabled";
		};
	};
};

&cros_kb_raw {
	status = "okay";
};
