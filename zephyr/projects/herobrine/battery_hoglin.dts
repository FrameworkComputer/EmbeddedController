/* Copyright 2022 The Chromium OS Authors. All rights reserved.
 * Use of this source code is governed by a BSD-style license that can be
 * found in the LICENSE file.
 */

/ {
	batteries {
		default_battery: 7c01 {
			compatible = "ganfeng,7c01", "battery-smart";
		};
	};
};
