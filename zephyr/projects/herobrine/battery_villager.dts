/* Copyright 2022 The Chromium OS Authors. All rights reserved.
 * Use of this source code is governed by a BSD-style license that can be
 * found in the LICENSE file.
 */

/ {
	batteries {
		default_battery: ap19a5k {
			compatible = "panasonic,ap19a5k", "battery-smart";
		};
		ap19a8k {
			compatible = "lgc,ap19a8k", "battery-smart";
		};
	};
};
