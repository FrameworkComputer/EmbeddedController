/* Copyright 2022 The ChromiumOS Authors
 * Use of this source code is governed by a BSD-style license that can be
 * found in the LICENSE file.
 */

/ {
	batteries {
		default_battery: pc_vp_bp153 {
			compatible = "smp,pc-vp-bp153", "battery-smart";
		};
		ap16l5j {
			compatible = "panasonic,ap16l5j", "battery-smart";
		};
	};
};
