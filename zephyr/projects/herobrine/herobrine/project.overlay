/* Copyright 2022 The ChromiumOS Authors
 * Use of this source code is governed by a BSD-style license that can be
 * found in the LICENSE file.
 */

/* Herobrine program common DTS includes */
#include "../adc.dtsi"
#include "../common.dtsi"
#include "../interrupts.dtsi"
#include "../keyboard.dtsi"
#include "../default_gpio_pinctrl.dtsi"
#include "../display.dtsi"
#include "../gpio.dtsi"
#include "../motionsense.dtsi"
#include "../switchcap.dtsi"

/* Herobrine project DTS includes*/
#include "battery.dtsi"
#include "i2c.dtsi"
#include "led_pins.dtsi"
#include "led_policy.dtsi"
#include "usbc.dtsi"
