/* Copyright 2022 The Chromium OS Authors. All rights reserved.
 * Use of this source code is governed by a BSD-style license that can be
 * found in the LICENSE file.
 */

/ {
	kblight {
		compatible = "cros-ec,kblight-pwm";
		pwms = <&pwm3 0 PWM_KHZ(10) PWM_POLARITY_NORMAL>;
		frequency = <10000>;
		generic-pwm-channel = <0>;
	};
};

&pwm3 {
	status = "okay";
	pinctrl-0 = <&pwm3_gp80>;
	pinctrl-names = "default";
};
