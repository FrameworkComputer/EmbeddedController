/* Copyright 2022 The Chromium OS Authors. All rights reserved.
 * Use of this source code is governed by a BSD-style license that can be
 * found in the LICENSE file.
 */

/ {
	named-pwms {
		compatible = "named-pwms";

		displight: ecl_bl_pwm_r {
			pwms = <&pwm5 0 0>;
			frequency = <4800>;
		};
	};
};

/* Display backlight */
&pwm5 {
	status = "okay";
};
