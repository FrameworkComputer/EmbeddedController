/* Copyright 2021 The Chromium OS Authors. All rights reserved.
 * Use of this source code is governed by a BSD-style license that can be
 * found in the LICENSE file.
 */

/ {
	switchcap {
		compatible = "switchcap-gpio";
		enable-pin = <&gpio_switchcap_on>;
		power-good-pin = <&gpio_switchcap_pg>;
	};
};
