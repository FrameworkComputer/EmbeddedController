/* Copyright 2022 The Chromium OS Authors. All rights reserved.
 * Use of this source code is governed by a BSD-style license that can be
 * found in the LICENSE file.
 */

/ {
	batteries {
		default_battery: getac_smp_hhp_408_3s {
			compatible = "getac,bq40z50-R3-S3", "battery-smart";
		};
		getac_smp_hhp_408_2s {
			compatible = "getac,bq40z50-R3-S2", "battery-smart";
		};
	};
};
