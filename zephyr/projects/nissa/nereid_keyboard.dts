/* Copyright 2022 The Chromium OS Authors. All rights reserved.
 * Use of this source code is governed by a BSD-style license that can be
 * found in the LICENSE file.
 */

/ {
	kblight {
		compatible = "cros-ec,kblight-pwm";
		pwms = <&pwm0 0 PWM_KHZ(10) PWM_POLARITY_NORMAL>;
		frequency = <10000>;
	};
};

&pwm0 {
	status = "okay";
	prescaler-cx = <PWM_PRESCALER_C4>;
};
