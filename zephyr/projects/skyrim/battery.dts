/* Copyright 2021 The Chromium OS Authors. All rights reserved.
 * Use of this source code is governed by a BSD-style license that can be
 * found in the LICENSE file.
 */

/ {
	batteries {
		default_battery: aec_5477109 {
			compatible = "aec,5477109";
		};
		smp_l20m3pg1 {
			compatible = "smp,l20m3pg1";
		};
	};
};
