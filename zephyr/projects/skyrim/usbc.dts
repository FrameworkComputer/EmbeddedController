/* Copyright 2022 The Chromium OS Authors. All rights reserved.
 * Use of this source code is governed by a BSD-style license that can be
 * found in the LICENSE file.
 */

/ {
	usbc {
		#address-cells = <1>;
		#size-cells = <0>;

		usbc_port0: port0@0 {
			compatible = "named-usbc-port";
			reg = <0>;
			bc12 = <&bc12_port0>;
			tcpc = <&tcpc_port0>;
			chg = <&charger>;
		};

		usbc_port1: port1@1 {
			compatible = "named-usbc-port";
			reg = <1>;
			bc12 = <&bc12_port1>;
			tcpc = <&tcpc_port1>;
		};
	};
};
