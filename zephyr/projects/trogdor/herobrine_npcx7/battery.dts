/* Copyright 2021 The Chromium OS Authors. All rights reserved.
 * Use of this source code is governed by a BSD-style license that can be
 * found in the LICENSE file.
 */

/ {
	named-batteries {
		compatible = "named-batteries";

		ap16l5j {
			enum-name = "ap16l5j";
		};
	};
};
