/* Copyright 2022 The Chromium OS Authors. All rights reserved.
 * Use of this source code is governed by a BSD-style license that can be
 * found in the LICENSE file.
 */

/ {
	displight {
		compatible = "cros-ec,displight";
		pwms = <&pwm5 0 PWM_POLARITY_NORMAL>;
		frequency = <4800>;
	};
};

&pwm5 {
	status = "okay";
};
