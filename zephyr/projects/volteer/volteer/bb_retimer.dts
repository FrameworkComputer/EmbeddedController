/* Copyright 2021 The Chromium OS Authors. All rights reserved.
 * Use of this source code is governed by a BSD-style license that can be
 * found in the LICENSE file.
 */

&i2c3_0 {
	status = "okay";
	clock-frequency = <I2C_BITRATE_STANDARD>;

	usb_c1_bb_retimer: jhl8040r@40 {
		compatible = "intel,jhl8040r";
		reg = <0x40>;
		label = "USB_C1_BB_RETIMER";
		int-pin = <&gpio_usb_c1_mix_int_odl>;
		reset-pin = <&gpio_usb_c1_rt_rst_odl>;
		ls-en-pin = <&gpio_unused_gpio41>;
	};
};
