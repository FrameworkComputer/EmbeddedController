## zephyr/subsys/host_service/Kconfig
```kconfig
# Copyright 2023 The ChromiumOS Authors
# Use of this source code is governed by a BSD-style license that can be
# found in the LICENSE file.

menu "host_service"

config HOST_SERVICE
	bool "HOST_SERVICE support"
	default n
	help
	  This option enables local-host communication support. If enabled,
	  local firmware can communicate with host SW. This function helps
	  managing the lower layer protocols and is transparent for
	  applications.

config HECI_CORE_ID
	int "heci core id for multiple cores system"
	default 0
	range 0 15
	help
	  HECI core id for multiple cores system.

if HOST_SERVICE

config HOST_SERVICE_BOOT_DELAY
	int "Host Service Boot Delay"
	default 0
	help
	  Seconds to delay before starting Host Service. It is for boot
	  timeout issue of host drivers on platforms with slow booting,
	  liking FPGA.

config SYS_MNG
	bool "System Management Protocol support"
	select HECI
	default y
	help
	  Local-host system management commands handling, which includes
	  logic layer synchronization between local and host. This flag
	  should be set if there is no hal level synchronization.

config HECI
	bool "HECI Protocol support"
	default y
	help
	  Host HECI protocol. HECI (Host Embedded Controller Interface) is
	  used as a transport protocol for communication of main FW with the
	  host.
	  HECI provides a bi-directional fully asynchronous communications
	  interface between host software and firmware. HECI “Client” refers
	  to the software endpoints that send and receive messages via HECI.
	  The HECI Client Message Link refers to the connection between a host
	  client and a FW client. Clients can be drivers, services, or
	  applications depending upon the architecture of the software stack
	  interfacing with HECI.

config HECI_ROUTER
	bool "HECI ROUTER function support"
	default n
	help
	  heci router offers capability that fw can forward message between
	  host and another core fw, which can be used for cross core heci
	  functions

config RTD3
	bool "rtd3, run time d3 support"
	default n
	depends on PM
	help
	  Run time d3 offers capability that host drivers could enter d3 on run
	  time, to avoid device access during that time

if HECI
rsource "heci/Kconfig"
endif

config HOST_TIME_SYNC
	bool "sync host utc time"
	default y
	help
	  Sync host utc time. If enabled, HOST driver will send utc time to
	  sync with FW, which may be applied on sensor's timestamping.

endif
endmenu
```

## zephyr/subsys/host_service/heci/Kconfig
```kconfig
# Copyright 2023 The ChromiumOS Authors
# Use of this source code is governed by a BSD-style license that can be
# found in the LICENSE file.

comment "local-host HECI protocol support"

module = HECI
module-str = heci
source "subsys/logging/Kconfig.template.log_config"

config WEAK_SMHI
	bool "enable the weak SMHI client"
	default n
	select REBOOT
	help
	  SMHI is a basic system HECI client used by host to get basic
	  fw status and info

if WEAK_SMHI
module = SMHI
module-str = smhi
source "subsys/logging/Kconfig.template.log_config"
endif

config HECI_INTF_IPC
	bool "support ipc as communication hal of heci"
	default n
	select IPC
	select IPC_SEDI
	help
	  Support IPC as communication hal of HECI, an IPC device is treated
	  as hal bridge with host.

config HECI_INTF_IPM
	bool "support ipm as communication hal of heci"
	default n
	select IPM
	select IPM_SEDI
	help
	  Support ipm as communication hal of HECI, an IPM device is treated
	  as hal bridge with host.

config HECI_MSG_DUMP
	bool "if HECI message dumping is neeed for debugging"
	default n
	depends on LOG
	help
	  This configuration is used for HECI debugging, to print all
	  HECI in/out message

config HECI_MAX_MSG_SIZE
	int "max message size of HECI protocol"
	default 16384
	range 1024 65536
	help
	  Set this to config max message size of HECI protocol

config HECI_MAX_FRAG_SIZE
	int "max size of single heci fragment"
	default 128 if HECI_INTF_IPC && (!HECI_ROUTER)
	default 4096
	range 64 4096
	help
	  HECI message will be divided into fragments, this kconfig
	  sets the max fragment message size

config HECI_PAGE_SIZE
	int "max page size of HECI protocol"
	default 4096
	help
	  Set this to config page size of HECI protocol,
	  equals the page size of local sram

config HECI_FC_WAIT_TIMEOUT
	int "timeout in ms to wait flow control when send heci message"
	default 5000
	help
	  The max time in ms that the heci client message sending will
	  wait for the flow control from peer client.

config HECI_USE_DMA
	bool "if HECI use dma to transfer dma, as an extension of ipc"
	default n
	help
	 Set the HECI_USE_DMA to config HECI to use dma, while data
	 length is too long.

if HECI_USE_DMA
config HECI_DMA_THRESHOLD
	int "the threshold when using dma in HECI"
	default 372
	help
	  When data legnth exceeds the max length of ipc msg size, HECI
	  should use dma, and the threshold should no larger than max
	  size of ipc msg field.

config DMA_ALIGN_SIZE
	int "dma align size"
	default 32
	help
	  DMA align size

endif
```

## zephyr/subsys/pd_controller/Kconfig
```kconfig
# Copyright 2023 The ChromiumOS Authors
# Use of this source code is governed by a BSD-style license that can be
# found in the LICENSE file.

if PLATFORM_EC_USBC

rsource "Kconfig.usbc_altmode"

menuconfig USB_PDC_POWER_MGMT
	bool "Configure USB-C PD Controller"
	depends on PLATFORM_EC_USB_PD_CONTROLLER
	depends on PLATFORM_EC_CHARGER
	default y
	select SMF
	select SMF_ANCESTOR_SUPPORT
	select EVENTS
	help
	  Enable this to support configuring the USB-C power management
	  when using Power Delivery Controllers.

config PDC_POWER_MGMT_INIT_PRIORITY
	int "USB-C stack init priority"
	default 91
	help
	  Initialization priority of the USB-C in POST_KERNEL.

config CHARGE_MANAGER_SYS_INIT_PRIORITY
	int "USB-C stack init priority"
	default 89
	help
	  Initialization priority of the charge manager weh using the PDC
	  power management subsystem.  This must be higher priority than the
	  PDC power management initialization priority.

config PDC_POWER_MGMT_THREAD_PRIORTY
	int "USB-C thread priority"
	default 0
	help
	  Set thread priority of the USB-C

config PDC_POWER_MGMT_STACK_SIZE
	int "USB-C thread stack size"
	default 1024
	help
	  Stack size of thread created for each instance.

choice PDC_POWER_MGMT_SRC_PDO_PEAK_OCP
	prompt "Peak overcurrent capability advertised in the source PDO"
	default PDC_POWER_MGMT_SRC_PDO_PEAK_OCP_100
	help
	  Set the allowable peak overcurrent as a percentage of the normal
	  current limit. See USB-PD Spec, ver 3.2, Table 6.10 for a full
	  explanation of the settings.

config PDC_POWER_MGMT_SRC_PDO_PEAK_OCP_100
	bool "Peak overcurrent of 100%"
	help
	  The PDC does not support any peak current beyond normal operating
	  levels

config PDC_POWER_MGMT_SRC_PDO_PEAK_OCP_110
	bool "Peak overcurrent of 110%"
	help
	  The PDC supports 110% for 10ms, 125% for 2ms, 150% for 1ms (relative
	  to normal operating current)

config PDC_POWER_MGMT_SRC_PDO_PEAK_OCP_125
	bool "Peak overcurrent of 125%"
	help
	  The PDC supports 125% for 10ms, 150% for 2ms, 200% for 1ms (relative
	  to normal operating current)

config PDC_POWER_MGMT_SRC_PDO_PEAK_OCP_150
	bool "Peak overcurrent of 150%"
	help
	  The PDC supports 150% for 10ms, 175% for 2ms, 200% for 1ms (relative
	  to normal operating current)

endchoice # PDC_POWER_MGMT_SRC_PDO_PEAK_OCP

config PDC_POWER_MGMT_STATE_MACHINE_SETTLED_TIMEOUT_MS
	int "PDC_SM_SETTLED_TIMEOUT_MS timeout duration (ms)"
	default 2000 # milliseconds
	help
	  Set the timeout duration, in milliseconds, when waiting on the PDC
	  state machine to settle on a resting state in the function
	  pdc_power_mgmt_wait_for_sync(). The default of 2000ms
	  matches the PDC command processing timeout (PDC_CMD_TIMEOUT_MS).

config PDC_POWER_MGMT_USB_MUX
	bool "Enable USB mux control"
	depends on PLATFORM_EC_USB_MUX && USB_PDC_POWER_MGMT
	help
	  Enable USB mux control in PDC power manager.  This needs to be
	  enabled if the USB3/DP mux control is managed by the EC rather than
	  the SoC.

if PDC_POWER_MGMT_USB_MUX
config USB_MUX_SYS_INIT_PRIORITY
	int "USB mux module init priority"
	default 89
	help
	  Initialization priority of the usb mux module when using the PDC
	  power management subsystem.  This must be higher priority than the
	  PDC power management initialization priority.
endif

module = USB_PDC
module-str = USB PDC
source "subsys/logging/Kconfig.template.log_config"

endif # PLATFORM_EC_USBC
```

## zephyr/subsys/ucsi/Kconfig
```kconfig
# Copyright 2024 The ChromiumOS Authors
# Use of this source code is governed by a BSD-style license that can be
# found in the LICENSE file.

config UCSI_PPM
	bool "UCSI Platform Policy Manager"
	default n
	help
	  Enable this to support UCSI platform policy manager (PPM).

config UCSI_PPM_STACK_SIZE
	int "UCSI PPM implementation thread stack size"
	default 1024
	help
	  Stack size of thread created for PPM.

config UCSI_PPM_THREAD_PRIORITY
	int "UCSI PPM thread priority"
	default 0
	help
	  Set thread priority of the PPM.

config UCSI_PPM_CONSOLE
	bool "UCSI PPM console commands"
	help
	  Enable the `ppm` console command, which supports calling various
	  UCSI commands through the PPM subsystem to the PDCs.

config UCSI_PPM_INIT_PRIORITY
	int "USCI PPM init priority"
	default 92
	help
	  Initialization priority of the PPM (POST_KERNEL). Must come after
	  CONFIG_PDC_POWER_MGMT_INIT_PRIORITY

module = UCSI_PPM
module-str = UCSI PPM
source "subsys/logging/Kconfig.template.log_config"
```

## zephyr/subsys/usb_dc/Kconfig
```kconfig
# Copyright 2023 The ChromiumOS Authors
# Use of this source code is governed by a BSD-style license that can be
# found in the LICENSE file.

config USB_DEVICE_GOOGLE_UPDATE
	bool "USB Google support"
	depends on USB_DEVICE_STACK
	depends on PLATFORM_EC_USB_UPDATE
	select NET_BUF
	default y
	help
	  Enable Google vender specific class.

config GOOGLE_UPDATE_RX_THREAD_PRIORTY
	int "Google update RX thread priority"
	depends on USB_DEVICE_GOOGLE_UPDATE
	default 8
	help
	  Set thread priority of the Google update RX.

config GOOGLE_UPDATE_RX_STACK_SIZE
	int "Size of the Rx thread stack"
	depends on USB_DEVICE_GOOGLE_UPDATE
	default 2048
	help
	  Size of the Rx thread stack.

config GOOGLE_UPDATE_TX_THREAD_PRIORTY
	int "Google update TX thread priority"
	depends on USB_DEVICE_GOOGLE_UPDATE
	default 8
	help
	  Set thread priority of the Google update TX.

config GOOGLE_UPDATE_TX_STACK_SIZE
	int "Size of the Tx thread stack"
	depends on USB_DEVICE_GOOGLE_UPDATE
	default 1024
	help
	  Size of the Tx thread stack.

config USB_DC_HID_KEYBOARD
	bool "Enable support USB HID keyboard"
	depends on USB_DEVICE_STACK
	default n
	help
	  Enable keyboard support in RW firmware.

config USB_DC_KEYBOARD_HID_NUM
	int "Set the HID number for keyboard instance name"
	depends on USB_DC_HID_KEYBOARD
	default 0
	help
	  Set the hid number for keyboard instance name.
	  The format of hid instance name is name_n, where the name can be
	  configured by CONFIG_USB_HID_DEVICE_NAME and n(hid number) should be in
	  the range of 0 to (CONFIG_USB_HID_DEVICE_COUNT - 1).

config USB_DC_HID_VIVALDI
	bool "Enable support vivaldi keyboard"
	depends on USB_DC_HID_KEYBOARD
	default n
	help
	  Enable code for Vivaldi keyboard (standard for new Chromium OS
	  devices).

config USB_DC_KEYBOARD_NUM_TOP_ROW_KEYS
	int "Keyboard top raw key number"
	depends on USB_DC_HID_VIVALDI
	default 10
	range 10 15
	help
	  The number of top raw keys.
	  The number should be between 10 and 15.

config USB_DC_KEYBOARD_ASSISTANT_KEY
	bool "Enable support assistant key"
	depends on USB_DC_HID_KEYBOARD
	default n
	help
	  Enable assistant key for keyboard device.

config USB_DC_KEYBOARD_TABLET_MODE_SWITCH
	bool "Enable support tablet mode switch key"
	depends on USB_DC_HID_KEYBOARD
	default n
	help
	  Enable tablet mode switch for keyboard device.

config USB_DC_HID_TOUCHPAD
	bool "Enable support USB HID touchpad"
	depends on USB_DEVICE_STACK
	default n
	help
	  Enable touchpad support in RW firmware.

config USB_DC_TOUCHPAD_HID_NUM
	int "Set the HID number for touchpad instance name"
	depends on USB_DC_HID_TOUCHPAD
	default 1
	help
	  Set the hid number for touchpad instance name.
	  The format of hid instance name is name_n, where the name can be
	  configured by CONFIG_USB_HID_DEVICE_NAME and n(hid number) should be in
	  the range of 0 to (CONFIG_USB_HID_DEVICE_COUNT - 1).

if CROS_EC_RW

config USB_HID_DEVICE_COUNT
	default 0 if !USB_DC_HID_KEYBOARD && !USB_DC_HID_TOUCHPAD
	default 2 if USB_DC_HID_KEYBOARD && USB_DC_HID_TOUCHPAD
	default 1

config USB_DEVICE_HID
	default y if USB_DC_HID_KEYBOARD || USB_DC_HID_TOUCHPAD

config USB_HID_BOOT_PROTOCOL
	default y

config HID_INTERRUPT_EP_MPS
	default 64

config USB_HID_POLL_INTERVAL_MS
	default 1

endif # CROS_EC_RW

rsource "Kconfig.gi2c"
```

## zephyr/subsys/usb_dc/Kconfig.gi2c
```kconfig
# Copyright 2024 The ChromiumOS Authors
# Use of this source code is governed by a BSD-style license that can be
# found in the LICENSE file.

config USB_DEVICE_GOOGLE_I2C
	bool "USB Google I2C class support"
	depends on USB_DEVICE_STACK
	depends on PLATFORM_EC_USB_I2C
	select NET_BUF
	default y
	help
	  Enable Google vender specific I2C class.

config GOOGLE_I2C_RX_THREAD_PRIORTY
	int "Google I2C RX thread priority"
	depends on USB_DEVICE_GOOGLE_I2C
	default 8
	help
	  Set thread priority of the Google I2C RX.

config GOOGLE_I2C_RX_STACK_SIZE
	int "Size of the Rx thread stack"
	depends on USB_DEVICE_GOOGLE_I2C
	default 1024
	help
	  Size of the Rx thread stack.

config GOOGLE_I2C_TX_THREAD_PRIORTY
	int "Google I2C TX thread priority"
	depends on USB_DEVICE_GOOGLE_I2C
	default 8
	help
	  Set thread priority of the Google I2C TX.

config GOOGLE_I2C_TX_STACK_SIZE
	int "Size of the Tx thread stack"
	depends on USB_DEVICE_GOOGLE_I2C
	default 1024
	help
	  Size of the Tx thread stack.
```

## zephyr/subsys/usb_pd/Kconfig.usbc_altmode
```kconfig
# Copyright 2023 The ChromiumOS Authors
# Use of this source code is governed by a BSD-style license that can be
# found in the LICENSE file.

if PLATFORM_EC_USB_PD_CONTROLLER

menuconfig USB_PD_ALTMODE
	bool "Configure USB-C Alternate modes"
	default y
	help
	  Enables the alternate modes of USB-C when using dedicated power
	  delivery controllers in PD mode.

module = USB_PD_ALTMODE
module-str = USB PD Alternate Mode
source "subsys/logging/Kconfig.template.log_config"

if USB_PD_ALTMODE

menuconfig USB_PD_ALTMODE_INTEL
	bool "Configure USB-C Alternate modes on Intel SoC"
	default y if DT_HAS_INTEL_PD_ALTMODE_ENABLED
	select EVENTS
	help
	  Enable this to support configuring the USB-C alternate modes on
	  Intel SoC when using PD chips in PD mode.

if USB_PD_ALTMODE_INTEL

config TASK_PD_ALTMODE_INTEL_STACK_SIZE
	int "USB PD Alternate mode thread stack size (in bytes)"
	help
	  This option specifies the size of the stack used by the
	  USB PD Alternate mode thread.

config USBPD_ALTMODE_INTEL_THREAD_PRIORITY
	int "USB PD Alternate mode thread priority"
	default 8
	help
	  This option determines the USB PD alternate mode thread priority,
	  this number must be selected in such way thread priority is lower
	  than the USB PD task that handles the power delivery aspects.

config CONSOLE_CMD_USBPD_INTEL_ALTMODE
	bool "Console command: altmode"
	default y
	help
	  Enable this to read/write to the status/control registers of
	  PD that are compliant with Intel alternate mode configuration
	  specification.

endif # USB_PD_ALTMODE_INTEL

endif # USB_PD_ALTMODE

endif # PLATFORM_EC_USB_PD_CONTROLLER
```
