## zephyr/subsys/usbd_service/Kconfig
```kconfig
# Copyright 2024 The ChromiumOS Authors
# Use of this source code is governed by a BSD-style license that can be
# found in the LICENSE file.

config COMMON_LIBC_MALLOC_ARENA_SIZE
	default 1024 if USB_DEVICE_STACK_NEXT

choice USBD_LOG_LEVEL_CHOICE
	default USBD_LOG_LEVEL_WRN
endchoice

choice USBD_HID_LOG_LEVEL_CHOICE
	default USBD_HID_LOG_LEVEL_WRN
endchoice

choice UDC_DRIVER_LOG_LEVEL_CHOICE
	default UDC_DRIVER_LOG_LEVEL_WRN
endchoice

config USBD_HID_KEYBOARD
	bool "Enable support USB HID keyboard"
	depends on USB_DEVICE_STACK_NEXT
	default n
	help
	  Enable keyboard support.

config USBD_HID_KEYBOARD_QUEUE_SIZE
	int "Keyboard report queue size"
	depends on USBD_HID_KEYBOARD
	default 32
	help
	  The report queue size for Keyboard device.

config USBD_HID_VIVALDI
	bool "Enable support vivaldi keyboard"
	depends on USBD_HID_KEYBOARD
	default n
	help
	  Enable code for Vivaldi keyboard (standard for new Chromium OS
	  devices).

config USBD_KEYBOARD_NUM_TOP_ROW_KEYS
	int "Keyboard top raw key number"
	depends on USBD_HID_VIVALDI
	default 10
	range 10 15
	help
	  The number of top raw keys.
	  The number should be between 10 and 15.

config USBD_KEYBOARD_ASSISTANT_KEY
	bool "Enable support assistant key"
	depends on USBD_HID_KEYBOARD
	default n
	help
	  Enable assistant key for keyboard device.

config USBD_KEYBOARD_TABLET_MODE_SWITCH
	bool "Enable support tablet mode switch key"
	depends on USBD_HID_KEYBOARD
	default n
	help
	  Enable tablet mode switch for keyboard device.

config USBD_HID_TOUCHPAD
	bool "Enable support USB HID touchpad"
	depends on USB_DEVICE_STACK_NEXT
	default n
	help
	  Enable touchpad support.

config USBD_HID_TOUCHPAD_QUEUE_SIZE
	int "Touchpad report queue size"
	depends on USBD_HID_TOUCHPAD
	default 8
	help
	  The report queue size for Touchpad device.

menu "USB device options"
	depends on USB_DEVICE_STACK_NEXT

config USB_DEVICE_MANUFACTURER
	string "USB device manufacturer string"
	default "Google LLC"
	help
	  USB device manufacturer string.

config USB_DEVICE_PRODUCT
	string "USB device product string"
	default "HID KB and TP Sample"
	help
	  USB device product stringa.

config USB_DEVICE_SN
	string "USB device serial number string"
	default "0123456789ABCDEF"
	help
	  Placeholder for USB device serial number string.

config USB_DEVICE_VID
	hex "USB device Vendor ID"
	default 0x18D1
	help
	  USB device Vendor ID.

config USB_DEVICE_PID
	hex "USB device Product ID"
	default 0x0000
	help
	  USB device Product ID.

config USB_DEVICE_SELF_POWERED
	bool "USB device HID Self-powered attribute"
	default n
	help
	  Set the Self-powered attribute in the HID configuration.

config USB_DEVICE_REMOTE_WAKEUP
	bool "USB device HID Remote Wakeup attribute"
	default y
	help
	  Set the Remote Wakeup attribute in the HID configuration.

config USB_DEVICE_MAX_POWER
	int "USB device HID bMaxPower value"
	default 125
	range 0 250
	help
	  bMaxPower value in the HID configuration in 2 mA units.

if CROS_EC_RW

config USBD_HID_SUPPORT
	default y if USBD_HID_KEYBOARD || USBD_HID_TOUCHPAD
	default n

endif # CROS_EC_RW

if CROS_EC_RO

config USBD_HID_SUPPORT
	default n

endif # CROS_EC_RO

endmenu

rsource "Kconfig.gupdate"
rsource "Kconfig.gi2c"
```

## zephyr/subsys/usbd_service/Kconfig.gupdate
```kconfig
# Copyright 2024 The ChromiumOS Authors
# Use of this source code is governed by a BSD-style license that can be
# found in the LICENSE file.

config USBD_GOOGLE_UPDATE_SUPPORT
	bool "USB Google update support"
	depends on USB_DEVICE_STACK_NEXT
	depends on PLATFORM_EC_USB_UPDATE
	select NET_BUF
	default y
	help
	  Enable Google vender specific class.

config GOOGLE_UPDATE_RX_THREAD_PRIORTY
	int "Google update RX thread priority"
	depends on USBD_GOOGLE_UPDATE_SUPPORT
	default 8
	help
	  Set thread priority of the Google update RX.

config GOOGLE_UPDATE_RX_STACK_SIZE
	int "Size of the Rx thread stack"
	depends on USBD_GOOGLE_UPDATE_SUPPORT
	default 2048
	help
	  Size of the Rx thread stack.

config GOOGLE_UPDATE_TX_THREAD_PRIORTY
	int "Google update TX thread priority"
	depends on USBD_GOOGLE_UPDATE_SUPPORT
	default 8
	help
	  Set thread priority of the Google update TX.

config GOOGLE_UPDATE_TX_STACK_SIZE
	int "Size of the Tx thread stack"
	depends on USBD_GOOGLE_UPDATE_SUPPORT
	default 1024
	help
	  Size of the Tx thread stack.
```

## zephyr/test/amd/testcase.yaml
```yaml
# Copyright 2023 The ChromiumOS Authors
# Use of this source code is governed by a BSD-style license that can be
# found in the LICENSE file.

common:
  platform_allow: native_posix
tests:
  amd.power:
    extra_configs:
      - CONFIG_PLATFORM_EC_EMULATED_SYSRQ=y
      - CONFIG_PLATFORM_EC_MKBP_EVENT=y
      - CONFIG_TEST_AMD_POWER=y
  amd.power_ro:
    extra_args:
      - EXTRA_CFLAGS=-DSECTION_IS_RO
    extra_configs:
      - CONFIG_TEST_AMD_POWER=y
  amd.power_rw:
    extra_args:
      - EXTRA_CFLAGS=-DSECTION_IS_RW
    extra_configs:
      - CONFIG_PLATFORM_EC_EMULATED_SYSRQ=y
      - CONFIG_PLATFORM_EC_MKBP_EVENT=y
      - CONFIG_TEST_AMD_POWER=y
```

## zephyr/test/amd_power/testcase.yaml
```yaml
common:
  platform_allow: native_posix
tests:
  amd_power.default:
    extra_dtc_overlay_files:
    - boards/native_posix.overlay
```

## zephyr/test/boot_keys/testcase.yaml
```yaml
common:
  platform_allow: native_sim
tests:
  boot_keys.default: {}
  boot_keys.ignore_key:
    extra_configs:
      - CONFIG_BOOT_KEYS_GHOST_REFRESH_WORKAROUND=y
```

## zephyr/test/brox/Kconfig
```kconfig
# Copyright 2024 The ChromiumOS Authors
# Use of this source code is governed by a BSD-style license that can be
# found in the LICENSE file.

choice TEST_BOARD_VARIANT
	prompt "Select board variant for tests"
	help
	  Board variant to use for tests

	config TEST_BOARD_BASEBOARD
		bool "Enable baseboard-specific tests"
		help
		  Enable baseboard tests.

	config TEST_BOARD_BROX
		bool "Enable brox-specific tests"
		help
		  Enable Brox tests.

	config TEST_BOARD_LOTSO
		bool "Enable lotso-specific tests"
		help
		  Enable Lotso tests.

endchoice # TEST_BOARD_VARIANT

config TEST_BOARD_NAME
	string "Board name"
	default "baseboard" if TEST_BOARD_BASEBOARD
	default "brox" if TEST_BOARD_BROX

config TEST_BOARD_HIBERNATE
	bool "Run hibernate tests"

config TEST_BOARD_SUSPEND_RESUME
	bool "Run suspend/resume tests"

config TEST_BOARD_USBC
	bool "Run USB-C tests"

config TEST_BOARD_LOTSO_KEYBOARD
	bool "Enable lotso keyboard tests"

config PLATFORM_EC_KEYBOARD_CUSTOMIZATION
	bool "Support keyboard customization"

config PLATFORM_EC_KEYBOARD_DEBUG
	bool "Enable keyboard debug prints"

source "Kconfig.zephyr"
```

## zephyr/test/brox/testcase.yaml
```yaml
# Copyright 2024 The ChromiumOS Authors
# Use of this source code is governed by a BSD-style license that can be
# found in the LICENSE file.

common:
  platform_allow: native_sim
tests:
  # Baseboard tests
  brox.baseboard:
    extra_configs:
    - CONFIG_TEST_BOARD_BASEBOARD=y
    extra_dtc_overlay_files:
    - boards/baseboard/baseboard.overlay

  brox.baseboard.usbc:
    extra_configs:
    - CONFIG_TEST_BOARD_BASEBOARD=y
    - CONFIG_TEST_BOARD_USBC=y
    extra_dtc_overlay_files:
    - boards/baseboard/baseboard.overlay

  brox.baseboard.hibernate:
    extra_configs:
    - CONFIG_TEST_BOARD_BASEBOARD=y
    - CONFIG_TEST_BOARD_HIBERNATE=y
    extra_dtc_overlay_files:
    - boards/baseboard/baseboard.overlay

  brox.baseboard.suspend_resume:
    extra_configs:
    - CONFIG_TEST_BOARD_BASEBOARD=y
    - CONFIG_TEST_BOARD_SUSPEND_RESUME=y
    extra_dtc_overlay_files:
    - boards/baseboard/baseboard.overlay

  brox.lotso.keyboard:
    extra_configs:
    - CONFIG_TEST_BOARD_LOTSO=y
    - CONFIG_TEST_BOARD_LOTSO_KEYBOARD=y
    - CONFIG_PLATFORM_EC_KEYBOARD_CUSTOMIZATION=y
    - CONFIG_PLATFORM_EC_KEYBOARD_DEBUG=y
    extra_dtc_overlay_files:
    - boards/baseboard/baseboard.overlay

  brox.greenbayupoc.keyboard:
    extra_configs:
    - CONFIG_TEST_BOARD_GREENBAYUPOC=y
    - CONFIG_TEST_BOARD_GREENBAYUPOC_KEYBOARD=y
    - CONFIG_PLATFORM_EC_KEYBOARD_CUSTOMIZATION=y
    - CONFIG_PLATFORM_EC_KEYBOARD_DEBUG=y
    extra_dtc_overlay_files:
    - boards/baseboard/baseboard.overlay

  brox.jubilant.keyboard:
    extra_configs:
    - CONFIG_TEST_BOARD_JUBILANT=y
    - CONFIG_TEST_BOARD_JUBILANT_KEYBOARD=y
    - CONFIG_PLATFORM_EC_KEYBOARD_CUSTOMIZATION=y
    - CONFIG_PLATFORM_EC_KEYBOARD_DEBUG=y
    - CONFIG_POSIX_ARCH_CONSOLE_INIT_PRIORITY=98
    - CONFIG_PLATFORM_EC_CONSOLE_INIT_PRIORITY=99
    - CONFIG_LOG=y
    - CONFIG_LOG_MODE_MINIMAL=y
    extra_dtc_overlay_files:
    - boards/jubilant.overlay

  brox.lotso.sensor:
    extra_configs:
    - CONFIG_TEST_BOARD_LOTSO=y
    - CONFIG_TEST_BOARD_LOTSO_SENSOR=y
    extra_dtc_overlay_files:
    - boards/lotso.overlay
```

## zephyr/test/console/Kconfig
```kconfig
# Copyright 2024 The ChromiumOS Authors
# Use of this source code is governed by a BSD-style license that can be
# found in the LICENSE file.

config TEST_CONSOLE_OUTPUT
	bool "Console filtering tests"
	help
	  EC console output tests.  These tests validate that both legacy
	  cprints/cprintf/cputs calls and Zephyr logging calls are routed
	  to the chosen UART.

config TEST_CONSOLE_RESTRICTED
	bool "Console restricted tests"
	help
	  Console restricted tests.

config BOARD_FINGERPRINT
	bool "Simulate Fingerprint board"
	help
	  Simulate Fingerprint board for testing purposes.

source "Kconfig.zephyr"
```

## zephyr/test/console/testcase.yaml
```yaml
common:
  platform_allow: native_sim
tests:
  # The UART API provides both interrupt driven and modes.
  console.output.interrupt:
    extra_conf_files:
    - console_output.conf
    extra_dtc_overlay_files:
    - boards/native_sim.overlay
    - console_output.dts
    extra_configs:
    - CONFIG_TEST_CONSOLE_OUTPUT=y
    - CONFIG_SHELL_BACKEND_SERIAL_API_INTERRUPT_DRIVEN=y
    - CONFIG_SHELL_BACKEND_SERIAL_API_POLLING=n
  console.output.interrupt.noisr:
    extra_conf_files:
    - console_output.conf
    extra_dtc_overlay_files:
    - boards/native_sim.overlay
    - console_output.dts
    extra_configs:
    - CONFIG_TEST_CONSOLE_OUTPUT=y
    - CONFIG_SHELL_BACKEND_SERIAL_API_INTERRUPT_DRIVEN=y
    - CONFIG_SHELL_BACKEND_SERIAL_API_POLLING=n
    - CONFIG_PLATFORM_EC_ISR_CONSOLE_OUTPUT=n
  console.output.polling:
    extra_conf_files:
    - console_output.conf
    extra_dtc_overlay_files:
    - boards/native_sim.overlay
    - console_output.dts
    extra_configs:
    - CONFIG_TEST_CONSOLE_OUTPUT=y
    - CONFIG_UART_ASYNC_API=y
    - CONFIG_SHELL_BACKEND_SERIAL_API_INTERRUPT_DRIVEN=n
    - CONFIG_SHELL_BACKEND_SERIAL_API_POLLING=y
  console.output.polling.noisr:
    extra_conf_files:
    - console_output.conf
    extra_dtc_overlay_files:
    - boards/native_sim.overlay
    - console_output.dts
    extra_configs:
    - CONFIG_TEST_CONSOLE_OUTPUT=y
    - CONFIG_UART_ASYNC_API=y
    - CONFIG_SHELL_BACKEND_SERIAL_API_INTERRUPT_DRIVEN=n
    - CONFIG_SHELL_BACKEND_SERIAL_API_POLLING=y
    - CONFIG_PLATFORM_EC_ISR_CONSOLE_OUTPUT=n
  console.restricted:
    extra_configs:
    - CONFIG_TEST_CONSOLE_RESTRICTED=y
    - CONFIG_BOARD_FINGERPRINT=y
```

## zephyr/test/crypto/Kconfig
```kconfig
# Copyright 2024 The ChromiumOS Authors
# Use of this source code is governed by a BSD-style license that can be
# found in the LICENSE file.

config TEST_SHA256
	bool "SHA256 tests"
	help
	  SHA256 tests.

source "Kconfig.zephyr"
```

## zephyr/test/crypto/testcase.yaml
```yaml
common:
  platform_allow: native_sim
tests:
  crypto.sha256:
    extra_configs:
    - CONFIG_TEST_SHA256=y
    - CONFIG_PLATFORM_EC_SHA256_SW=y
```

## zephyr/test/dsp_comms/testcase.yaml
```yaml
tests:
  cros.dsp.level_trigger.buffered_i2c:
    harness: gtest
    extra_dtc_overlay_files:
      - boards/native_sim.overlay
      - boards/native_sim.buffered_i2c.overlay
    extra_args:
      - TEST_LIB=cros.dsp.test
    platform_allow:
      - native_sim
  cros.dsp.level_trigger.pio_i2c:
    harness: gtest
    extra_dtc_overlay_files:
      - boards/native_sim.overlay
    extra_args:
      - TEST_LIB=cros.dsp.test
    platform_allow:
      - native_sim
  cros.dsp.edge_trigger.buffered_i2c:
    harness: gtest
    extra_dtc_overlay_files:
      - boards/native_sim.overlay
      - boards/native_sim.buffered_i2c.overlay
      - boards/native_sim.edge_trigger.overlay
    extra_args:
      - TEST_LIB=cros.dsp.test
    platform_allow:
      - native_sim
  cros.dsp.edge_trigger.pio_i2c:
    harness: gtest
    extra_dtc_overlay_files:
      - boards/native_sim.overlay
      - boards/native_sim.edge_trigger.overlay
    extra_args:
      - TEST_LIB=cros.dsp.test
    platform_allow:
      - native_sim
  pw_fsm.state_machine:
    harness: gtest
    extra_args:
      - TEST_LIB=pw_fsm.fsm_test
    platform_allow:
      - native_sim
  pw_transport.service:
    harness: gtest
    extra_args:
      - TEST_LIB=pw_transport.service_test
      - PW_TRANSPORT_STATUS_FLAGS_SIZE=2
    platform_allow:
      - native_sim
```
