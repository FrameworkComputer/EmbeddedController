/* Copyright 2024 The ChromiumOS Authors
 * Use of this source code is governed by a BSD-style license that can be
 * found in the LICENSE file.
 */

/* Arbitrage generates an incorrect node label when using alternate pins.
 * Create a 2nd node label on I2C3 as a workaround.
 * TODO: b/310227384 - I2C alternate selection not detected automatically.
 */
i2c3ALT: &i2c3 {
};


#include "../../../../program/brox/generated.dtsi"
#include "../../../../program/brox/gpio.dtsi"
