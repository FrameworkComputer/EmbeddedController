/* Copyright 2026 The ChromiumOS Authors
 * Use of this source code is governed by a BSD-style license that can be
 * found in the LICENSE file.
 */

&fake_keyboard {
	col-size = <16>;

	#include "../../../../program/brox/greenbayupoc/keyboard_set2.dtsi"
};
