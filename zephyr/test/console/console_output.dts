/* Copyright 2024 The ChromiumOS Authors
 * Use of this source code is governed by a BSD-style license that can be
 * found in the LICENSE file.
 */


/ {
	chosen {
		zephyr,console = &euart0;
		zephyr,shell-uart = &euart0;
	};

	euart0: uart_emul0 {
		compatible = "zephyr,uart-emul";
		current-speed = <0>;
		status = "okay";
		rx-fifo-size = <256>;
		tx-fifo-size = <256>;
	};
};