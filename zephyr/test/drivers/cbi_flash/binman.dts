/* Copyright 2023 The ChromiumOS Authors
 * Use of this source code is governed by a BSD-style license that can be
 * found in the LICENSE file.
 */

#include <cros/binman.dtsi>
#include <cros/cbi_flash.dtsi>

&cbi_flash {
	offset = <(0x40000 - 0x1000)>;
	size = <0x1000>;
};
