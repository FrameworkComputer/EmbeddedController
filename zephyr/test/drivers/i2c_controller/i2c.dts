/* Copyright 2022 The ChromiumOS Authors
 * Use of this source code is governed by a BSD-style license that can be
 * found in the LICENSE file.
 */

&i2c0 {
	/* Add a test I2C define */
	basic_i2c_device: basic_i2c_device@ec {
		compatible = "basic-i2c-device";
		status = "okay";
		reg = <0xec>;
	};
};
