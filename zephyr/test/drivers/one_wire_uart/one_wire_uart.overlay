/* Copyright 2023 The ChromiumOS Authors
 * Use of this source code is governed by a BSD-style license that can be
 * found in the LICENSE file.
 */

#include <board-overlays/native_sim.dts>

/ {
	uart2 {
		compatible = "zephyr,uart-emul";
		status = "okay";

		one_wire_uart: one-wire-uart {
			compatible = "cros-ec,one-wire-uart";
			status = "okay";
			id = <0>;
		};
	};
};
