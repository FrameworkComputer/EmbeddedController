/* Copyright 2025 The ChromiumOS Authors
 * Use of this source code is governed by a BSD-style license that can be
 * found in the LICENSE file.
 */

&i2c0 {
	rt3645_emul: richtek-imvp@20 {
		compatible = "richtek,rt3645";
		status = "okay";
		reg = <0x20>;
		enable-gpios = <&gpio0 27 GPIO_ACTIVE_HIGH>;
		update-data = <0x24 0x54 0x02>;
		update-crc = <0x12>;
	};
};
