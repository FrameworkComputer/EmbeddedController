/* Copyright 2024 The ChromiumOS Authors
 * Use of this source code is governed by a BSD-style license that can be
 * found in the LICENSE file.
 */

/ {
	tabletmode_interrupt: tabletmode-interrupt {
		compatible = "cros,tabletmode-interrupt";
		/* This test explicitly expects an active high interrupt */
		irq-gpios = <&gpio0 20 GPIO_ACTIVE_HIGH>;
	};
};
