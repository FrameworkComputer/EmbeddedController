/* Copyright 2023 The ChromiumOS Authors
 * Use of this source code is governed by a BSD-style license that can be
 * found in the LICENSE file.
 */

&i2c0 {
	upstream_battery: smartbattery@40 {
		compatible =  "sbs,default-sbs-gauge","sbs,sbs-gauge-new-api";
		reg = <0x40>;
		status = "okay";
		battery-cutoff-support;
	};
};
