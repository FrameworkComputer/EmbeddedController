## CMakeLists.txt
```
# Copyright 2022 The ChromiumOS Authors
# Use of this source code is governed by a BSD-style license that can be
# found in the LICENSE file.

target_include_directories(app PRIVATE ${CMAKE_CURRENT_SOURCE_DIR}/include)

target_sources(app PRIVATE src/usbc_alt_mode.c)
target_sources_ifdef(CONFIG_PLATFORM_EC_USB_PD_REQUIRE_AP_MODE_ENTRY app PRIVATE src/usbc_alt_mode__require_ap_mode_entry.c)
target_sources_ifndef(CONFIG_PLATFORM_EC_USB_PD_REQUIRE_AP_MODE_ENTRY
	app PRIVATE src/usbc_alt_mode_ec_mode_entry.c)
```

## prj.conf
```kconfig
# Copyright 2023 The ChromiumOS Authors
# Use of this source code is governed by a BSD-style license that can be
# found in the LICENSE file.

CONFIG_PLATFORM_EC_USB_PD_DP_HPD_GPIO=y
CONFIG_PLATFORM_EC_USB_PD_DATA_RESET_MSG=y
```

## include/test_usbc_alt_mode.h
```c
/* Copyright 2022 The ChromiumOS Authors
 * Use of this source code is governed by a BSD-style license that can be
 * found in the LICENSE file.
 */

#ifndef ZEPHYR_TEST_DRIVERS_USBC_ALT_MODE_TEST_USBC_ALT_MODE_H_
#define ZEPHYR_TEST_DRIVERS_USBC_ALT_MODE_TEST_USBC_ALT_MODE_H_

#include "compile_time_macros.h"
#include "emul/tcpc/emul_tcpci.h"
#include "emul/tcpc/emul_tcpci_partner_snk.h"
#include "test/drivers/stubs.h"

#include <stdbool.h>

#define TEST_PORT 0

/* Arbitrary */
#define PARTNER_PRODUCT_ID 0x1234
#define PARTNER_DEV_BINARY_CODED_DECIMAL 0x5678

BUILD_ASSERT(TEST_PORT == USBC_PORT_C0);

struct usbc_alt_mode_fixture {
	const struct emul *tcpci_emul;
	const struct emul *charger_emul;
	struct tcpci_partner_data partner;
	struct tcpci_src_emul_data src_ext;
};

struct usbc_alt_mode_custom_discovery_fixture {
	const struct emul *tcpci_emul;
	const struct emul *charger_emul;
	struct tcpci_partner_data partner;
	struct tcpci_src_emul_data src_ext;
};

struct usbc_alt_mode_dp_unsupported_fixture {
	const struct emul *tcpci_emul;
	const struct emul *charger_emul;
	struct tcpci_partner_data partner;
	struct tcpci_src_emul_data src_ext;
};

struct usbc_alt_mode_minus_dp_configure_fixture {
	const struct emul *tcpci_emul;
	const struct emul *charger_emul;
	struct tcpci_partner_data partner;
	struct tcpci_src_emul_data src_ext;
};

struct usbc_discovery_no_drs_fixture {
	const struct emul *tcpci_emul;
	const struct emul *charger_emul;
	struct tcpci_partner_data partner;
	struct tcpci_src_emul_data src_ext;
};

/** Assert that the TCPM sent or did not send a Data Reset message.
 *
 * Fail an assertion if the partner message log
 * 1) does not contain a Data Reset sent by the TCPM when one was expected, or
 * 2) does contain a Data Reset sent by the TCPM when none was expected.
 *
 * @param partner Partner emulator
 * @param want Whether the TCPM is expected to have sent a Data Reset
 */
void verify_data_reset_msg(struct tcpci_partner_data *partner, bool want);

/** Simulate a connection between the TCPM and the partner emulator.
 *
 * Take enough time to leave a normal connection in a settled state.
 *
 * @param tcpc_emul An emulator for the local TCPC
 * @param charger_emul An emulator for the local charger
 * @param partner_emul An emulator for the partner to be connected
 * @param src_ext An initialized source extension to be used by partner_emul
 */
void connect_partner_to_port(const struct emul *tcpc_emul,
			     const struct emul *charger_emul,
			     struct tcpci_partner_data *partner_emul,
			     const struct tcpci_src_emul_data *src_ext);

/** Simulate disconnecting the TCPM and the partner emulator.
 *
 * Take enough time to leave a normal connection in a settled state.
 *
 * @param tcpc_emul An emulator for the local TCPC
 * @param charger_emul An emulator for the local charger
 */
void disconnect_partner_from_port(const struct emul *tcpc_emul,
				  const struct emul *charger_emul);

#endif /* ZEPHYR_TEST_DRIVERS_USBC_ALT_MODE_TEST_USBC_ALT_MODE_H_ */
```

## src/usbc_alt_mode__require_ap_mode_entry.c
```c
/* Copyright 2022 The ChromiumOS Authors
 * Use of this source code is governed by a BSD-style license that can be
 * found in the LICENSE file.
 */

#include "test/drivers/utils.h"
#include "test_usbc_alt_mode.h"
#include "usb_pd_vdo.h"

#include <zephyr/drivers/gpio/gpio_emul.h>
#include <zephyr/kernel.h>
#include <zephyr/ztest.h>

#include <gpio.h>

/* Tests that require CONFIG_PLATFORM_EC_USB_PD_REQUIRE_AP_MODE_ENTRY enabled */

ZTEST_F(usbc_alt_mode, test_displayport_mode_reentry)
{
	if (!IS_ENABLED(CONFIG_PLATFORM_EC_USB_PD_REQUIRE_AP_MODE_ENTRY)) {
		ztest_test_skip();
	}

	host_cmd_typec_control_enter_mode(TEST_PORT, TYPEC_MODE_DP);
	k_sleep(K_SECONDS(1));

	/* DPM configures the partner on DP mode entry */
	/* Verify port partner thinks its configured for DisplayPort */
	zassert_true(fixture->partner.displayport_configured);

	tcpci_partner_common_enable_pd_logging(&fixture->partner, true);
	host_cmd_typec_control_exit_modes(TEST_PORT);
	k_sleep(K_SECONDS(1));
	zassert_false(fixture->partner.displayport_configured);
	/*
	 * As with initial entry, for an AMA partner, the TCPM should not issue
	 * a Data Reset.
	 */
	verify_data_reset_msg(&fixture->partner, false);

	host_cmd_typec_control_enter_mode(TEST_PORT, TYPEC_MODE_DP);
	k_sleep(K_SECONDS(1));
	zassert_true(fixture->partner.displayport_configured);

	/*
	 * Verify that DisplayPort is the active alternate mode by checking our
	 * MUX settings
	 */
	struct ec_response_typec_status status;

	status = host_cmd_typec_status(TEST_PORT);
	zassert_equal((status.mux_state & USB_PD_MUX_DP_ENABLED),
		      USB_PD_MUX_DP_ENABLED, "Failed to see DP mux set");
}

ZTEST_F(usbc_alt_mode, test_mode_exit_via_pd_host_cmd)
{
	const struct gpio_dt_spec *gpio =
		GPIO_DT_FROM_NODELABEL(gpio_usb_c0_hpd);

	if (!IS_ENABLED(CONFIG_PLATFORM_EC_USB_PD_REQUIRE_AP_MODE_ENTRY)) {
		ztest_test_skip();
	}

	host_cmd_typec_control_enter_mode(TEST_PORT, TYPEC_MODE_DP);
	k_sleep(K_SECONDS(1));

	/*
	 * Set HPD so we can see it clear on Exit
	 */
	uint32_t vdm_attention_data[2];

	vdm_attention_data[0] =
		VDO(USB_SID_DISPLAYPORT, 1,
		    VDO_OPOS(1) | VDO_CMDT(CMDT_INIT) | CMD_ATTENTION);
	vdm_attention_data[1] = VDO_DP_STATUS(1, /* IRQ_HPD */
					      true, /* HPD_HI|LOW - Changed*/
					      0, /* request exit DP */
					      0, /* request exit USB */
					      0, /* MF pref */
					      true, /* DP Enabled */
					      0, /* power low e.g. normal */
					      0x2 /* Connected as Sink */);
	tcpci_partner_send_data_msg(&fixture->partner, PD_DATA_VENDOR_DEF,
				    vdm_attention_data, 2, 0);

	k_sleep(K_SECONDS(1));
	zassert_equal(gpio_emul_output_get(gpio->port, gpio->pin), 1);

	host_cmd_typec_control_exit_modes(TEST_PORT);
	k_sleep(K_SECONDS(1));
	zassert_false(fixture->partner.displayport_configured);
	zassert_equal(gpio_emul_output_get(gpio->port, gpio->pin), 0);

	/*
	 * Verify that DisplayPort is no longer active by checking our
	 * MUX settings
	 */
	struct ec_response_typec_status status;

	status = host_cmd_typec_status(TEST_PORT);
	zassert_equal((status.mux_state & USB_PD_MUX_DP_ENABLED), 0);
}

ZTEST_F(usbc_alt_mode, test_early_status_hpd_set)
{
	const struct gpio_dt_spec *gpio =
		GPIO_DT_FROM_NODELABEL(gpio_usb_c0_hpd);

	if (!IS_ENABLED(CONFIG_PLATFORM_EC_USB_PD_REQUIRE_AP_MODE_ENTRY)) {
		ztest_test_skip();
	}

	/*
	 * Tweak our DP:Status reply to set HPD and ensure it's transmitted
	 * through our HPD GPIO
	 */
	fixture->partner.dp_status_vdm[VDO_INDEX_HDR + 1] =
		/* Mainly copied from hoho */
		VDO_DP_STATUS(0, /* IRQ_HPD */
			      true, /* HPD_HI|LOW - Changed*/
			      0, /* request exit DP */
			      0, /* request exit USB */
			      0, /* MF pref */
			      true, /* DP Enabled */
			      0, /* power low e.g. normal */
			      0x2 /* Connected as Sink */);

	host_cmd_typec_control_enter_mode(TEST_PORT, TYPEC_MODE_DP);
	k_sleep(K_SECONDS(1));

	zassert_equal(gpio_emul_output_get(gpio->port, gpio->pin), 1);
}

ZTEST_F(usbc_alt_mode_custom_discovery, test_hub_no_usb4_no_alt_mode)
{
	struct tcpci_partner_data *partner = &fixture->partner;

	if (!IS_ENABLED(CONFIG_PLATFORM_EC_USB_PD_REQUIRE_AP_MODE_ENTRY)) {
		ztest_test_skip();
	}

	/* If the partner has Hub product type but does not set the USB4 device
	 * capability or Alternate Modes field in its Discover Identity
	 * response, the TCPM should not send Data Reset during mode entry.
	 */
	partner->identity_vdm[VDO_INDEX_IDH] = VDO_IDH_REV30(
		/* USB host */ false, /* USB device */ false, IDH_PTYPE_HUB,
		/* modal operation */ true, /* DFP type */ 0,
		/* connector type */ 3, USB_VID_GOOGLE);
	partner->identity_vdm[VDO_INDEX_PTYPE_UFP1_VDO] = VDO_UFP1(
		/* Capability */ VDO_UFP1_CAPABILITY_USB32,
		/* connector type */ 0, /* alternate modes */ 0, /* speed */ 1);
	connect_partner_to_port(fixture->tcpci_emul, fixture->charger_emul,
				&fixture->partner, &fixture->src_ext);

	tcpci_partner_common_clear_logged_msgs(&fixture->partner);
	tcpci_partner_common_enable_pd_logging(&fixture->partner, true);
	host_cmd_typec_control_enter_mode(TEST_PORT, TYPEC_MODE_DP);
	k_sleep(K_SECONDS(1));

	verify_data_reset_msg(&fixture->partner, false);
}

ZTEST_F(usbc_alt_mode_custom_discovery, test_hub_no_ufp_vdo)
{
	struct tcpci_partner_data *partner = &fixture->partner;

	if (!IS_ENABLED(CONFIG_PLATFORM_EC_USB_PD_REQUIRE_AP_MODE_ENTRY)) {
		ztest_test_skip();
	}

	partner->identity_vdm[VDO_INDEX_IDH] = VDO_IDH_REV30(
		/* USB host */ false, /* USB device */ false, IDH_PTYPE_HUB,
		/* modal operation */ true, /* DFP type */ 0,
		/* connector type */ 3, USB_VID_GOOGLE);
	partner->identity_vdm[VDO_INDEX_PTYPE_UFP1_VDO] = VDO_UFP1(
		/* Capability */ VDO_UFP1_CAPABILITY_USB4,
		/* connector type */ 0,
		/* alternate modes */ VDO_UFP1_ALT_MODE_RECONFIGURE,
		/* speed */ 1);
	connect_partner_to_port(fixture->tcpci_emul, fixture->charger_emul,
				&fixture->partner, &fixture->src_ext);
	host_cmd_typec_control_enter_mode(TEST_PORT, TYPEC_MODE_DP);
	k_sleep(K_SECONDS(1));
	disconnect_partner_from_port(fixture->tcpci_emul,
				     fixture->charger_emul);
	k_sleep(K_SECONDS(1));

	/* If the partner has Hub product type but does not send a UFP VDO at
	 * all, the TCPM should not send Data Reset during mode entry. This
	 * should be true even if a partner supporting Data Reset was previously
	 * connected. See b/304935541.
	 */
	partner->identity_vdm[VDO_INDEX_IDH] = VDO_IDH_REV30(
		/* USB host */ false, /* USB device */ false, IDH_PTYPE_HUB,
		/* modal operation */ true, /* DFP type */ 0,
		/* connector type */ 3, USB_VID_GOOGLE);
	partner->identity_vdos = VDO_INDEX_PRODUCT + 1;
	partner->identity_vdm[VDO_INDEX_PTYPE_UFP1_VDO] = VDO_UFP1(
		/* Capability */ VDO_UFP1_CAPABILITY_USB32,
		/* connector type */ 0, /* alternate modes */ 0, /* speed */ 1);
	connect_partner_to_port(fixture->tcpci_emul, fixture->charger_emul,
				&fixture->partner, &fixture->src_ext);

	tcpci_partner_common_clear_logged_msgs(&fixture->partner);
	tcpci_partner_common_enable_pd_logging(&fixture->partner, true);
	host_cmd_typec_control_enter_mode(TEST_PORT, TYPEC_MODE_DP);
	k_sleep(K_SECONDS(1));

	verify_data_reset_msg(&fixture->partner, false);
}

ZTEST_F(usbc_alt_mode_custom_discovery, test_hub_usb4_no_alt_mode)
{
	struct tcpci_partner_data *partner = &fixture->partner;

	if (!IS_ENABLED(CONFIG_PLATFORM_EC_USB_PD_REQUIRE_AP_MODE_ENTRY)) {
		ztest_test_skip();
	}

	/* If the partner has Hub product type and USB4 device capability in its
	 * Discover Identity response, the TCPM should send Data Reset during
	 * mode entry.
	 */
	partner->identity_vdm[VDO_INDEX_IDH] = VDO_IDH_REV30(
		/* USB host */ false, /* USB device */ false, IDH_PTYPE_HUB,
		/* modal operation */ true, /* DFP type */ 0,
		/* connector type */ 3, USB_VID_GOOGLE);
	partner->identity_vdm[VDO_INDEX_PTYPE_UFP1_VDO] = VDO_UFP1(
		/* Capability */ VDO_UFP1_CAPABILITY_USB4,
		/* connector type */ 0, /* alternate modes */ 0, /* speed */ 1);
	connect_partner_to_port(fixture->tcpci_emul, fixture->charger_emul,
				&fixture->partner, &fixture->src_ext);

	tcpci_partner_common_clear_logged_msgs(&fixture->partner);
	tcpci_partner_common_enable_pd_logging(&fixture->partner, true);
	host_cmd_typec_control_enter_mode(TEST_PORT, TYPEC_MODE_DP);
	k_sleep(K_SECONDS(1));

	verify_data_reset_msg(&fixture->partner, true);
}

ZTEST_F(usbc_alt_mode_custom_discovery, test_hub_alt_mode_no_usb4)
{
	struct tcpci_partner_data *partner = &fixture->partner;

	if (!IS_ENABLED(CONFIG_PLATFORM_EC_USB_PD_REQUIRE_AP_MODE_ENTRY)) {
		ztest_test_skip();
	}

	/* If the partner has Hub product type and Alternate Modes support in
	 * its Discover Identity response, the TCPM should send Data Reset
	 * during mode entry.
	 */
	partner->identity_vdm[VDO_INDEX_IDH] = VDO_IDH_REV30(
		/* USB host */ false, /* USB device */ false, IDH_PTYPE_HUB,
		/* modal operation */ true, /* DFP type */ 0,
		/* connector type */ 3, USB_VID_GOOGLE);
	partner->identity_vdm[VDO_INDEX_PTYPE_UFP1_VDO] = VDO_UFP1(
		/* Capability */ VDO_UFP1_CAPABILITY_USB32,
		/* connector type */ 0,
		/* alternate modes */ VDO_UFP1_ALT_MODE_RECONFIGURE,
		/* speed */ 1);
	connect_partner_to_port(fixture->tcpci_emul, fixture->charger_emul,
				&fixture->partner, &fixture->src_ext);

	tcpci_partner_common_clear_logged_msgs(&fixture->partner);
	tcpci_partner_common_enable_pd_logging(&fixture->partner, true);
	host_cmd_typec_control_enter_mode(TEST_PORT, TYPEC_MODE_DP);
	k_sleep(K_SECONDS(1));

	verify_data_reset_msg(&fixture->partner, true);
}

ZTEST_F(usbc_alt_mode_custom_discovery, test_peripheral_usb4_no_alt_mode)
{
	struct tcpci_partner_data *partner = &fixture->partner;

	if (!IS_ENABLED(CONFIG_PLATFORM_EC_USB_PD_REQUIRE_AP_MODE_ENTRY)) {
		ztest_test_skip();
	}

	/* If the partner has Peripheral product type and USB4 device capability
	 * in its Discover Identity response, the TCPM should send Data Reset
	 * during mode entry.
	 */
	partner->identity_vdm[VDO_INDEX_IDH] = VDO_IDH_REV30(
		/* USB host */ false, /* USB device */ false, IDH_PTYPE_PERIPH,
		/* modal operation */ true, /* DFP type */ 0,
		/* connector type */ 3, USB_VID_GOOGLE);
	partner->identity_vdm[VDO_INDEX_PTYPE_UFP1_VDO] = VDO_UFP1(
		/* Capability */ VDO_UFP1_CAPABILITY_USB4,
		/* connector type */ 0, /* alternate modes */ 0, /* speed */ 1);
	connect_partner_to_port(fixture->tcpci_emul, fixture->charger_emul,
				&fixture->partner, &fixture->src_ext);

	tcpci_partner_common_clear_logged_msgs(&fixture->partner);
	tcpci_partner_common_enable_pd_logging(&fixture->partner, true);
	host_cmd_typec_control_enter_mode(TEST_PORT, TYPEC_MODE_DP);
	k_sleep(K_SECONDS(1));

	verify_data_reset_msg(&fixture->partner, true);
}
```

## src/usbc_alt_mode_ec_mode_entry.c
```c
/* Copyright 2022 The ChromiumOS Authors
 * Use of this source code is governed by a BSD-style license that can be
 * found in the LICENSE file.
 */

#include "ec_commands.h"
#include "emul/tcpc/emul_tcpci_partner_common.h"
#include "mock/power.h"
#include "test/drivers/utils.h"
#include "test_usbc_alt_mode.h"

#include <zephyr/kernel.h>
#include <zephyr/ztest.h>
#include <zephyr/ztest_assert.h>
#include <zephyr/ztest_test.h>

/* Tests that require CONFIG_PLATFORM_EC_USB_PD_REQUIRE_AP_MODE_ENTRY disabled
 */

ZTEST_F(usbc_alt_mode, test_displayport_mode_power_cycle)
{
	struct ec_response_typec_status status;

	/* Verify that the TCPM enters DP mode on attach, exits on AP power-off,
	 * and enters again on AP power on.
	 */

	zassert_true(fixture->partner.displayport_configured, NULL);
	status = host_cmd_typec_status(TEST_PORT);
	zassert_equal((status.mux_state & USB_PD_MUX_DP_ENABLED),
		      USB_PD_MUX_DP_ENABLED);

	mock_power_request(POWER_REQ_SOFT_OFF);

	zassert_false(fixture->partner.displayport_configured, NULL);
	status = host_cmd_typec_status(TEST_PORT);
	zassert_equal((status.mux_state & USB_PD_MUX_DP_ENABLED), 0);

	mock_power_request(POWER_REQ_ON);

	zassert_true(fixture->partner.displayport_configured, NULL);
	status = host_cmd_typec_status(TEST_PORT);
	zassert_equal((status.mux_state & USB_PD_MUX_DP_ENABLED),
		      USB_PD_MUX_DP_ENABLED);
}
```
