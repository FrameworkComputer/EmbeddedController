/* Copyright 2023 The ChromiumOS Authors
 * Use of this source code is governed by a BSD-style license that can be
 * found in the LICENSE file.
 */

/ {
	chosen {
		cros-ec,watchdog-helper = &wdg_helper;
	};

	wdg_helper: wdg-helper {
		compatible = "zephyr,counter-watchdog";
		status = "okay";
		counter = <&counter0>;
	};
};

/* Native posix only supports a single wdt counter, disable wdt_counter */
&wdt_counter {
	status = "disabled";
};
