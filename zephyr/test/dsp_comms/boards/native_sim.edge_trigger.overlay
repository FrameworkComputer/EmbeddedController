/* Copyright 2024 The ChromiumOS Authors
 * Use of this source code is governed by a BSD-style license that can be
 * found in the LICENSE file.
 */

&gpio1 {
    /delete-property/ high-level;
    /delete-property/ low-level;
};
