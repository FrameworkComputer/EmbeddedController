## zephyr/test/nissa/testcase.yaml
```yaml
# Copyright 2024 The ChromiumOS Authors
# Use of this source code is governed by a BSD-style license that can be
# found in the LICENSE file.

common:
  platform_allow: native_sim
tests:
  nissa.board_power:
    extra_dtc_overlay_files:
      - "boards/generic_npcx.dts"
      - "boards/generic_power_signals.dts"
    extra_configs:
      - CONFIG_TEST_NISSA_BOARD_POWER=y
      - CONFIG_AP_X86_INTEL_ADL=y
      - CONFIG_TEST_DISABLE_AP_PWRSEQ=y
      - CONFIG_AP_POWER_EVENTS_MOCK=y
      - CONFIG_POWER_SIGNALS_MOCK=y
  nissa.board_power.ap_pwrseq_drv:
    extra_configs:
      - CONFIG_TEST_NISSA_BOARD_POWER=y
      - CONFIG_PLATFORM_EC_VBOOT_HASH=n
      - CONFIG_AP_X86_INTEL_ADL=y
      - CONFIG_AP_PWRSEQ=y
      - CONFIG_EMUL_AP_PWRSEQ_DRIVER=y
      - CONFIG_EMUL_POWER_SIGNALS=y
      - CONFIG_AP_PWRSEQ_DRIVER=y
      - CONFIG_PLATFORM_EC_HOSTCMD=y
      - CONFIG_PLATFORM_EC_BACKLIGHT_LID=n
    extra_dtc_overlay_files:
      - "boards/generic_npcx.dts"
      - "boards/ap_pwrseq_drv_power_signals.dts"
  nissa.sub_board:
    extra_dtc_overlay_files:
      - "boards/generic_npcx.dts"
    extra_configs:
      - CONFIG_TEST_NISSA_SUB_BOARD=y
      - CONFIG_NISSA_BOARD_HAS_HDMI_SUPPORT=y
  nissa.common:
    extra_dtc_overlay_files:
      - "boards/generic_npcx.dts"
      - "boards/chargers.dts"
    extra_conf_files:
      - "prj.conf"
      - "charger.conf"
    extra_configs:
      - CONFIG_TEST_NISSA_COMMON=y
  nissa.nivviks:
    extra_dtc_overlay_files:
      - "boards/generic_npcx.dts"
      - "boards/chargers.dts"
      - "boards/nivviks.dts"
    extra_conf_files:
      - "prj.conf"
      - "charger.conf"
    extra_configs:
      - CONFIG_TEST_NISSA_NIVVIKS=y
      - CONFIG_PLATFORM_EC_ACCELGYRO_LSM6DSO=y
      - CONFIG_PLATFORM_EC_ACCEL_LIS2DW12=y
  nissa.nivviks.charger:
    extra_dtc_overlay_files:
      - "boards/generic_npcx.dts"
      - "boards/battery.dts"
    extra_conf_files:
      - "prj.conf"
    extra_configs:
      - CONFIG_TEST_NISSA_NIVVIKS_CHARGER=y
      - CONFIG_PLATFORM_EC_TCPC_INTERRUPT=n
  nissa.nereid:
    extra_configs:
      - CONFIG_TEST_NISSA_NEREID=y
      - CONFIG_PLATFORM_EC_TCPC_INTERRUPT=n
    extra_dtc_overlay_files:
      - "boards/nereid.dts"
  nissa.nokris:
    extra_dtc_overlay_files:
      - "boards/nokris.dts"
    extra_conf_files:
      - "prj.conf"
    extra_configs:
      - CONFIG_TEST_NISSA_NOKRIS=y
      - CONFIG_PLATFORM_EC_TCPC_INTERRUPT=y
      - CONFIG_PLATFORM_EC_USB_PD_HOST_CMD=y
      - CONFIG_PLATFORM_EC_USB_PD_TCPM_PS8815=y
  nissa.pujjoga:
    extra_dtc_overlay_files:
      - "boards/pujjoga.dts"
    extra_conf_files:
      - "prj.conf"
    extra_configs:
      - CONFIG_TEST_NISSA_PUJJOGA=y
      - CONFIG_PLATFORM_EC_ACCELGYRO_LSM6DSM=y
      - CONFIG_PLATFORM_EC_ACCEL_LIS2DW12=y
      - CONFIG_PLATFORM_EC_LED_PWM=n
      - CONFIG_PLATFORM_EC_LED_COMMON=y
      - CONFIG_PLATFORM_EC_TABLET_MODE=y
      - CONFIG_PLATFORM_EC_GMR_TABLET_MODE=y
      - CONFIG_PLATFORM_EC_TCPC_INTERRUPT=y
      - CONFIG_PLATFORM_EC_USB_PD_HOST_CMD=y
      - CONFIG_NISSA_BOARD_HAS_HDMI_SUPPORT=y
  nissa.sundance:
    extra_dtc_overlay_files:
      - "boards/sundance.dts"
    extra_conf_files:
      - "prj.conf"
    extra_configs:
      - CONFIG_TEST_NISSA_SUNDANCE=y
      - CONFIG_PLATFORM_EC_TCPC_INTERRUPT=y
      - CONFIG_PLATFORM_EC_USB_PD_HOST_CMD=y
  nissa.gothrax:
    extra_dtc_overlay_files:
      - "boards/gothrax.dts"
    extra_conf_files:
      - "prj.conf"
    extra_configs:
      - CONFIG_TEST_NISSA_GOTHRAX=y
      - CONFIG_TEST_DISABLE_INLINE_CHIPSET_IN_STATE=y
      - CONFIG_PLATFORM_EC_TCPC_INTERRUPT=n
      - CONFIG_PLATFORM_EC_ACCEL_BMA4XX=y
      - CONFIG_PLATFORM_EC_ACCELGYRO_BMI_COMM_I2C=y
      - CONFIG_PLATFORM_EC_ACCELGYRO_BMI3XX=y
      - CONFIG_PLATFORM_EC_DYNAMIC_MOTION_SENSOR_COUNT=y
      - CONFIG_PLATFORM_EC_TABLET_MODE=y
      - CONFIG_PLATFORM_EC_GMR_TABLET_MODE=y
      - CONFIG_PLATFORM_EC_HOSTCMD=y
      - CONFIG_PLATFORM_EC_VBOOT_HASH=n
  nissa.pujjo:
    extra_dtc_overlay_files:
      - "boards/generic_npcx.dts"
      - "boards/chargers.dts"
      - "boards/pujjo.dts"
    extra_conf_files:
      - "prj.conf"
      - "charger.conf"
    extra_configs:
      - CONFIG_TEST_NISSA_PUJJO=y
      - CONFIG_PLATFORM_EC_ACCELGYRO_LSM6DSM=y
      - CONFIG_PLATFORM_EC_ACCEL_LIS2DW12=y
      - CONFIG_PLATFORM_EC_ACCELGYRO_BMI_COMM_I2C=y
      - CONFIG_PLATFORM_EC_ACCELGYRO_BMI3XX=y
      - CONFIG_PLATFORM_EC_ACCEL_BMA4XX=y
      - CONFIG_PLATFORM_EC_DYNAMIC_MOTION_SENSOR_COUNT=y
      - CONFIG_PLATFORM_EC_TABLET_MODE=y
      - CONFIG_PLATFORM_EC_GMR_TABLET_MODE=y
      - CONFIG_PLATFORM_EC_LED_PWM=n
      - CONFIG_PLATFORM_EC_LED_COMMON=y
  nissa.joxer:
    extra_configs:
      - CONFIG_TEST_NISSA_JOXER=y
      - CONFIG_PLATFORM_EC_TCPC_INTERRUPT=n
      - CONFIG_PLATFORM_EC_ACCELGYRO_BMI_COMM_I2C=y
      - CONFIG_PLATFORM_EC_ACCELGYRO_BMI3XX=y
      - CONFIG_PLATFORM_EC_ACCEL_BMA4XX=y
      - CONFIG_PLATFORM_EC_HOSTCMD=y
      - CONFIG_FLASH=y
      - CONFIG_FLASH_PAGE_LAYOUT=y
      - CONFIG_PLATFORM_EC_FLASH_SIZE_BYTES=0x80000
      - CONFIG_PLATFORM_EC_VBOOT_HASH=n
      - CONFIG_PLATFORM_EC_LID_SWITCH=y
      - CONFIG_PLATFORM_EC_FAN_DYNAMIC_CONFIG=y
    extra_dtc_overlay_files:
      - "boards/joxer.dts"
  nissa.craask:
    extra_dtc_overlay_files:
      - "boards/craask.dts"
      - "boards/chargers.dts"
    extra_conf_files:
      - "prj.conf"
      - "charger.conf"
    extra_configs:
      - CONFIG_TEST_NISSA_CRAASK=y
      - CONFIG_PLATFORM_EC_VOLUME_BUTTONS=y
      - CONFIG_PLATFORM_EC_BUTTONS_RUNTIME_CONFIG=y
      - CONFIG_PLATFORM_EC_KEYBOARD_KEYPAD=y
      - CONFIG_PLATFORM_EC_LID_SWITCH=y
      - CONFIG_PLATFORM_EC_ACCEL_LIS2DW12=y
      - CONFIG_PLATFORM_EC_ACCELGYRO_LSM6DSO=y
      - CONFIG_PLATFORM_EC_ACCEL_BMA4XX=y
      - CONFIG_PLATFORM_EC_ACCELGYRO_BMI_COMM_I2C=y
      - CONFIG_PLATFORM_EC_ACCELGYRO_BMI3XX=y
      - CONFIG_PLATFORM_EC_DYNAMIC_MOTION_SENSOR_COUNT=y
      - CONFIG_PLATFORM_EC_TABLET_MODE=y
      - CONFIG_PLATFORM_EC_GMR_TABLET_MODE=y
      - CONFIG_PLATFORM_EC_CHARGER_RAA489000=n
      - CONFIG_PLATFORM_EC_TCPC_INTERRUPT=n
      - CONFIG_ADC=y
  nissa.pirrha:
    extra_dtc_overlay_files:
      - "boards/pirrha.dts"
    extra_conf_files:
      - "prj.conf"
    extra_configs:
      - CONFIG_TEST_NISSA_PIRRHA=y
      - CONFIG_PLATFORM_EC_ACCELGYRO_LSM6DSM=y
      - CONFIG_PLATFORM_EC_ACCEL_LIS2DS=y
      - CONFIG_PLATFORM_EC_TCPC_INTERRUPT=n
      - CONFIG_PLATFORM_EC_LED_PWM=n
      - CONFIG_PLATFORM_EC_LED_COMMON=y
  nissa.anraggar:
    extra_dtc_overlay_files:
      - "boards/anraggar.dts"
    extra_configs:
      - CONFIG_TEST_NISSA_ANRAGGAR=y
      - CONFIG_PLATFORM_EC_TCPC_INTERRUPT=n
      - CONFIG_PLATFORM_EC_KEYBOARD_CUSTOMIZATION=y
      - CONFIG_PLATFORM_EC_ACCEL_LIS2DW12=y
      - CONFIG_PLATFORM_EC_ACCELGYRO_LSM6DSM=y
      - CONFIG_PLATFORM_EC_ACCEL_BMA4XX=y
      - CONFIG_PLATFORM_EC_ACCELGYRO_BMI_COMM_I2C=y
      - CONFIG_PLATFORM_EC_ACCELGYRO_BMI3XX=y
      - CONFIG_PLATFORM_EC_DYNAMIC_MOTION_SENSOR_COUNT=y
      - CONFIG_PLATFORM_EC_TABLET_MODE=y
      - CONFIG_PLATFORM_EC_GMR_TABLET_MODE=y
      - CONFIG_PLATFORM_EC_BATTERY_HW_PRESENT_CUSTOM=y
  nissa.craaskov:
    extra_dtc_overlay_files:
      - "boards/craaskov.dts"
      - "boards/chargers.dts"
    extra_conf_files:
      - "prj.conf"
      - "charger.conf"
    extra_configs:
      - CONFIG_TEST_NISSA_CRAASKOV=y
      - CONFIG_PLATFORM_EC_CHARGER_RAA489000=n
      - CONFIG_PLATFORM_EC_TCPC_INTERRUPT=n
      - CONFIG_PLATFORM_EC_KEYBOARD_CUSTOMIZATION=y
  nissa.uldren:
    extra_dtc_overlay_files:
      - "boards/uldren.dts"
      - "boards/chargers.dts"
    extra_conf_files:
      - "prj.conf"
      - "charger.conf"
    extra_configs:
      - CONFIG_TEST_NISSA_ULDREN=y
      - CONFIG_PLATFORM_EC_VOLUME_BUTTONS=y
      - CONFIG_PLATFORM_EC_BUTTONS_RUNTIME_CONFIG=y
      - CONFIG_PLATFORM_EC_CHARGER_RAA489000=n
      - CONFIG_PLATFORM_EC_TCPC_INTERRUPT=n
      - CONFIG_PLATFORM_EC_ACCEL_LIS2DW12=y
      - CONFIG_PLATFORM_EC_ACCELGYRO_LSM6DSO=y
      - CONFIG_PLATFORM_EC_ACCEL_BMA4XX=y
      - CONFIG_PLATFORM_EC_ACCELGYRO_BMI_COMM_I2C=y
      - CONFIG_PLATFORM_EC_ACCELGYRO_BMI3XX=y
      - CONFIG_PLATFORM_EC_DYNAMIC_MOTION_SENSOR_COUNT=y
      - CONFIG_PLATFORM_EC_TABLET_MODE=y
      - CONFIG_PLATFORM_EC_GMR_TABLET_MODE=y
      - CONFIG_PLATFORM_EC_LID_SWITCH=y
      - CONFIG_PLATFORM_EC_I2C=n
  nissa.yaviks:
    extra_dtc_overlay_files:
      - "boards/yaviks.dts"
    extra_configs:
      - CONFIG_TEST_NISSA_YAVIKS=y
      - CONFIG_TEST_DISABLE_INLINE_CHIPSET_IN_STATE=y
      - CONFIG_PLATFORM_EC_TCPC_INTERRUPT=n
      - CONFIG_PLATFORM_EC_HOSTCMD=y
      - CONFIG_PLATFORM_EC_VBOOT_HASH=n
      - CONFIG_PLATFORM_EC_LID_SWITCH=y
      - CONFIG_PLATFORM_EC_CHARGER=n
      - CONFIG_PLATFORM_EC_LED_COMMON=y
  nissa.quandiso:
    extra_dtc_overlay_files:
      - "boards/quandiso.dts"
    extra_configs:
      - CONFIG_TEST_NISSA_QUANDISO=y
      - CONFIG_TEST_DISABLE_INLINE_CHIPSET_IN_STATE=y
      - CONFIG_PLATFORM_EC_TCPC_INTERRUPT=n
      - CONFIG_PLATFORM_EC_ACCELGYRO_BMI_COMM_I2C=y
      - CONFIG_PLATFORM_EC_ACCELGYRO_BMI3XX=y
      - CONFIG_PLATFORM_EC_ACCEL_KX022=y
      - CONFIG_PLATFORM_EC_DYNAMIC_MOTION_SENSOR_COUNT=y
      - CONFIG_PLATFORM_EC_TABLET_MODE=y
      - CONFIG_PLATFORM_EC_GMR_TABLET_MODE=y
      - CONFIG_PLATFORM_EC_HOSTCMD=y
      - CONFIG_PLATFORM_EC_VBOOT_HASH=n
      - CONFIG_PLATFORM_EC_LID_SWITCH=y
      - CONFIG_PLATFORM_EC_LED_COMMON=y
  nissa.yavilla:
    extra_dtc_overlay_files:
      - "boards/yavilla.dts"
    extra_configs:
      - CONFIG_TEST_NISSA_YAVILLA=y
      - CONFIG_TEST_DISABLE_INLINE_CHIPSET_IN_STATE=y
      - CONFIG_PLATFORM_EC_TCPC_INTERRUPT=n
      - CONFIG_PLATFORM_EC_ACCELGYRO_BMI_COMM_I2C=y
      - CONFIG_PLATFORM_EC_ACCELGYRO_BMI3XX=y
      - CONFIG_PLATFORM_EC_ACCEL_BMA4XX=y
      - CONFIG_PLATFORM_EC_DYNAMIC_MOTION_SENSOR_COUNT=y
      - CONFIG_PLATFORM_EC_TABLET_MODE=y
      - CONFIG_PLATFORM_EC_GMR_TABLET_MODE=y
      - CONFIG_PLATFORM_EC_HOSTCMD=y
      - CONFIG_PLATFORM_EC_VBOOT_HASH=n
      - CONFIG_PLATFORM_EC_LID_SWITCH=y
  nissa.glassway:
    extra_dtc_overlay_files:
      - "boards/generic_npcx.dts"
      - "boards/battery.dts"
      - "boards/glassway.dts"
    extra_conf_files:
      - "prj.conf"
    extra_configs:
      - CONFIG_TEST_NISSA_GLASSWAY=y
      - CONFIG_PLATFORM_EC_ACCELGYRO_LSM6DSO=n
      - CONFIG_PLATFORM_EC_ACCEL_LIS2DW12=n
      - CONFIG_PLATFORM_EC_CHARGER=n
      - CONFIG_PLATFORM_EC_TCPC_INTERRUPT=n
  nissa.riven:
    extra_dtc_overlay_files:
      - "boards/riven.dts"
      - "boards/chargers.dts"
    extra_conf_files:
      - "prj.conf"
      - "charger.conf"
    extra_configs:
      - CONFIG_TEST_NISSA_RIVEN=y
      - CONFIG_PLATFORM_EC_KEYBOARD_KEYPAD=y
      - CONFIG_PLATFORM_EC_LID_SWITCH=y
      - CONFIG_PLATFORM_EC_ACCEL_BMA4XX=y
      - CONFIG_PLATFORM_EC_DYNAMIC_MOTION_SENSOR_COUNT=y
      - CONFIG_PLATFORM_EC_KEYBOARD_CUSTOMIZATION=y
      - CONFIG_PLATFORM_EC_KEYBOARD_DEBUG=y
      - CONFIG_PLATFORM_EC_TABLET_MODE=y
      - CONFIG_PLATFORM_EC_GMR_TABLET_MODE=y
      - CONFIG_PLATFORM_EC_CHARGER_RAA489000=n
      - CONFIG_PLATFORM_EC_TCPC_INTERRUPT=n
      - CONFIG_ADC=y
  nissa.domika:
    extra_dtc_overlay_files:
      - "boards/domika.dts"
    extra_configs:
      - CONFIG_TEST_NISSA_DOMIKA=y
      - CONFIG_TEST_DISABLE_INLINE_CHIPSET_IN_STATE=y
      - CONFIG_PLATFORM_EC_TCPC_INTERRUPT=n
      - CONFIG_PLATFORM_EC_ACCELGYRO_BMI_COMM_I2C=y
      - CONFIG_PLATFORM_EC_ACCELGYRO_BMI3XX=y
      - CONFIG_PLATFORM_EC_ACCEL_BMA4XX=y
      - CONFIG_PLATFORM_EC_DYNAMIC_MOTION_SENSOR_COUNT=y
      - CONFIG_PLATFORM_EC_TABLET_MODE=y
      - CONFIG_PLATFORM_EC_GMR_TABLET_MODE=y
      - CONFIG_PLATFORM_EC_HOSTCMD=y
      - CONFIG_PLATFORM_EC_VBOOT_HASH=n
      - CONFIG_PLATFORM_EC_LID_SWITCH=y
  nissa.teliks:
    extra_dtc_overlay_files:
      - "boards/teliks.dts"
    extra_configs:
      - CONFIG_TEST_NISSA_TELIKS=y
      - CONFIG_PLATFORM_EC_TCPC_INTERRUPT=n
      - CONFIG_PLATFORM_EC_KEYBOARD_CUSTOMIZATION=y
      - CONFIG_PLATFORM_EC_ACCEL_LIS2DW12=y
      - CONFIG_PLATFORM_EC_ACCELGYRO_LSM6DSM=y
      - CONFIG_PLATFORM_EC_ACCEL_BMA4XX=y
      - CONFIG_PLATFORM_EC_ACCELGYRO_BMI_COMM_I2C=y
      - CONFIG_PLATFORM_EC_ACCELGYRO_BMI3XX=y
      - CONFIG_PLATFORM_EC_ACCELGYRO_ICM42607=y
      - CONFIG_PLATFORM_EC_ACCELGYRO_ICM_COMM_I2C=y
      - CONFIG_PLATFORM_EC_DYNAMIC_MOTION_SENSOR_COUNT=y
      - CONFIG_PLATFORM_EC_TABLET_MODE=y
      - CONFIG_PLATFORM_EC_GMR_TABLET_MODE=y
      - CONFIG_PLATFORM_EC_BATTERY_HW_PRESENT_CUSTOM=y
      - CONFIG_PLATFORM_EC_KEYBOARD_CUSTOMIZATION=y
      - CONFIG_PLATFORM_EC_KEYBOARD_DEBUG=y
```
