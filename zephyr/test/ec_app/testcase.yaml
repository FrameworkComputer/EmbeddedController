## zephyr/test/fingerprint/algorithm/api/testcase.yaml
```yaml
# Copyright 2023 The ChromiumOS Authors
# Use of this source code is governed by a BSD-style license that can be
# found in the LICENSE file.

common:
  platform_allow: native_posix
tests:
  fingerprint.algorithm.api: {}
```

## zephyr/test/fpmcu/Kconfig
```kconfig
# Copyright 2023 The ChromiumOS Authors
# Use of this source code is governed by a BSD-style license that can be
# found in the LICENSE file.

config BOARD_FINGERPRINT
	bool
	default y

choice TEST_BOARD_VARIANT
	prompt "Select board variant for tests"
	help
	  Board variant to use for tests

	config TEST_BOARD_BLOONCHIPPER
		bool "Enable baseboard-specific tests"
		help
		Enable bloonchippers tests.

endchoice # TEST_BOARD_VARIANT

config TEST_BOARD_NAME
	string "Board name"
	default "bloonchipper" if TEST_BOARD_BLOONCHIPPER

config TEST_BOARD_TRANSPORT_SPI
	bool "Enable SPI transport layer tests"

config TEST_BOARD_TRANSPORT_UART
	bool "Enable UART transport layer tests"

config EC_HOST_CMD_INIT_PRIORITY
	int "Initialization priority"
	default 80
	range 0 99

config EC_HOST_CMD_HANDLER_RX_BUFFER_SIZE
	int "HC RX buffer size"
	default 549

config EC_HOST_CMD_HANDLER_TX_BUFFER_SIZE
	int "HC TX buffer size"
	default 544

config EC_HOST_CMD_BACKEND_SPI
	bool "HC SPI backend"
	default y

config EC_HOST_CMD_BACKEND_UART
	bool "HC UART backend"
	default y

config TEST_BOARD_POWER
	bool "Board power tests"

config TEST_PROVIDE_PM_HOOKS
	bool "Provide PM hooks for test purposes"
	default y
	select HAS_PM

config TEST_BOARD_EC_QUIRKS
	bool "Board EC quirks tests"

config TEST_BOARD_RESTRICTED_CONSOLE
	bool "Board restricted console tests"

source "Kconfig.zephyr"
```

## zephyr/test/fpmcu/testcase.yaml
```yaml
# Copyright 2023 The ChromiumOS Authors
# Use of this source code is governed by a BSD-style license that can be
# found in the LICENSE file.

common:
  platform_allow: native_sim
tests:
  fpmcu.bloonchipper.transport_spi:
    extra_configs:
    - CONFIG_TEST_BOARD_BLOONCHIPPER=y
    - CONFIG_TEST_BOARD_TRANSPORT_SPI=y
    extra_dtc_overlay_files:
    - ./boards/bloonchipper/bloonchipper.dtsi
  fpmcu.bloonchipper.transport_uart:
    extra_configs:
    - CONFIG_TEST_BOARD_BLOONCHIPPER=y
    - CONFIG_TEST_BOARD_TRANSPORT_UART=y
    extra_dtc_overlay_files:
    - ./boards/bloonchipper/bloonchipper.dtsi
  fpmcu.bloonchipper.power:
    extra_configs:
    - CONFIG_TEST_BOARD_BLOONCHIPPER=y
    - CONFIG_TEST_BOARD_POWER=y
    - CONFIG_PM=y
    extra_dtc_overlay_files:
    - ./boards/bloonchipper/bloonchipper.dtsi
  fpmcu.bloonchipper.ec_quirks:
    extra_configs:
    - CONFIG_TEST_BOARD_BLOONCHIPPER=y
    - CONFIG_TEST_BOARD_EC_QUIRKS=y
    extra_dtc_overlay_files:
    - ./boards/bloonchipper/bloonchipper.dtsi
  fpmcu.bloonchipper.restricted_console:
    extra_configs:
    - CONFIG_TEST_BOARD_BLOONCHIPPER=y
    - CONFIG_TEST_BOARD_RESTRICTED_CONSOLE=y
    extra_dtc_overlay_files:
    - ./boards/bloonchipper/bloonchipper.dtsi
```

## zephyr/test/geralt/testcase.yaml
```yaml
common:
  platform_allow: native_sim
tests:
  geralt.default:
    extra_configs:
    - CONFIG_TEST_GERALT=y
    - CONFIG_SHIMMED_TASKS=y
    extra_dtc_overlay_files:
    - geralt.default.overlay
  geralt.ciri:
    extra_configs:
    - CONFIG_TEST_CIRI=y
    extra_dtc_overlay_files:
    - geralt.ciri.overlay
```

## zephyr/test/herobrine/testcase.yaml
```yaml
# Copyright 2022 The ChromiumOS Authors.
# Use of this source code is governed by a BSD-style license that can be
# found in the LICENSE file.

common:
  platform_allow: native_posix
tests:
  herobrine.board_chipset:
    extra_configs:
      - CONFIG_TEST_BOARD_CHIPSET=y
```

## zephyr/test/hostcmd_console/testcase.yaml
```yaml
common:
  platform_allow: native_sim
tests:
  hostcmd_console.log_immediate:
    extra_configs:
    - CONFIG_LOG_MODE_IMMEDIATE=y
    - CONFIG_LOG_MODE_MINIMAL=n
    - CONFIG_PLATFORM_EC_LOG_BACKEND_CONSOLE_BUFFER=y
  hostcmd_console.log_minimal:
    extra_configs:
    - CONFIG_LOG_MODE_IMMEDIATE=n
    - CONFIG_LOG_MODE_MINIMAL=y
    - CONFIG_POSIX_ARCH_CONSOLE_INIT_PRIORITY=60
```

## zephyr/test/hwtest/Kconfig
```kconfig
# Copyright 2024 The ChromiumOS Authors
# Use of this source code is governed by a BSD-style license that can be
# found in the LICENSE file.

config HW_TEST_ABORT
	bool "Abort test"
	select ZTEST
	depends on PLATFORM_EC_PANIC
	help
	  The test verify if abort() call works correctly and validates panic
	  data.

config HW_TEST_AES
	bool "AES test"
	select ZTEST
	help
	  The test verifies AES functions.

config HW_TEST_BENCHMARK
	bool "Benchmark test"
	select ZTEST
	help
	  The test verifies benchmark feature.

config HW_TEST_BORINGSSL_CRYPTO
	bool "Benchmark test"
	select ZTEST
	help
	  The test verifies the boringssl library.

config HW_TEST_CORTEXM_FPU
	bool "Cortex-M FPU test"
	select ZTEST
	depends on BOARD_FINGERPRINT

config HW_TEST_CRC
	bool "CRC test"
	select ZTEST

config HW_TEST_EXCEPTION
	bool "Exception test"
	select ZTEST

config HW_TEST_FLASH_PHYSICAL
	bool "Flash physical test"
	select ZTEST
	depends on FLASH

config HW_TEST_FLASH_WRITE_PROTECT
	bool "Flash write protect test"
	select ZTEST
	depends on PLATFORM_EC_FLASH_CROS

config HW_TEST_FP_TRANSPORT
	bool "FP transport layer test"
	select ZTEST
	depends on EC_HOST_CMD

config HW_TEST_FPSENSOR_AUTH_CRYPTO_STATEFUL
	bool "FP sensor auth crypto stateful test"
	select ZTEST
	select MOCK_ROLLBACK

config HW_TEST_FPSENSOR_AUTH_CRYPTO_STATELESS
	bool "FP sensor auth crypto stateless test"
	select ZTEST

config HW_TEST_FPSENSOR_CRYPTO
	bool "FP sensor crypto test"
	select ZTEST

config HW_TEST_FPSENSOR_HW
	bool "FP sensor hw test"
	select ZTEST

config HW_TEST_FPSENSOR_UTILS
	bool "FP sensor utils test"
	select ZTEST

config HW_TEST_FTRAPV
	bool "ftrapv test"
	select ZTEST
	depends on BOARD_FINGERPRINT
	help
	  The test verify if int overflow causes a crash.

config HW_TEST_LIBC_PRINTF
	bool "libc printf test"
	select ZTEST
	help
	  Prints a hardcoded string to check by a test runner.

config HW_TEST_LIBCXX
	bool "libcxx test"
	select ZTEST
	help
	  The test verifies time measurement system_clock vs udelay.

config HW_TEST_MALLOC
	bool "malloc test"
	select ZTEST
	help
	  The test verifies basic malloc operations.

config HW_TEST_PANIC
	bool "Panic test"
	select ZTEST
	depends on ARM
	help
	  The test verifies panic data.

config HW_TEST_PRINTF
	bool "printf test"
	select ZTEST
	help
	  The test verifies printf related functions.

config HW_TEST_QUEUE
	bool "Queue test"
	select ZTEST
	help
	  The test verifies queue functionality in EC.

config HW_TEST_RESTRICTED_CONSOLE
	bool "Restricted console test"
	select ZTEST
	depends on BOARD_FINGERPRINT
	help
	  The test verifies restricted console.

config HW_TEST_RNG_BENCHMARK
	bool "RNG benchmark test"
	select ZTEST
	depends on BOARD_FINGERPRINT
	help
	  The test measures performance of the hardware (TRNG) compared to the
	  std::rand()

config HW_TEST_ROLLBACK
	bool "Rollback test"
	select ZTEST
	depends on BOARD_FINGERPRINT
	help
	  The test verifies rollback regions functionality.

config HW_TEST_ROLLBACK_ENTROPY
	bool "Rollback entropy test"
	select ZTEST
	depends on PLATFORM_EC_ROLLBACK
	help
	  The test verifies rollback entropy functionality.

config HW_TEST_SHA256
	bool "SHA256 test"
	select ZTEST
	help
	  The test verifies SHA256 functions.

config HW_TEST_SHA256_UNROLLED
	bool "SHA256 unrolled test"
	select ZTEST
	select PLATFORM_EC_SHA256_UNROLLED
	help
	  The test verifies SHA256 functions with forced unrolled config.

config HW_TEST_STATIC_IF
	bool "STATIC_IF test"
	select ZTEST
	help
	  The test verifies SHA256 functions with forced unrolled config.

config HW_TEST_STD_VECTOR
	bool "std_vector test"
	select ZTEST
	help
	  The test verifies std::vector and dynamic memory allocation.

config HW_TEST_STDLIB
	bool "stdlib test"
	select ZTEST
	help
	  The test builtin stdlib functions used by Zephyr.

config HW_TEST_TIMER
	bool "timer test"
	select ZTEST
	help
	  The test verifies some functions defined in timer.h.

config HW_TEST_TPM_SEED_CLEAR
	bool "TPM seed clear test"
	select ZTEST
	help
	  The test verifies if the tpm seed is cleared after reboot.

config HW_TEST_SYSTEM_IS_LOCKED
	bool "system_is_locked test"
	select ZTEST
	help
	  The test verifies system_is_locked function with wp on/off.

config HW_TEST_UNALIGNED_ACCESS
	bool "Unaligned access test"
	select ZTEST
	help
	  The test verifies unaligned access works properly.

config HW_TEST_UNALIGNED_ACCESS_BENCHMARK
	bool "Unaligned access benchmark test"
	select ZTEST
	help
	  The benchmark test of unaligned access.

config HW_TEST_UTILS
	bool "Utils test"
	select ZTEST
	help
	  The test verifies util functions.

config HW_TEST_UTILS_STR
	bool "Utils string test"
	select ZTEST
	help
	  The test verifies util string functions.

config MOCK_ROLLBACK
	bool "Mock rollback for tests"
```

## zephyr/test/intelrvp/Kconfig
```kconfig
# Copyright 2024 The ChromiumOS Authors
# Use of this source code is governed by a BSD-style license that can be
# found in the LICENSE file.

choice TEST_PROJECT_TYPE
	prompt "Select Intel RVP board variant for tests"
	help
	  Choose the board variant for which the tests will be compiled and run.

config TEST_PROJECT_MTLRVPP_COMMON
	bool "Enable tests for board mtlrvp common source code"
	help
	  Enable tests specific to the mtlrvp common source code.

config TEST_PROJECT_MTLRVPP_NPCX
	bool "Enable tests for board mtlrvp_npcx"
	help
	  Enable tests specific to the mtlrvp_npcx variant.

config TEST_PROJECT_MTLRVPP_MCHP
	bool "Enable tests for board mtlrvp_mchp"
	help
	  Enable tests specific to the mtlrvp_mchp variant.

endchoice

config TEST_PROJECT_MTL_BOARD_POWER
	bool "Run tests for board_power.c"
	help
	  Include board_power.c into the binary and test its functions.

config TEST_AP_PWRSEQ_PP5500
        bool "Enable PP5500 rail tests"
        default n
        help
          Enable PP5500 rail tests for board power.

config TEST_PROJECT_INTELRVP_TCPC
	bool "Run tests for tcpc.c"
	help
	  Include tcpc.c into the binary and test its functions.

config TEST_PROJECT_INTELRVP_CHG_USB_PD_MECC
	bool "Run tests for chg_usb_pd_mecc_1_1.c"
	help
	  Include chg_usb_pd_mecc_1_1.c into the binary and test its functions.

config TEST_PROJECT_INTELRVP_DC_JACK
	bool "Run tests for dc_jack.c"
	help
	  Include dc_jack.c into the binary and test its functions.

config TEST_PROJECT_INTELRVP_BOARD_ID
	bool "Run INTELRVP board id test"
	help
	  Run board ID test for INTELRVP.

config TEST_PROJECT_INTELRVP_BOARD_ID_VAL
	int "Value to be used for board ID test"
	depends on TEST_PROJECT_INTELRVP_BOARD_ID
	default 1051 if TEST_PROJECT_MTLRVPP_COMMON
	default 1078 if TEST_PROJECT_PTLRVPP_MCHP
	help
	  Value to be used for board ID test.

source "Kconfig.zephyr"
```

## zephyr/test/intelrvp/testcase.yaml
```yaml
# Copyright 2024 The ChromiumOS Authors
# Use of this source code is governed by a BSD-style license that can be
# found in the LICENSE file.

common:
  platform_allow: native_sim
tests:
  intelrvp.mtlrvp_npcx.board_power:
    extra_dtc_overlay_files:
      - boards/intelrvp.dtsi
      - boards/mtlrvp_npcx/mtlrvp_npcx.dtsi
    extra_conf_files:
      - boards/mtlrvp/mtlrvp.conf
    extra_configs:
      - CONFIG_TEST_PROJECT_MTLRVPP_NPCX=y
      - CONFIG_TEST_PROJECT_MTL_BOARD_POWER=y
      - CONFIG_AP_POWER_EVENTS_MOCK=y
      - CONFIG_POWER_SIGNALS_MOCK=y
      - CONFIG_AP_EVENTS=n

  intelrvp.mtlrvp_mchp.board_power:
    extra_dtc_overlay_files:
      - boards/intelrvp.dtsi
      - boards/mtlrvp_mchp/mtlrvp_mchp.dtsi
    extra_conf_files:
      - boards/mtlrvp/mtlrvp.conf
    extra_configs:
      - CONFIG_TEST_PROJECT_MTLRVPP_MCHP=y
      - CONFIG_TEST_PROJECT_MTL_BOARD_POWER=y
      - CONFIG_AP_POWER_EVENTS_MOCK=y
      - CONFIG_POWER_SIGNALS_MOCK=y
      - CONFIG_AP_EVENTS=n

  intelrvp.mtlrvp_npcx.tcpc:
    extra_dtc_overlay_files:
      - boards/intelrvp.dtsi
      - boards/mtlrvp_npcx/mtlrvp_npcx.dtsi
    extra_conf_files:
      - boards/mtlrvp/mtlrvp.conf
    extra_configs:
      - CONFIG_TEST_PROJECT_MTLRVPP_NPCX=y
      - CONFIG_TEST_PROJECT_INTELRVP_TCPC=y

  intelrvp.mtlrvp_mchp.tcpc:
    extra_dtc_overlay_files:
      - boards/intelrvp.dtsi
      - boards/mtlrvp_mchp/mtlrvp_mchp.dtsi
    extra_conf_files:
      - boards/mtlrvp/mtlrvp.conf
    extra_configs:
      - CONFIG_TEST_PROJECT_MTLRVPP_MCHP=y
      - CONFIG_TEST_PROJECT_INTELRVP_TCPC=y

  intelrvp.mtlrvp_mchp.chg_usb_pd_mecc_1_1:
    extra_dtc_overlay_files:
      - boards/intelrvp.dtsi
      - boards/mtlrvp_mchp/mtlrvp_mchp.dtsi
    extra_conf_files:
      - boards/mtlrvp/mtlrvp.conf
    extra_configs:
      - CONFIG_TEST_PROJECT_MTLRVPP_MCHP=y
      - CONFIG_TEST_PROJECT_INTELRVP_CHG_USB_PD_MECC=y

  intelrvp.mtlrvp_npcx.chg_usb_pd_mecc_1_1:
    extra_dtc_overlay_files:
      - boards/intelrvp.dtsi
      - boards/mtlrvp_npcx/mtlrvp_npcx.dtsi
    extra_conf_files:
      - boards/mtlrvp/mtlrvp.conf
    extra_configs:
      - CONFIG_TEST_PROJECT_MTLRVPP_NPCX=y
      - CONFIG_TEST_PROJECT_INTELRVP_CHG_USB_PD_MECC=y

  intelrvp.mtlrvp_mchp.dc_jack:
    extra_dtc_overlay_files:
      - boards/intelrvp.dtsi
      - boards/mtlrvp_mchp/mtlrvp_mchp.dtsi
    extra_conf_files:
      - boards/mtlrvp/mtlrvp.conf
    extra_configs:
      - CONFIG_TEST_PROJECT_MTLRVPP_MCHP=y
      - CONFIG_TEST_PROJECT_INTELRVP_DC_JACK=y

  intelrvp.mtlrvp_npcx.dc_jack:
    extra_dtc_overlay_files:
      - boards/intelrvp.dtsi
      - boards/mtlrvp_npcx/mtlrvp_npcx.dtsi
    extra_conf_files:
      - boards/mtlrvp/mtlrvp.conf
    extra_configs:
      - CONFIG_TEST_PROJECT_MTLRVPP_NPCX=y
      - CONFIG_TEST_PROJECT_INTELRVP_DC_JACK=y

  intelrvp.mtlrvp.board_id:
    extra_dtc_overlay_files:
      - boards/intelrvp.dtsi
      - boards/mtlrvp_npcx/mtlrvp_npcx.dtsi
    extra_conf_files:
      - boards/mtlrvp/mtlrvp.conf
    extra_configs:
      - CONFIG_TEST_PROJECT_MTLRVPP_COMMON=y
      - CONFIG_TEST_PROJECT_INTELRVP_BOARD_ID=y

  intelrvp.ptlrvp_mchp.board_power:
    extra_dtc_overlay_files:
      - boards/intelrvp.dtsi
      - boards/ptlrvp/ptlrvp_mchp/ptlrvp_mchp.dtsi
    extra_conf_files:
      - boards/ptlrvp/program.conf
      - boards/ptlrvp/pd.conf
      - boards/ptlrvp/ptlrvp.conf
    extra_configs:
      - CONFIG_TEST_PROJECT_PTLRVP_MCHP=y
      - CONFIG_TEST_PROJECT_MTL_BOARD_POWER=y
      - CONFIG_X86_NON_DSX_PWRSEQ_MTL=n
      - CONFIG_AP_PWRSEQ=y
      - CONFIG_AP_PWRSEQ_DRIVER=y
      - CONFIG_EMUL_AP_PWRSEQ_DRIVER=n
      - CONFIG_AP_POWER_EVENTS_MOCK=y
      - CONFIG_POWER_SIGNALS_MOCK=y
      - CONFIG_CHIPSET_API_MOCK=y
      - CONFIG_AP_EVENTS=n
      - CONFIG_TEST_AP_PWRSEQ_PP5500=y

  intelrvp.ptlrvp.board_id:
    extra_dtc_overlay_files:
      - boards/intelrvp.dtsi
      - boards/ptlrvp/ptlrvp_mchp/ptlrvp_mchp.dtsi
    extra_conf_files:
      - boards/ptlrvp/program.conf
      - boards/ptlrvp/pd.conf
      - boards/ptlrvp/ptlrvp.conf
    extra_configs:
      - CONFIG_TEST_PROJECT_PTLRVP_MCHP=y
      - CONFIG_TEST_PROJECT_INTELRVP_BOARD_ID=y
```

## zephyr/test/ish/testcase.yaml
```yaml
# Copyright 2024 The ChromiumOS Authors
# Use of this source code is governed by a BSD-style license that can be
# found in the LICENSE file.

common:
  platform_allow: native_sim
tests:
  # ISH notebook/tablet mode test
  ish.nb_mode:
    extra_dtc_overlay_files:
      - boards/native_sim.overlay
    extra_configs:
      - CONFIG_PLATFORM_EC_TABLET_MODE=y
      - CONFIG_PLATFORM_EC_EXTERNAL_NOTEBOOK_MODE=y
```

## zephyr/test/jump_tags/testcase.yaml
```yaml
# Copyright 2022 The ChromiumOS Authors
# Use of this source code is governed by a BSD-style license that can be
# found in the LICENSE file.

common:
  platform_allow: native_sim
tests:
  jump_tags.default:
    extra_configs:
      - CONFIG_PLATFORM_EC_PRESERVED_END_OF_RAM_SIZE=1024
    tags:
      common
      system
```
