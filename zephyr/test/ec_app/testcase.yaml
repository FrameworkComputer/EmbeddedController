## zephyr/test/kingler/testcase.yaml
```yaml
common:
  platform_allow: native_posix
tests:
  corsola.usbc:
    extra_configs:
    - CONFIG_TEST_CORSOLA_USBC=y
    - CONFIG_VARIANT_CORSOLA_DB_DETECTION=y
    extra_dtc_overlay_files:
    - kingler.usbc.overlay
    extra_conf_files:
    - prj.conf
    - kingler.usbc.conf
  corsola.usb_pd_policy:
    extra_configs:
    - CONFIG_TEST_CORSOLA_USB_PD_POLICY=y
    - CONFIG_TEST_BUILD_FAKE=n
    - CONFIG_AP_ARM_MTK_MT8186=y
    - CONFIG_PLATFORM_EC_POWERSEQ=y
    - CONFIG_PLATFORM_EC_POWERSEQ_PP5000_CONTROL=n
    - CONFIG_SHIMMED_TASKS=y
    - CONFIG_PLATFORM_EC_CHIPSET_RESUME_INIT_HOOK=y
    - CONFIG_PLATFORM_EC_EXTPOWER_GPIO=y
    - CONFIG_PLATFORM_EC_POWER_BUTTON=y
    - CONFIG_PLATFORM_EC_USB_PD_DP_HPD_GPIO=y
    - CONFIG_PLATFORM_EC_USB_PD_DP_HPD_GPIO_CUSTOM=y
    - CONFIG_PLATFORM_EC_USBC_PPC=n
    - CONFIG_PLATFORM_EC_USB_CHARGER=n
    - CONFIG_PLATFORM_EC_USB_PD_DISCHARGE=n
    extra_dtc_overlay_files:
    - kingler.usbc.overlay
    extra_conf_files:
    - prj.conf
    - kingler.usbc.conf
  kingler.usbc:
    extra_configs:
    - CONFIG_TEST_KINGLER_USBC=y
    extra_conf_files:
    - prj.conf
    - kingler.usbc.conf
    extra_dtc_overlay_files:
    - kingler.usbc.overlay
  kingler.steelix:
    extra_configs:
    - CONFIG_TEST_STEELIX_RUSTY=y
    - CONFIG_TEST_FORM_FACTOR_CONVERTIBLE=y
    - CONFIG_PLATFORM_EC_ACCELGYRO_LSM6DSM=y
    extra_dtc_overlay_files:
    - kingler.steelix.overlay
  kingler.steelix_led:
    extra_configs:
    - CONFIG_TEST_STEELIX_LED=y
    - CONFIG_PLATFORM_EC_ACCELGYRO_LSM6DSM=y
    - CONFIG_PLATFORM_EC_LED_COMMON=y
    extra_dtc_overlay_files:
    - kingler.steelix.overlay
  kingler.rusty:
    extra_configs:
    - CONFIG_TEST_STEELIX_RUSTY=y
    - CONFIG_TEST_FORM_FACTOR_CLAMSHELL=y
    - CONFIG_PLATFORM_EC_ACCELGYRO_LSM6DSM=y
    extra_dtc_overlay_files:
    - kingler.steelix.overlay
  kingler.db_detect_typec:
    extra_configs:
    - CONFIG_TEST_DB_DETECT_TYPEC=y
    - CONFIG_VARIANT_CORSOLA_DB_DETECTION=y
    extra_dtc_overlay_files:
    - kingler.default.overlay
  kingler.db_detect_hdmi:
    extra_configs:
    - CONFIG_TEST_DB_DETECT_HDMI=y
    - CONFIG_VARIANT_CORSOLA_DB_DETECTION=y
    extra_dtc_overlay_files:
    - kingler.default.overlay
  kingler.db_detect_none:
    extra_configs:
    - CONFIG_TEST_DB_DETECT_NONE=y
    - CONFIG_VARIANT_CORSOLA_DB_DETECTION=y
    extra_dtc_overlay_files:
    - kingler.steelix.overlay
  kingler.ccd:
    extra_configs:
    - CONFIG_TEST_KINGLER_CCD=y
    extra_dtc_overlay_files:
    - kingler.default.overlay
  kingler.alt_sensor:
    extra_configs:
    - CONFIG_TEST_STEELIX_RUSTY=y
    - CONFIG_TEST_ALT_SENSOR_PROBE=y
    extra_dtc_overlay_files:
    - kingler.steelix.overlay
  kingler.voltorb:
    extra_configs:
    - CONFIG_TEST_VOLTORB=y
    - CONFIG_TEST_USB_PD_POLICY=y
    extra_dtc_overlay_files:
    - kingler.default.overlay
  kingler.usb_port_count:
    extra_configs:
    - CONFIG_TEST_DB_DETECTION_USB_COUNT=y
    extra_dtc_overlay_files:
    - kingler.default.overlay
  kingler.ponyta:
    extra_configs:
    - CONFIG_TEST_PONYTA=y
    - CONFIG_PLATFORM_EC_KEYBOARD_PROTOCOL_MKBP=y
    - CONFIG_PLATFORM_EC_MKBP_EVENT=y
    extra_dtc_overlay_files:
    - kingler.ponyta.overlay
    - boards/ponyta.dtsi
  kingler.kyogre_sensor:
    extra_configs:
    - CONFIG_TEST_KYOGRE_SENSOR_PROBE=y
    extra_dtc_overlay_files:
    - kingler.kyogre.overlay
```

## zephyr/test/krabby/testcase.yaml
```yaml
common:
  platform_allow: native_posix
tests:
  krabby.default:
    extra_configs:
    - CONFIG_TEST_KRABBY=y
    - CONFIG_AP_ARM_MTK_MT8186=y
    - CONFIG_MUX_INIT_ADC=y
    - CONFIG_PLATFORM_EC_CHIPSET_RESUME_INIT_HOOK=y
    - CONFIG_PLATFORM_EC_EXTPOWER_GPIO=y
    - CONFIG_PLATFORM_EC_POWERSEQ=y
    - CONFIG_PLATFORM_EC_POWERSEQ_PP5000_CONTROL=n
    - CONFIG_SHIMMED_TASKS=y
    extra_dtc_overlay_files:
    - krabby.default.overlay
  krabby.default_ro:
    extra_args:
    - EXTRA_CFLAGS=-DSECTION_IS_RO
    extra_configs:
    - CONFIG_TEST_KRABBY=y
    - CONFIG_AP_ARM_MTK_MT8186=y
    - CONFIG_MUX_INIT_ADC=y
    - CONFIG_PLATFORM_EC_CHIPSET_RESUME_INIT_HOOK=y
    - CONFIG_PLATFORM_EC_EXTPOWER_GPIO=y
    - CONFIG_PLATFORM_EC_POWERSEQ=y
    - CONFIG_PLATFORM_EC_POWERSEQ_PP5000_CONTROL=n
    - CONFIG_SHIMMED_TASKS=y
    extra_dtc_overlay_files:
    - krabby.default.overlay
  krabby.default_rw:
    extra_args:
    - EXTRA_CFLAGS=-DSECTION_IS_RW
    extra_configs:
    - CONFIG_TEST_KRABBY=y
    - CONFIG_AP_ARM_MTK_MT8186=y
    - CONFIG_MUX_INIT_ADC=y
    - CONFIG_PLATFORM_EC_CHIPSET_RESUME_INIT_HOOK=y
    - CONFIG_PLATFORM_EC_EXTPOWER_GPIO=y
    - CONFIG_PLATFORM_EC_POWERSEQ=y
    - CONFIG_PLATFORM_EC_POWERSEQ_PP5000_CONTROL=n
    - CONFIG_SHIMMED_TASKS=y
    extra_dtc_overlay_files:
    - krabby.default.overlay
  krabby.tentacruel:
    extra_configs:
    - CONFIG_TEST_TENTACRUEL=y
    - CONFIG_PLATFORM_EC_CHARGER_PROFILE_OVERRIDE=y
    - CONFIG_EEPROM=y
    - CONFIG_EEPROM_SIMULATOR=n
    - CONFIG_EMUL_EEPROM_AT2X=y
    - CONFIG_PLATFORM_EC_MOTIONSENSE=y
    - CONFIG_PLATFORM_EC_DYNAMIC_MOTION_SENSOR_COUNT=y
    - CONFIG_PLATFORM_EC_GMR_TABLET_MODE=y
    - CONFIG_PLATFORM_EC_TABLET_MODE=y
    - CONFIG_PLATFORM_EC_LID_ANGLE=y
    - CONFIG_PLATFORM_EC_ACCELGYRO_BMI260=y
    - CONFIG_PLATFORM_EC_ACCELGYRO_BMI_COMM_I2C=y
    - CONFIG_PLATFORM_EC_USBC_PPC_RT1739=y
    extra_dtc_overlay_files:
    - krabby.tentacruel.overlay
  krabby.starmie:
    extra_configs:
    - CONFIG_TEST_STARMIE=y
    - CONFIG_AP_ARM_MTK_MT8188=y
    - CONFIG_PLATFORM_EC_CHARGER_PROFILE_OVERRIDE=y
    - CONFIG_PLATFORM_EC_CHIPSET_RESUME_INIT_HOOK=y
    - CONFIG_PLATFORM_EC_EXTPOWER_GPIO=y
    - CONFIG_PLATFORM_EC_POWERSEQ=y
    - CONFIG_PLATFORM_EC_POWERSEQ_PP5000_CONTROL=n
    - CONFIG_SHIMMED_TASKS=y
    extra_dtc_overlay_files:
    - krabby.starmie.overlay
  krabby.chinchou:
    extra_configs:
    - CONFIG_TEST_CHINCHOU=y
    - CONFIG_PLATFORM_EC_DYNAMIC_MOTION_SENSOR_COUNT=y
    - CONFIG_PLATFORM_EC_GMR_TABLET_MODE=y
    - CONFIG_PLATFORM_EC_TABLET_MODE=y
    - CONFIG_EEPROM=y
    - CONFIG_PLATFORM_EC_CBI_EEPROM=y
    - CONFIG_PLATFORM_EC_EEPROM_CBI_WP=y
    - CONFIG_EMUL_EEPROM_AT2X=y
    extra_dtc_overlay_files:
    - krabby.chinchou.overlay
  krabby.woobat:
    extra_configs:
    - CONFIG_TEST_WOOBAT=y
    - CONFIG_PLATFORM_EC_CHARGER_PROFILE_OVERRIDE=y
    - CONFIG_EEPROM=y
    - CONFIG_EEPROM_SIMULATOR=n
    - CONFIG_EMUL_EEPROM_AT2X=y
    - CONFIG_PLATFORM_EC_MOTIONSENSE=y
    - CONFIG_PLATFORM_EC_DYNAMIC_MOTION_SENSOR_COUNT=y
    - CONFIG_PLATFORM_EC_GMR_TABLET_MODE=y
    - CONFIG_PLATFORM_EC_TABLET_MODE=y
    - CONFIG_PLATFORM_EC_LID_ANGLE=y
    - CONFIG_PLATFORM_EC_ACCELGYRO_BMI260=y
    - CONFIG_PLATFORM_EC_ACCELGYRO_BMI_COMM_I2C=y
    - CONFIG_PLATFORM_EC_USBC_PPC_RT1739=y
    extra_dtc_overlay_files:
    - krabby.woobat.overlay
```

## zephyr/test/lib/testcase.yaml
```yaml
common:
  platform_allow:
  - native_sim
tests:
  lib.exit:
    extra_configs:
    - CONFIG_LIBC_EXIT=y
    - CONFIG_TEST_LIB_EXIT=y
    - CONFIG_ZTEST_FATAL_HOOK=y
  lib.sbrk:
    extra_configs:
    - CONFIG_TEST_LIB_SBRK=y
    - CONFIG_PLATFORM_EC_SBRK=y
  lib.stdlib:
    extra_configs:
    - CONFIG_TEST_LIB_STDLIB=y
  lib.std_vector:
    extra_configs:
    - CONFIG_TEST_LIB_STD_VECTOR=y
```

## zephyr/test/lid_angle_common/testcase.yaml
```yaml
# Copyright 2024 The ChromiumOS Authors
# Use of this source code is governed by a BSD-style license that can be
# found in the LICENSE file.

tests:
  common.lid_angle_common.default:
    type: unit
    extra_args:
      - EXTRA_CFLAGS="-DCONFIG_TEST=1;-DCONFIG_ZEPHYR=1;-DCONFIG_TEST_DISABLE_INLINE_CHIPSET_IN_STATE;-DCONFIG_CROS_EC_KEYBOARD_INPUT"
  common.lid_angle_common.tablet_mode:
    type: unit
    extra_args:
      - EXTRA_CFLAGS="-DCONFIG_TEST=1;-DCONFIG_ZEPHYR=1;-DCONFIG_TEST_DISABLE_INLINE_CHIPSET_IN_STATE;-DCONFIG_CROS_EC_KEYBOARD_INPUT;-DCONFIG_TEST_TABLET_MODE=1"
```

## zephyr/test/math/testcase.yaml
```yaml
common:
  platform_allow: native_sim
tests:
  util.math.fixed_point:
    extra_overlay_confs:
    - ./fixed_point.conf
  util.math.floating_point:
    extra_overlay_confs:
    - ./floating_point.conf
```

## zephyr/test/nissa/Kconfig
```kconfig
# Copyright 2023 The ChromiumOS Authors
# Use of this source code is governed by a BSD-style license that can be
# found in the LICENSE file.

choice TEST_TARGET
	prompt "Select test target to build"
	help
	  Select the build target for a given test. Each test target must select
	  exactly one, because some tests assume configuration that conflicts with
	  others.

	config TEST_NISSA_SUB_BOARD
		bool "Tests for sub_board.c"
		help
		  The test target that exercises nissa/src/sub_board.c.

	config TEST_NISSA_BOARD_POWER
		bool "Tests for board_power.c"
		help
		  The test target that exercises nissa/src/board_power.c

	config TEST_NISSA_COMMON
		bool "Tests for common.c"
		help
		  The test target that exercises nissa/src/common.c.

	config TEST_NISSA_NIVVIKS
	  bool "Tests for Nivviks-specific code"
	  help
	    The test target that exercises nissa/nivviks/*.c

	config TEST_NISSA_NIVVIKS_CHARGER
	  bool "Tests for Nivviks-specific charger/USB-C code"
	  select TEST_DISABLE_INLINE_CHIPSET_IN_STATE
	  help
	    The test target that exercises nissa/nivviks/{charger,usbc}.c

	config TEST_NISSA_NEREID
	  bool "Tests for Nereid-specific code"
	  help
		The test target that exercises nissa/nereid/*.c

	config TEST_NISSA_NOKRIS
	  bool "Tests for Nokris-specific code"
	  help
		The test target that exercises nissa/nokris/*.c

	config TEST_NISSA_GOTHRAX
	  bool "Tests for Gothrax-specific code"
	  select TEST_DISABLE_INLINE_CHIPSET_IN_STATE
	  help
		The test target that exercises nissa/gothrax/*.c

	config TEST_NISSA_PUJJO
	  bool "Tests for Pujjo-specific code"
	  help
	    The test target that exercises nissa/pujjo/*.c

	config TEST_NISSA_JOXER
	  bool "Tests for Joxer-specific code"
	  help
		The test target that exercises nissa/joxer/*.c

	config TEST_NISSA_CRAASK
	  bool "Tests for Craask-specific code"
	  select TEST_DISABLE_INLINE_CHIPSET_IN_STATE
	  help
		The test target that exercises nissa/craask/*.c

	config TEST_NISSA_CRAASKOV
	  bool "Tests for Craaskov-specific code"
	  select TEST_DISABLE_INLINE_CHIPSET_IN_STATE
	  help
		The test target that exercises nissa/craaskov/*.c

	config TEST_NISSA_PIRRHA
	  bool "Tests for Pirrha-specific code"
	  select TEST_DISABLE_INLINE_CHIPSET_IN_STATE
	  help
		The test target that exercises nissa/pirrha/*.c

	config TEST_NISSA_ANRAGGAR
	  bool "Tests for Anraggar-specific code"
	  help
		The test target that exercises nissa/anraggar/*.c
endchoice

config TEST_DISABLE_INLINE_CHIPSET_IN_STATE
	bool "Disable chipset_in_state inline method"
	help
	  This is used to not define chipset_in_state method as inline
	  function.

config NISSA_BOARD_HAS_HDMI_SUPPORT
	bool "Board supports HDMI sub-boards"
	help
	  Enable board code for managing the state of hdmi connections
	  for nissa/src/sub_board.c.

config PLATFORM_EC_KEYBOARD_CUSTOMIZATION
	bool "Support keyboard customization"
	help
	  Enable support for customization keyboard, some boards need to custom matrix
	  because those board keyboard layout doesn't follow a common matrix.

	  If define, the board layer
	  needs to implement:
	  1. the scancode_set2 and keycap_label array
	  2. keyboard_customization.h which is similar to keyboard_config.h

	  Note that if your board has the standard chromeos keyboard layout other
	  than the top row, and you are looking only for top row customization,
	  then you should be looking at overriding board_vivaldi_keybd_config()
	  instead.

config TEST_DISABLE_AP_PWRSEQ
	bool "Disable CONFIG_AP_PWRSEQ"
	default n
	help
	  This is used to disable CONFIG_AP_PWRSEQ for testing purposes
	  directly.

module = NISSA
module-str = Nissa board-specific code (unit tests)
source "subsys/logging/Kconfig.template.log_config"

source "Kconfig.zephyr"
```
