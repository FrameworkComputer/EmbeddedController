/* Copyright 2026 The ChromiumOS Authors
 * Use of this source code is governed by a BSD-style license that can be
 * found in the LICENSE file.
 */

#include "boards/native_sim.overlay"

/ {
	aliases {
		gpio-btn-ign-out = &gpio_btn_ign_out;
	};

	gpio-leds {
		compatible = "gpio-leds";

		gpio_btn_ign_out: gpio_btn_ign_out {
			gpios = <&gpio0 3 GPIO_ACTIVE_HIGH>;
		};
	};
};
