/* Copyright 2025 The ChromiumOS Authors
 * Use of this source code is governed by a BSD-style license that can be
 * found in the LICENSE file.
 */

/* Defer initialization to force hibernate driver failure. */
&gpio0 {
	zephyr,deferred-init;
};

&hibernate_z5 {
	zephyr,deferred-init;
};
