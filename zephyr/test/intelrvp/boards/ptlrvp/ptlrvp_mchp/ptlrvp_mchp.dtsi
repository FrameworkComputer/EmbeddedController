/* Copyright 2024 The ChromiumOS Authors
 * Use of this source code is governed by a BSD-style license that can be
 * found in the LICENSE file.
 */

#include <dt-bindings/gpio/microchip-xec-gpio.h>
#include "include/board.h"
#include "mchp_emul.dts"
#include "../ptlrvp.dtsi"
#include "adc.dtsi"
#include "gpio.dtsi"
#include "../battery.dtsi"
#include "../i2c.dtsi"
#include "i2c.dts"
#include "../ioex.dtsi"
#include "../ioex_gpio.dtsi"
#include "../interrupts.dtsi"
#include "../keyboard.dtsi"
#include "../pd.dtsi"
#include "../power_signals.dtsi"
#include "../temp_sensor.dts"
#include "../usbc.dtsi"
