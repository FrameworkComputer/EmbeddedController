/* Copyright 2022 The ChromiumOS Authors
 * Use of this source code is governed by a BSD-style license that can be
 * found in the LICENSE file.
 */

#include <cros/thermistor/thermistor.dtsi>

/ {
	name_temp_charger: charger {
		compatible = "cros-ec,temp-sensor-thermistor";

		thermistor = <&thermistor_rt9490>;
		adc = <&adc_charger>;
	};

	named-temp-sensors {
		compatible = "cros-ec,temp-sensors";
		temp_charger: charger {
			status = "okay";
			sensor = <&name_temp_charger>;
		};
	};
};
