## CMakeLists.txt
```
# Copyright 2022 The ChromiumOS Authors
# Use of this source code is governed by a BSD-style license that can be
# found in the LICENSE file.

cmake_minimum_required(VERSION 3.13.1)
find_package(Zephyr REQUIRED HINTS "${ZEPHYR_BASE}")
project(math)

target_sources(app PRIVATE ${PLATFORM_EC}/common/math_util.c)

target_sources(
	app PRIVATE
		src/suite.c
		src/math_util.c
		src/vector.c
		src/mask.c
)

# Fixed point specific tests
target_sources_ifndef(CONFIG_FPU app PRIVATE src/fixed_point_int_sqrtf.c)

add_subdirectory(${PLATFORM_EC}/zephyr/test/test_utils test_utils)
```

## prj.conf
```kconfig
# Copyright 2022 The ChromiumOS Authors
# Use of this source code is governed by a BSD-style license that can be
# found in the LICENSE file.

CONFIG_ZTEST=y
CONFIG_ZTEST_ASSERT_VERBOSE=1
CONFIG_ASSERT=y

CONFIG_PLATFORM_EC=y
CONFIG_CROS_EC=y
CONFIG_PLATFORM_EC_MATH_UTIL=y
```

## fixed_point.conf
```kconfig
# Copyright 2022 The ChromiumOS Authors
# Use of this source code is governed by a BSD-style license that can be
# found in the LICENSE file.

CONFIG_FPU=n
```

## floating_point.conf
```kconfig
# Copyright 2022 The ChromiumOS Authors
# Use of this source code is governed by a BSD-style license that can be
# found in the LICENSE file.

CONFIG_FPU=y
```

## boards/native_posix.overlay
```dts
../../../dts/board-overlays/native_posix.dts
```

## src/fixed_point_int_sqrtf.c
```c
/* Copyright 2022 The ChromiumOS Authors
 * Use of this source code is governed by a BSD-style license that can be
 * found in the LICENSE file.
 */

#include "math.h"
#include "math_util.h"

#include <zephyr/ztest.h>

ZTEST_USER(math, test_int_sqrtf_negative)
{
	zassert_equal(int_sqrtf(-100), 0);
}

ZTEST_USER(math, test_int_sqrtf_overflow)
{
	zassert_equal(int_sqrtf(INT64_MAX), INT32_MAX);
}
```

## src/mask.c
```c
/* Copyright 2022 The ChromiumOS Authors
 * Use of this source code is governed by a BSD-style license that can be
 * found in the LICENSE file.
 */

#include "math.h"
#include "math_util.h"

#include <inttypes.h>

#include <zephyr/ztest.h>

ZTEST_USER(math, test_bitmask_uint64)
{
	zassert_equal(bitmask_uint64(-1), 0);
	zassert_equal(bitmask_uint64(64), 0);
	zassert_equal(bitmask_uint64(1), UINT64_C(1) << 1);
	zassert_equal(bitmask_uint64(15), UINT64_C(1) << 15);
	zassert_equal(bitmask_uint64(35), UINT64_C(1) << 35);
	zassert_equal(bitmask_uint64(60), UINT64_C(1) << 60);
}
```

## src/math_util.c
```c
/* Copyright 2022 The ChromiumOS Authors
 * Use of this source code is governed by a BSD-style license that can be
 * found in the LICENSE file.
 */

#include "builtin/stdio.h"
#include "common.h"
#include "math.h"
#include "math_util.h"

#include <zephyr/ztest.h>

ZTEST_USER(math, test_arc_cos__x_below_range)
{
	fp_t result = arc_cos(FLOAT_TO_FP(-1.1));

	zassert_within(result, FLOAT_TO_FP(180.0), FLOAT_TO_FP(1.0),
		       "arc_cos(-1.1) was %d", FP_TO_INT(result));
}

ZTEST_USER(math, test_arc_cos__x_above_range)
{
	fp_t result = arc_cos(FLOAT_TO_FP(1.1));

	zassert_within(result, FLOAT_TO_FP(0), FLOAT_TO_FP(1.0),
		       "arc_cos(1.1) was %d", FP_TO_INT(result));
}

ZTEST_USER(math, test_int_sqrtf)
{
	zassert_equal(int_sqrtf(0), 0);
	zassert_equal(int_sqrtf(15), 3);
	zassert_equal(int_sqrtf(25), 5);
	zassert_equal(int_sqrtf(11108889), 3333);
	zassert_equal(int_sqrtf(1234321), 1111);
}

ZTEST_USER(math, test_fp_sqrtf)
{
	zassert_within(fp_sqrtf(FLOAT_TO_FP(15)), FLOAT_TO_FP(3.872983),
		       FLOAT_TO_FP(0.001), NULL);
}

ZTEST_USER(math, test_print_ints)
{
	char buffer[10];

	/* Fixed point. */
	zassert_true(crec_snprintf(buffer, sizeof(buffer), "%.5d", 123) > 0,
		     NULL);
	zassert_equal(0, strcmp(buffer, "0.00123"), "got '%s'", buffer);
	zassert_true(crec_snprintf(buffer, sizeof(buffer), "%2.1d", 123) > 0,
		     NULL);
	zassert_equal(0, strcmp(buffer, "12.3"), "got '%s'", buffer);

	/* Precision or width larger than buffer should fail. */
	zassert_equal(-EC_ERROR_OVERFLOW, crec_snprintf(buffer, 4, "%5d", 123),
		      NULL);
	zassert_equal(0, strcmp(buffer, "  1"), "got '%s'", buffer);
	zassert_equal(-EC_ERROR_OVERFLOW, crec_snprintf(buffer, 4, "%10d", 123),
		      NULL);
	zassert_equal(0, strcmp(buffer, "   "), "got '%s'", buffer);
	zassert_equal(-EC_ERROR_OVERFLOW,
		      crec_snprintf(buffer, 4, "%-10d", 123), NULL);
	zassert_equal(0, strcmp(buffer, "123"), "got '%s'", buffer);
	zassert_equal(-EC_ERROR_OVERFLOW,
		      crec_snprintf(buffer, 4, "%.10d", 123), NULL);
	zassert_equal(0, strcmp(buffer, "0.0"), "got '%s'", buffer);
}
```

## src/suite.c
```c
/* Copyright 2022 The ChromiumOS Authors
 * Use of this source code is governed by a BSD-style license that can be
 * found in the LICENSE file.
 */

#include <zephyr/ztest.h>

ZTEST_SUITE(math, NULL, NULL, NULL, NULL, NULL);
```

## src/vector.c
```c
/* Copyright 2022 The ChromiumOS Authors
 * Use of this source code is governed by a BSD-style license that can be
 * found in the LICENSE file.
 */

#include "math.h"
#include "math_util.h"

#include <zephyr/ztest.h>

ZTEST_USER(math, test_cosine_of_angle_diff__zero_magnitude_vector)
{
	intv3_t v0 = { 0, 0, 0 };
	intv3_t v1 = { 1, 1, 1 };

	zassert_equal(cosine_of_angle_diff(v0, v1), 0);
	zassert_equal(cosine_of_angle_diff(v1, v0), 0);
}

ZTEST_USER(math, test_rotate_inv__null_matrix)
{
	intv3_t v = { 1, 2, 3 };
	intv3_t r = { 4, 5, 6 };

	rotate_inv(v, NULL, r);
	zassert_equal(v[0], r[0]);
	zassert_equal(v[1], r[1]);
	zassert_equal(v[2], r[2]);
}
```
