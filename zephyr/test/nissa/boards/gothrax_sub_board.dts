/* Copyright 2023 The ChromiumOS Authors
 * Use of this source code is governed by a BSD-style license that can be
 * found in the LICENSE file.
 */
#include "generic_npcx.dts"
/ {
	aliases {
		/delete-property/ gpio-en-sub-s5-rails;
	};
};
