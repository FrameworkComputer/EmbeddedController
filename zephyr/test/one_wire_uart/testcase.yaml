## zephyr/test/utils/Kconfig
```kconfig
# Copyright 2024 The ChromiumOS Authors
# Use of this source code is governed by a BSD-style license that can be
# found in the LICENSE file.

config TEST_STATIC_IF
	bool "STATIC_IF tests"
	help
	  STATIC_IF tests.

config TEST_UTILS
	bool "Utils tests"
	help
	  Utils tests.

config TEST_UTILS_STR
	bool "String utils tests"
	help
	  String utils tests.

source "Kconfig.zephyr"
```

## zephyr/test/utils/testcase.yaml
```yaml
common:
  platform_allow: native_sim
tests:
  utils.static_if:
    extra_configs:
    - CONFIG_TEST_STATIC_IF=y
  utils.utils:
    extra_configs:
    - CONFIG_TEST_UTILS=y
  utils.utils_str:
    extra_configs:
    - CONFIG_TEST_UTILS_STR=y
```

## zephyr/test/vivaldi_kbd/testcase.yaml
```yaml
common:
  platform_allow: native_posix
tests:
  vivaldi_kbd.default: {}
  vivaldi_kbd.two-configs-0:
    extra_args:
      - EXTRA_DTC_OVERLAY_FILE=two-configs.overlay
    extra_configs:
      - CONFIG_VIVALDI_KBD_TEST_USE_IDX=y
      - CONFIG_VIVALDI_KBD_TEST_IDX_VALUE=0
  vivaldi_kbd.two-configs-1:
    extra_args:
      - EXTRA_DTC_OVERLAY_FILE=two-configs.overlay
    extra_configs:
      - CONFIG_VIVALDI_KBD_TEST_USE_IDX=y
      - CONFIG_VIVALDI_KBD_TEST_IDX_VALUE=1
  vivaldi_kbd.two-configs-no:
    extra_args:
      - EXTRA_DTC_OVERLAY_FILE=two-configs.overlay
    extra_configs:
      - CONFIG_VIVALDI_KBD_TEST_USE_IDX=y
      - CONFIG_VIVALDI_KBD_TEST_IDX_VALUE=-1
```
