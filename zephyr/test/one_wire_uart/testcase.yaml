## zephyr/test/one_wire_uart/testcase.yaml
```yaml
common:
  platform_allow: native_posix
tests:
  one_wire_uart.default:
    extra_dtc_overlay_files:
      - one_wire_uart.overlay
```

## zephyr/test/qcom_power/testcase.yaml
```yaml
common:
  platform_allow: native_posix
tests:
  qcom_power.default: {}
  qcom_power.power_gpio_keys:
    extra_configs:
    - CONFIG_PLATFORM_EC_POWER_BUTTON=n
    extra_dtc_overlay_files:
    - ./boards/native_posix.overlay
    - ./boards/power_button.dtsi
  qcom_power.power_gpio_keys_ro:
    extra_args:
    - EXTRA_CFLAGS=-DSECTION_IS_RO
    extra_configs:
    - CONFIG_PLATFORM_EC_POWER_BUTTON=n
    extra_dtc_overlay_files:
    - ./boards/native_posix.overlay
    - ./boards/power_button.dtsi
  qcom_power.power_gpio_keys_rw:
    extra_args:
    - EXTRA_CFLAGS=-DSECTION_IS_RW
    extra_configs:
    - CONFIG_PLATFORM_EC_POWER_BUTTON=n
    extra_dtc_overlay_files:
    - ./boards/native_posix.overlay
    - ./boards/power_button.dtsi
```

## zephyr/test/rex/testcase.yaml
```yaml
# Copyright 2022 The ChromiumOS Authors
# Use of this source code is governed by a BSD-style license that can be
# found in the LICENSE file.

common:
  platform_allow: native_posix
tests:
  rex.usb_pd_policy:
    extra_dtc_overlay_files:
      - boards/native_posix.overlay
    extra_configs:
      - CONFIG_TEST_PROGRAM_USB_PD_POLICY=y
      - CONFIG_TEST_DISABLE_INLINE_CHIPSET_IN_STATE=y
      - CONFIG_TEST_ENABLE_USB_PD_DISCHARGE=y
      - CONFIG_TEST_ENABLE_USB_PD_HOST_CMD=y

  rex.board_power:
    extra_dtc_overlay_files:
      - boards/board_power.dtsi
    extra_configs:
      - CONFIG_TEST_PROGRAM_BOARD_POWER=y
      - CONFIG_TEST_X86_NON_DSX_PWRSEQ_MTL=y
      - CONFIG_AP_POWER_EVENTS_MOCK=y
      - CONFIG_AP_EVENTS=n

  rex.board_power.ap_pwrseq_drv:
    extra_dtc_overlay_files:
      - boards/board_power.dtsi
    extra_configs:
      - CONFIG_TEST_PROGRAM_BOARD_POWER=y
      - CONFIG_TEST_X86_NON_DSX_PWRSEQ_MTL=y
      - CONFIG_TEST_DISABLE_AP_PWRSEQ=n
      - CONFIG_AP_POWER_EVENTS_MOCK=y
      - CONFIG_AP_PWRSEQ=y
      - CONFIG_AP_PWRSEQ_DRIVER=y
      - CONFIG_EMUL_AP_PWRSEQ_DRIVER=y
      - CONFIG_AP_EVENTS=n

  rex.battery_present:
    extra_dtc_overlay_files:
      - boards/rex/rex.dtsi
      - boards/power.dtsi
    extra_configs:
      - CONFIG_TEST_PROGRAM_BATTERY_PRESENT=y
      - CONFIG_PLATFORM_EC_BATTERY_PRESENT_CUSTOM=y
      - CONFIG_PLATFORM_EC_BATTERY_HW_PRESENT_CUSTOM=y
      - CONFIG_PLATFORM_EC_CHARGER_ISL9241=y
      - CONFIG_PLATFORM_EC_CHARGER_SENSE_RESISTOR=10
      - CONFIG_PLATFORM_EC_CHARGER_SENSE_RESISTOR_AC=20
      - CONFIG_PLATFORM_EC_BACKLIGHT_LID=n
      - CONFIG_PLATFORM_EC_BATTERY_FUEL_GAUGE=y
      - CONFIG_PLATFORM_EC_HOSTCMD=y
      - CONFIG_PLATFORM_EC_SWITCH=n
      - CONFIG_PLATFORM_EC_USB_PD_VBUS_MEASURE_NOT_PRESENT=y
      - CONFIG_PLATFORM_EC_VBOOT_HASH=n
      - CONFIG_PLATFORM_EC_USB_PD_DISCHARGE=n

  # Rex project tests
  rex.rex:
    extra_configs:
      - CONFIG_TEST_PROJECT_REX=y

  rex.rex.usb_mux_config:
    extra_dtc_overlay_files:
      - boards/rex/rex.dtsi
    extra_configs:
      - CONFIG_TEST_PROJECT_REX=y
      - CONFIG_TEST_PROJECT_USB_MUX_CONFIG=y

  rex.rex.i2c_policy:
    extra_dtc_overlay_files:
      - boards/native_posix.overlay
      - boards/rex/rex.dtsi
    extra_configs:
      - CONFIG_TEST_PROJECT_REX=y
      - CONFIG_TEST_PROGRAM_I2C_POLICY=y
      - CONFIG_PLATFORM_EC_I2C_PASSTHRU_RESTRICTED=y

  # Screebo project tests
  rex.screebo:
    extra_configs:
      - CONFIG_TEST_PROJECT_SCREEBO=y

  rex.screebo.usb_config:
    extra_dtc_overlay_files:
      - boards/screebo/screebo.dtsi
    extra_configs:
      - CONFIG_TEST_PROJECT_SCREEBO=y
      - CONFIG_TEST_PROJECT_USB_CONFIG=y
      - CONFIG_PLATFORM_EC_BACKLIGHT_LID=n
      - CONFIG_PLATFORM_EC_BATTERY_FUEL_GAUGE=y
      - CONFIG_PLATFORM_EC_CHARGER_ISL9241=y
      - CONFIG_PLATFORM_EC_CHARGER_SENSE_RESISTOR=10
      - CONFIG_PLATFORM_EC_CHARGER_SENSE_RESISTOR_AC=20
      - CONFIG_PLATFORM_EC_GPIO_INIT_PRIORITY=49
      - CONFIG_PLATFORM_EC_HOSTCMD=y
      - CONFIG_PLATFORM_EC_LID_SWITCH=n
      - CONFIG_PLATFORM_EC_SWITCH=n
      - CONFIG_PLATFORM_EC_TCPC_INTERRUPT=y
      - CONFIG_PLATFORM_EC_USBC=y
      - CONFIG_PLATFORM_EC_USBC_PPC=y
      - CONFIG_PLATFORM_EC_USBC_PPC_SYV682C=y
      - CONFIG_PLATFORM_EC_USB_PD_DISCHARGE_PPC=y
      - CONFIG_PLATFORM_EC_USB_PD_TCPC_RUNTIME_CONFIG=y
      - CONFIG_PLATFORM_EC_USB_PD_TCPM_PS8815=y
      - CONFIG_PLATFORM_EC_USB_PD_VBUS_MEASURE_BY_BOARD=y
      - CONFIG_PLATFORM_EC_VBOOT_HASH=n

  rex.screebo.board:
    extra_dtc_overlay_files:
      - boards/native_posix.overlay
    extra_configs:
      - CONFIG_TEST_PROJECT_SCREEBO=y
      - CONFIG_TEST_PROJECT_BOARD=y
      - CONFIG_PLATFORM_EC_BACKLIGHT_LID=n
      - CONFIG_PLATFORM_EC_HOOKS=y
      - CONFIG_PLATFORM_EC_USBA=y
      - CONFIG_PLATFORM_EC_USB_PORT_POWER_DUMB_CUSTOM_HOOK=y

  rex.screebo.i2c_policy:
    extra_dtc_overlay_files:
      - boards/native_posix.overlay
      - boards/screebo/i2c.dtsi
    extra_configs:
      - CONFIG_TEST_PROJECT_SCREEBO=y
      - CONFIG_TEST_PROGRAM_I2C_POLICY=y
      - CONFIG_PLATFORM_EC_I2C_PASSTHRU_RESTRICTED=y

  # Karis project tests
  rex.karis:
    extra_configs:
      - CONFIG_TEST_PROJECT_KARIS=y

  rex.karis.usb_config:
    extra_dtc_overlay_files:
      - boards/karis/karis.dtsi
      - boards/karis/usbc.dtsi
    extra_configs:
      - CONFIG_TEST_PROJECT_KARIS=y
      - CONFIG_TEST_PROJECT_USB_CONFIG=y
      - CONFIG_PLATFORM_EC_USBC=y
      - CONFIG_PLATFORM_EC_USBC_PPC=y
      - CONFIG_PLATFORM_EC_USBC_PPC_SYV682C=y
      - CONFIG_PLATFORM_EC_USB_PD_DISCHARGE_PPC=y
      - CONFIG_PLATFORM_EC_USB_PD_TCPC_RUNTIME_CONFIG=y
      - CONFIG_ESPI=y
  rex.karis.keyboard:
    extra_dtc_overlay_files:
      - boards/karis/karis.dtsi
    extra_configs:
      - CONFIG_TEST_PROJECT_KARIS=y
      - CONFIG_TEST_PROJECT_KEYBOARD=y
  rex.karis.charger:
    extra_dtc_overlay_files:
      - boards/karis/karis.dtsi
      - boards/karis/chargers.dtsi
    extra_configs:
      - CONFIG_TEST_PROJECT_KARIS=y
      - CONFIG_TEST_PROJECT_CHARGER=y
      - CONFIG_PLATFORM_EC_BACKLIGHT_LID=n
      - CONFIG_PLATFORM_EC_BATTERY_FUEL_GAUGE=y
      - CONFIG_PLATFORM_EC_CHARGER_ISL9241=y
      - CONFIG_PLATFORM_EC_CHARGER_SENSE_RESISTOR=10
      - CONFIG_PLATFORM_EC_CHARGER_SENSE_RESISTOR_AC=20
      - CONFIG_PLATFORM_EC_HOSTCMD=y
      - CONFIG_PLATFORM_EC_CHARGER=y
      - CONFIG_PLATFORM_EC_USB_PD_VBUS_MEASURE_NOT_PRESENT=y
      - CONFIG_PLATFORM_EC_USB_PD_DISCHARGE=n
      - CONFIG_PLATFORM_EC_VBOOT_HASH=n

  rex.karis.i2c_policy:
    extra_configs:
      - CONFIG_TEST_PROJECT_KARIS=y
      - CONFIG_TEST_PROGRAM_I2C_POLICY=y
      - CONFIG_PLATFORM_EC_I2C_PASSTHRU_RESTRICTED=y
```

## zephyr/test/roach/testcase.yaml
```yaml
common:
  platform_allow:
  - native_sim
tests:
  roach.axii:
    extra_configs:
    - CONFIG_TEST_AXII=y
    extra_dtc_overlay_files:
    - axii.default.overlay
  roach.spikyrock:
    extra_configs:
    - CONFIG_TEST_SPIKYROCK=y
    - CONFIG_USB_DC_HID_VIVALDI=y
    - CONFIG_USB_DC_HID_KEYBOARD=y
    - CONFIG_USB_DEVICE_STACK=y
    - CONFIG_USB_DEVICE_MANUFACTURER="Google"
    - CONFIG_USB_DEVICE_PRODUCT="Spikyrock"
    - CONFIG_USB_DEVICE_SN="0"
    - CONFIG_USB_DEVICE_VID=0x18D1
    - CONFIG_USB_DEVICE_PID=0x5067
    extra_dtc_overlay_files:
    - spikyrock.default.overlay
```

## zephyr/test/rollback/testcase.yaml
```yaml
# Copyright 2023 The ChromiumOS Authors
# Use of this source code is governed by a BSD-style license that can be
# found in the LICENSE file.

common:
  platform_allow: native_posix
tests:
  rollback.default: {}
  rollback.secure_clear_o2:
    extra_configs:
      - CONFIG_NO_OPTIMIZATIONS=n
      - CONFIG_SIZE_OPTIMIZATIONS=y
  rollback.secure_clear_os:
    extra_configs:
      - CONFIG_NO_OPTIMIZATIONS=n
      - CONFIG_SPEED_OPTIMIZATIONS=y
```

## zephyr/test/skyrim/testcase.yaml
```yaml
# Copyright 2023 The ChromiumOS Authors
# Use of this source code is governed by a BSD-style license that can be
# found in the LICENSE file.

common:
  platform_allow: native_sim
tests:
  # Baseboard tests TEST_BOARD_POWER_SIGNALS
  skyrim.baseboard:
    extra_configs:
    - CONFIG_TEST_BOARD_BASEBOARD=y

  skyrim.baseboard.i2c_policy:
    extra_configs:
    - CONFIG_TEST_BOARD_BASEBOARD=y
    - CONFIG_TEST_BOARD_I2C_POLICY=y

  skyrim.baseboard.usbc_config:
    extra_configs:
    - CONFIG_TEST_BOARD_BASEBOARD=y
    - CONFIG_PLATFORM_EC_USBC=n
    - CONFIG_TEST_BOARD_USBC_CONFIG=y
    - CONFIG_PLATFORM_EC_USB_PD_TCPM_TCPCI=y
    - CONFIG_PLATFORM_EC_USB_PD_TCPM_NCT38XX=y
    - CONFIG_PLATFORM_EC_USB_CHARGER=y
    - CONFIG_PLATFORM_EC_USB_PD_5V_EN_CUSTOM=y

  skyrim.baseboard.power_signals:
    extra_configs:
    - CONFIG_TEST_BOARD_BASEBOARD=y
    - CONFIG_PLATFORM_EC_USBC=n
    - CONFIG_TEST_BOARD_POWER_SIGNALS=y
    - CONFIG_PLATFORM_EC_AMD_STB_DUMP=y
    - CONFIG_PLATFORM_EC_THROTTLE_AP=y
    - CONFIG_PLATFORM_EC_THROTTLE_AP_NO_FAN=y
    - CONFIG_PLATFORM_EC_THROTTLE_AP_SINGLE_PIN=y

  skyrim.baseboard.usb_pd_policy:
    extra_configs:
    - CONFIG_TEST_BOARD_BASEBOARD=y
    - CONFIG_PLATFORM_EC_USBC=n
    - CONFIG_TEST_BOARD_USB_PD_POLICY=y

  skyrim.baseboard.usb_pd_policy.discharge:
    extra_configs:
    - CONFIG_TEST_BOARD_BASEBOARD=y
    - CONFIG_PLATFORM_EC_USBC=n
    - CONFIG_TEST_BOARD_USB_PD_POLICY=y
    - CONFIG_USB_PD_DISCHARGE=y

  # Crystaldrift tests
  skyrim.crystaldrift:
    extra_configs:
    - CONFIG_TEST_BOARD_CRYSTALDRIFT=y

  skyrim.crystaldrift.fan:
    extra_configs:
    - CONFIG_TEST_BOARD_CRYSTALDRIFT=y
    - CONFIG_TEST_BOARD_FAN=y
    - CONFIG_TEST_BOARD_FAN_CUSTOM=y
    - CONFIG_TEST_DISABLE_INLINE_CHIPSET_IN_STATE=y

    extra_dtc_overlay_files:
    - ./boards/crystaldrift/crystaldrift.dtsi
  skyrim.crystaldrift.usb_mux_config:
    extra_configs:
    - CONFIG_TEST_BOARD_CRYSTALDRIFT=y
    - CONFIG_PLATFORM_EC_USBC=n
    - CONFIG_TEST_BOARD_USB_MUX_CONFIG_CUSTOM=y

  skyrim.crystaldrift.form_factor:
    extra_configs:
    - CONFIG_TEST_BOARD_CRYSTALDRIFT=y
    - CONFIG_TEST_BOARD_FORM_FACTOR=y
    extra_dtc_overlay_files:
    - ./boards/skyrim/skyrim.dtsi

  # Frostflow tests
  skyrim.frostflow:
    extra_configs:
    - CONFIG_TEST_BOARD_FROSTFLOW=y

  skyrim.frostflow.ppc_config:
    extra_configs:
    - CONFIG_TEST_BOARD_FROSTFLOW=y
    - CONFIG_PLATFORM_EC_USBC=n
    - CONFIG_TEST_BOARD_PPC_CONFIG=y

  skyrim.frostflow.usb_mux_config:
    extra_configs:
    - CONFIG_TEST_BOARD_FROSTFLOW=y
    - CONFIG_PLATFORM_EC_USBC=n
    - CONFIG_TEST_BOARD_USB_MUX_CONFIG_CUSTOM=y

  # Markarth tests
  skyrim.markarth:
    extra_configs:
    - CONFIG_TEST_BOARD_MARKARTH=y

  skyrim.markarth.ppc_config:
    extra_configs:
    - CONFIG_TEST_BOARD_MARKARTH=y
    - CONFIG_PLATFORM_EC_USBC=n
    - CONFIG_TEST_BOARD_PPC_CONFIG=y

  skyrim.markarth.usb_mux_config:
    extra_configs:
    - CONFIG_TEST_BOARD_MARKARTH=y
    - CONFIG_PLATFORM_EC_USBC=n
    - CONFIG_TEST_BOARD_USB_MUX_CONFIG_CUSTOM=y

  # Skyrim tests
  skyrim.skyrim:
    extra_configs:
    - CONFIG_TEST_BOARD_SKYRIM=y

  skyrim.skyrim.alt_charger:
    extra_configs:
    - CONFIG_TEST_BOARD_SKYRIM=y
    - CONFIG_TEST_BOARD_ALT_CHARGER=y

  skyrim.skyrim.fan:
    extra_configs:
    - CONFIG_TEST_BOARD_SKYRIM=y
    - CONFIG_TEST_BOARD_FAN=y

  skyrim.skyrim.form_factor:
    extra_configs:
    - CONFIG_TEST_BOARD_SKYRIM=y
    - CONFIG_TEST_BOARD_FORM_FACTOR=y
    extra_dtc_overlay_files:
    - ./boards/skyrim/skyrim.dtsi

  skyrim.skyrim.ppc_config:
    extra_configs:
    - CONFIG_TEST_BOARD_SKYRIM=y
    - CONFIG_PLATFORM_EC_USBC=n
    - CONFIG_TEST_BOARD_PPC_CONFIG=y

  skyrim.skyrim.usb_mux_config:
    extra_configs:
    - CONFIG_TEST_BOARD_SKYRIM=y
    - CONFIG_PLATFORM_EC_USBC=n
    - CONFIG_TEST_BOARD_USB_MUX_CONFIG_CUSTOM=y

  # Winterhold tests
  skyrim.winterhold:
    extra_configs:
    - CONFIG_TEST_BOARD_WINTERHOLD=y

  skyrim.winterhold.alt_charger:
    extra_configs:
    - CONFIG_TEST_BOARD_WINTERHOLD=y
    - CONFIG_TEST_BOARD_ALT_CHARGER_CUSTOM=y

  skyrim.winterhold.usb_mux_config:
    extra_configs:
    - CONFIG_TEST_BOARD_WINTERHOLD=y
    - CONFIG_PLATFORM_EC_USBC=n
    - CONFIG_TEST_BOARD_USB_MUX_CONFIG_CUSTOM=y

  skyrim.winterhold.fan:
    extra_configs:
    - CONFIG_TEST_BOARD_WINTERHOLD=y
    - CONFIG_TEST_BOARD_FAN=y
    - CONFIG_TEST_BOARD_FAN_CUSTOM=y
```

## zephyr/test/spi_flash_reg/Kconfig.module
```kconfig
# Copyright 2022 The ChromiumOS Authors
# Use of this source code is governed by a BSD-style license that can be
# found in the LICENSE file.

config PLATFORM_EC_SPI_FLASH_REGS
	bool
	help
	  Enables flash registers for SPI flash (both internal and external).
	  When enabled, two new functions will become available: (1) a function
	  to compute the block write protection range from a set of status
	  registers, and (2) the inverse function to set the status registers
	  based on the desired protection offset/length.
```

## zephyr/test/system_common/testcase.yaml
```yaml
common:
  platform_allow: native_sim
tests:
  system.default:
    extra_configs:
      - CONFIG_SHELL_BACKEND_DUMMY=y
      - CONFIG_SHELL_BACKEND_DUMMY_BUF_SIZE=1000
      - CONFIG_SHELL_BACKEND_SERIAL=n
    tags:
      common
      system
```

## zephyr/test/system_safe_mode/testcase.yaml
```yaml
# Copyright 2022 The ChromiumOS Authors
# Use of this source code is governed by a BSD-style license that can be
# found in the LICENSE file.

common:
  platform_allow: native_sim
tests:
  system_safe_mode.default:
    tags:
      common
      system
  system_safe_mode.disabled:
    extra_configs:
      - CONFIG_PLATFORM_EC_SYSTEM_SAFE_MODE=n
```

## zephyr/test/system_shim/testcase.yaml
```yaml
common:
  platform_allow:
  - native_sim
  tags:
  - system
tests:
  system_shim.default:
    extra_dtc_overlay_files:
    - ./default.overlay
  system_shim.ish:
    extra_configs:
    - CONFIG_SYSTEM_SHIM_TEST_ISH=y
  system_shim.power_btn:
    extra_configs:
    - CONFIG_PLATFORM_EC_BACKLIGHT_LID=n
    - CONFIG_PLATFORM_EC_SWITCH=n
    - CONFIG_PLATFORM_EC_VBOOT_HASH=n
    - CONFIG_PLATFORM_EC_HOSTCMD=y
    - CONFIG_PLATFORM_EC_LID_SWITCH=y
    - CONFIG_PLATFORM_EC_POWER_BUTTON=y
    - CONFIG_PLATFORM_EC_POWER_BUTTON_INIT_IDLE=y
```

## zephyr/test/tasks/testcase.yaml
```yaml
# Copyright 2022 The ChromiumOS Authors
# Use of this source code is governed by a BSD-style license that can be
# found in the LICENSE file.

common:
  platform_allow: native_posix
tests:
  tasks.default:
    extra_configs:
      - CONFIG_HAS_TEST_TASKS=y
  tasks.extra_tasks:
    extra_configs:
      - CONFIG_SHIMMED_TASKS=y
      - CONFIG_ASSERT_TEST=y
      - CONFIG_PLATFORM_EC_HOSTCMD=n
  tasks.extra_tasks.hostcmd_main:
    timeout: 360
    extra_configs:
      - CONFIG_SHIMMED_TASKS=y
      - CONFIG_ASSERT_TEST=y
      - CONFIG_PLATFORM_EC_HOSTCMD=y
      - CONFIG_TASK_HOSTCMD_THREAD_MAIN=y
  tasks.extra_tasks.hostcmd_dedicated:
    extra_configs:
      - CONFIG_SHIMMED_TASKS=y
      - CONFIG_ASSERT_TEST=y
      - CONFIG_PLATFORM_EC_HOSTCMD=y
      - CONFIG_TASK_HOSTCMD_THREAD_DEDICATED=y
```

## zephyr/test/throttle_ap/testcase.yaml
```yaml
common:
  platform_allow: native_posix
tests:
  throttle_ap.interrupt.active_low:
    extra_configs:
      - CONFIG_PLATFORM_EC_POWERSEQ_CPU_PROCHOT_ACTIVE_LOW=n
      - CONFIG_TEST_INTERRUPT=y
  throttle_ap.interrupt.active_high:
    extra_configs:
      - CONFIG_PLATFORM_EC_POWERSEQ_CPU_PROCHOT_ACTIVE_LOW=y
      - CONFIG_TEST_INTERRUPT=y
  thottle_ap.throttle_ap:
    extra_configs:
      - CONFIG_TEST_THROTTLE_AP=y
      - CONFIG_PLATFORM_EC_CONSOLE_CMD_APTHROTTLE=y
```
