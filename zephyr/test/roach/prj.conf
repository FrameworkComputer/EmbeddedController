## CMakeLists.txt
```
# Copyright 2023 The ChromiumOS Authors
# Use of this source code is governed by a BSD-style license that can be
# found in the LICENSE file.

cmake_minimum_required(VERSION 3.13.1)
find_package(Zephyr REQUIRED HINTS "${ZEPHYR_BASE}")
project(roach)

add_subdirectory(${PLATFORM_EC}/zephyr/test/test_utils test_utils)

zephyr_include_directories(
	include)

target_sources(app PRIVATE src/main.c)

target_sources_ifdef(CONFIG_TEST_AXII app PRIVATE
		src/axii.c
		"${PLATFORM_EC_PROGRAM_DIR}/roach/axii/src/main.c")

target_sources_ifdef(CONFIG_TEST_SPIKYROCK app PRIVATE
		src/spikyrock_keyboard.c
		"${PLATFORM_EC_PROGRAM_DIR}/roach/spikyrock/src/keyboard.c")
```

## Kconfig
```
# Copyright 2023 The ChromiumOS Authors
# Use of this source code is governed by a BSD-style license that can be
# found in the LICENSE file.

choice
	prompt "select the test suite"

config TEST_AXII
	bool "Run the tests intended for Axii"
	help
	  Run the tests for Axii board.

config TEST_SPIKYROCK
	bool "Run the tests intended for Spikyrock"
	help
	  Run the tests for Spikyrock board.
	  vivaldi_Keyboard test.
endchoice

source "Kconfig.zephyr"
```

## prj.conf
```kconfig
# Copyright 2023 The ChromiumOS Authors
# Use of this source code is governed by a BSD-style license that can be
# found in the LICENSE file.

CONFIG_ZTEST=y
CONFIG_ZTEST_ASSERT_VERBOSE=1

CONFIG_ASSERT=y
CONFIG_ADC=y
CONFIG_CROS_EC=y
CONFIG_EMUL=y

CONFIG_SHIMMED_TASKS=n

CONFIG_PLATFORM_EC=y
CONFIG_PLATFORM_EC_LID_SWITCH=n
CONFIG_PLATFORM_EC_VSTORE=n

CONFIG_PLATFORM_EC_CBI=n
CONFIG_PLATFORM_EC_BACKLIGHT_LID=n
CONFIG_PLATFORM_EC_SWITCH=n
CONFIG_PLATFORM_EC_VBOOT_EFS2=n
CONFIG_PLATFORM_EC_VBOOT_HASH=n

CONFIG_PLATFORM_EC_USB_PD_TBT_COMPAT_MODE=n
CONFIG_PLATFORM_EC_USB_PD_USB4=n
```

## axii.default.overlay
```dts
/* Copyright 2023 The ChromiumOS Authors
 * Use of this source code is governed by a BSD-style license that can be
 * found in the LICENSE file.
 */

#include "common.dtsi"

/ {
	usb0: usb0 {
	};
};

#include "../program/roach/axii/project.overlay"

/* remove pinctrl to avoid pull in too many unwanted dependency */
/delete-node/ &pinctrl;

&adc0 {
	/delete-property/ pinctrl-0;
	/delete-property/ pinctrl-names;
};

&usb0 {
	/delete-property/ pinctrl-0;
	/delete-property/ pinctrl-names;
};

/delete-node/ &ite_uart2_wrapper;
```

## common.dtsi
```dts
/* Copyright 2023 The ChromiumOS Authors
 * Use of this source code is governed by a BSD-style license that can be
 * found in the LICENSE file.
 */

#include <it8xxx2_emul.dts>

/ {
	pinctrl: pinctrl {
		compatible = "ite,it8xxx2-pinctrl";
		status = "disabled";
	};
};

&uart2 {
	status = "okay";
	compatible = "zephyr,uart-emul";
	latch-buffer-size = <16>;
};
```

## src/main.c
```c
/* Copyright 2023 The ChromiumOS Authors
 * Use of this source code is governed by a BSD-style license that can be
 * found in the LICENSE file.
 */

#include "ec_app_main.h"
#include "test_state.h"

#include <zephyr/kernel.h>
#include <zephyr/ztest.h>

bool roach_predicate_post_main(const void *state)
{
	return ((struct test_state *)state)->ec_app_main_run;
}

void test_main(void)
{
	struct test_state state = {
		.ec_app_main_run = false,
	};

	/* Run all the suites that depend on main not being called yet */
	ztest_run_test_suites(&state, false, 1, 1);

	ec_app_main();

	state.ec_app_main_run = true;

	/* Run all the suites that depend on main being called */
	ztest_run_test_suites(&state, false, 1, 1);

	/* Check that every suite ran */
	ztest_verify_all_test_suites_ran();
}
```

## include/spikyrock_keyboard.h
```c
/* Copyright 2024 The ChromiumOS Authors
 * Use of this source code is governed by a BSD-style license that can be
 * found in the LICENSE file.
 */

extern const struct ec_response_keybd_config spikyrock_keyboard;
```

## include/test_state.h
```c
/* Copyright 2023 The ChromiumOS Authors
 * Use of this source code is governed by a BSD-style license that can be
 * found in the LICENSE file.
 */

#ifndef ZEPHYR_TEST_ROACH_INCLUDE_TEST_STATE_H_
#define ZEPHYR_TEST_ROACH_INCLUDE_TEST_STATE_H_

#include <stdbool.h>

struct test_state {
	bool ec_app_main_run;
};

bool roach_predicate_post_main(const void *state);

#endif /* ZEPHYR_TEST_ROACH_INCLUDE_TEST_STATE_H_ */
```

## src/axii.c
```c
/* Copyright 2023 The ChromiumOS Authors
 * Use of this source code is governed by a BSD-style license that can be
 * found in the LICENSE file.
 */

#include "drivers/one_wire_uart.h"
#include "drivers/one_wire_uart_internal.h"
#include "keyboard_config.h"
#include "test_state.h"
#include "usb_hid_touchpad.h"

#include <zephyr/device.h>
#include <zephyr/drivers/adc/adc_emul.h>
#include <zephyr/drivers/gpio/gpio_emul.h>
#include <zephyr/drivers/serial/uart_emul.h>
#include <zephyr/fff.h>
#include <zephyr/ztest.h>

FAKE_VOID_FUNC(keyboard_state_changed, int, int, int);
FAKE_VOID_FUNC(set_touchpad_report, struct usb_hid_touchpad_report *);

static const struct device *adc0 = DEVICE_DT_GET(DT_NODELABEL(adc0));

void recv_cb(uint8_t cmd, const uint8_t *payload, int length);

ZTEST(axii, test_attach_detach)
{
	const struct gpio_dt_spec *en_pp3300_base =
		GPIO_DT_FROM_NODELABEL(en_pp3300_base);

	/* attach */
	adc_emul_const_value_set(adc0, 0, 100);
	k_msleep(1000);
	zassert_equal(gpio_emul_output_get(en_pp3300_base->port,
					   en_pp3300_base->pin),
		      1);

	/* detach */
	adc_emul_const_value_set(adc0, 0, 3300);
	k_msleep(1000);
	zassert_equal(gpio_emul_output_get(en_pp3300_base->port,
					   en_pp3300_base->pin),
		      0);
}

ZTEST(axii, test_keyboard_event)
{
	uint8_t key_matrix[KEYBOARD_COLS_MAX] = {};

	key_matrix[5] = (1 << 6);
	recv_cb(ROACH_CMD_KEYBOARD_MATRIX, key_matrix, sizeof(key_matrix));

	key_matrix[3] = (1 << 4);
	recv_cb(ROACH_CMD_KEYBOARD_MATRIX, key_matrix, sizeof(key_matrix));

	key_matrix[3] = 0;
	recv_cb(ROACH_CMD_KEYBOARD_MATRIX, key_matrix, sizeof(key_matrix));

	key_matrix[5] = 0;
	recv_cb(ROACH_CMD_KEYBOARD_MATRIX, key_matrix, sizeof(key_matrix));

	zassert_equal(keyboard_state_changed_fake.call_count, 4);

	/* 1st call: keyboard_state_changed(6, 5, 1) */
	zassert_equal(keyboard_state_changed_fake.arg0_history[0], 6);
	zassert_equal(keyboard_state_changed_fake.arg1_history[0], 5);
	zassert_equal(keyboard_state_changed_fake.arg2_history[0], 1);

	/* 2nd call: keyboard_state_changed(4. 3, 1) */
	zassert_equal(keyboard_state_changed_fake.arg0_history[1], 4);
	zassert_equal(keyboard_state_changed_fake.arg1_history[1], 3);
	zassert_equal(keyboard_state_changed_fake.arg2_history[1], 1);

	/* 3rd call: keyboard_state_changed(4, 3, 0) */
	zassert_equal(keyboard_state_changed_fake.arg0_history[2], 4);
	zassert_equal(keyboard_state_changed_fake.arg1_history[2], 3);
	zassert_equal(keyboard_state_changed_fake.arg2_history[2], 0);

	/* 4th call: keyboard_state_changed(6, 5, 0) */
	zassert_equal(keyboard_state_changed_fake.arg0_history[3], 6);
	zassert_equal(keyboard_state_changed_fake.arg1_history[3], 5);
	zassert_equal(keyboard_state_changed_fake.arg2_history[3], 0);
}

ZTEST(axii, test_touchpad_event)
{
	struct usb_hid_touchpad_report report;

	recv_cb(ROACH_CMD_TOUCHPAD_REPORT, (uint8_t *)&report, sizeof(report));
	zassert_equal(set_touchpad_report_fake.call_count, 1);
}

static void consume_uart_tx(const struct device *dev, size_t size,
			    void *user_data)
{
	uart_emul_flush_tx_data(dev);
}

static void axii_before(void *fixture)
{
	RESET_FAKE(set_touchpad_report);
	RESET_FAKE(keyboard_state_changed);

	/* set base detached by default */
	adc_emul_const_value_set(adc0, 0, 3300);

	uart_emul_callback_tx_data_ready_set(DEVICE_DT_GET(DT_NODELABEL(uart2)),
					     consume_uart_tx, NULL);
}

ZTEST_SUITE(axii, roach_predicate_post_main, NULL, axii_before, NULL, NULL);
```

## src/spikyrock_keyboard.c
```c
/* Copyright 2024 The ChromiumOS Authors
 * Use of this source code is governed by a BSD-style license that can be
 * found in the LICENSE file.
 */

#include "keyboard_protocol.h"
#include "spikyrock_keyboard.h"

#include <zephyr/fff.h>
#include <zephyr/ztest.h>

ZTEST(spikyrock_keyboard, test_keyboard_event)
{
	zassert_equal_ptr(board_vivaldi_keybd_config(), &spikyrock_keyboard);
}

ZTEST_SUITE(spikyrock_keyboard, NULL, NULL, NULL, NULL, NULL);
```
