## zephyr/test/runtime_keys/testcase.yaml
```yaml
common:
  platform_allow:
    - native_sim
tests:
  runtime_keys.default: {}

  runtime_keys.vivaldi:
    extra_configs:
      - CONFIG_TEST_RUNTIME_KEYS_VIVALDI=y
```

## zephyr/test/skywalker/testcase.yaml
```yaml
common:
  platform_allow:
  - native_sim
tests:
  skywalker.skywalker:
    extra_configs:
      - CONFIG_TEST_SKYWALKER=y
      - CONFIG_SHIMMED_TASKS=y
    extra_dtc_overlay_files:
      - common.dtsi
```
