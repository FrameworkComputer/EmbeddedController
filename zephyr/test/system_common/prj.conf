## CMakeLists.txt
```
# Copyright 2022 The ChromiumOS Authors
# Use of this source code is governed by a BSD-style license that can be
# found in the LICENSE file.

cmake_minimum_required(VERSION 3.20.0)
find_package(Zephyr REQUIRED HINTS "${ZEPHYR_BASE}")
project(system_common_test)

# Include FFF fakes
add_subdirectory(${PLATFORM_EC}/zephyr/test/test_utils test_utils)

FILE(GLOB test_sources src/*.c)
target_sources(app PRIVATE ${test_sources})
```

## prj.conf
```kconfig
# Copyright 2022 The ChromiumOS Authors
# Use of this source code is governed by a BSD-style license that can be
# found in the LICENSE file.

CONFIG_ZTEST=y
CONFIG_CROS_EC=y

CONFIG_PLATFORM_EC_CROS_FWID_VERSION=y
CONFIG_PLATFORM_EC=y
CONFIG_PLATFORM_EC_BACKLIGHT_LID=n
CONFIG_PLATFORM_EC_HOSTCMD=y
CONFIG_PLATFORM_EC_LID_SWITCH=n
CONFIG_PLATFORM_EC_PANIC=n
CONFIG_PLATFORM_EC_SWITCH=n
CONFIG_PLATFORM_EC_VBOOT_HASH=n
CONFIG_SYSTEM_BOOT_TIME_LOGGING=y
```

## boards/native_posix.overlay
```dts
/* Copyright 2022 The ChromiumOS Authors
 * Use of this source code is governed by a BSD-style license that can be
 * found in the LICENSE file.
 */

#include <board-overlays/native_posix.dts>

/ {
};
```

## src/build_info.c
```c
/* Copyright 2022 The ChromiumOS Authors
 * Use of this source code is governed by a BSD-style license that can be
 * found in the LICENSE file.
 */

#include "host_command.h"
#include "system.h"

#include <zephyr/device.h>
#include <zephyr/fff.h>
#include <zephyr/ztest_assert.h>
#include <zephyr/ztest_test.h>

ZTEST_SUITE(host_cmd_get_build_info, NULL, NULL, NULL, NULL, NULL);

FAKE_VALUE_FUNC(const char *, system_get_build_info);

ZTEST(host_cmd_get_build_info, test_get_build_info)
{
	int ret;
	char resp[1024];
	struct host_cmd_handler_args args =
		BUILD_HOST_COMMAND_RESPONSE(EC_CMD_GET_BUILD_INFO, 0, resp);

	RESET_FAKE(system_get_build_info);
	system_get_build_info_fake.return_val = "i-am-a-version";

	ret = host_command_process(&args);

	zassert_equal(ret, EC_SUCCESS, "Unexpected return value: %d", ret);
	zassert_equal(args.response_size,
		      strlen(system_get_build_info_fake.return_val) + 1);
	zassert_equal(strcmp(resp, "i-am-a-version"), 0,
		      "Unexpected response: %s", resp);
	zassert_equal(system_get_build_info_fake.call_count, 1,
		      "Unexpected call count: %d",
		      system_get_build_info_fake.call_count);
}

ZTEST(host_cmd_get_build_info, test_get_build_info_truncated)
{
	int ret;
	char resp[8];
	struct host_cmd_handler_args args =
		BUILD_HOST_COMMAND_RESPONSE(EC_CMD_GET_BUILD_INFO, 0, resp);

	RESET_FAKE(system_get_build_info);
	system_get_build_info_fake.return_val = "i-am-a-long-version";

	ret = host_command_process(&args);

	zassert_equal(ret, EC_SUCCESS, "Unexpected return value: %d", ret);
	zassert_equal(args.response_size, sizeof(resp));
	zassert_equal(strcmp(resp, "i-am-a-"), 0, "Unexpected response: %s",
		      resp);
	zassert_equal(system_get_build_info_fake.call_count, 1,
		      "Unexpected call count: %d",
		      system_get_build_info_fake.call_count);
}
```

## src/fff.c
```c
/* Copyright 2022 The ChromiumOS Authors
 * Use of this source code is governed by a BSD-style license that can be
 * found in the LICENSE file.
 */

#include <zephyr/fff.h>

DEFINE_FFF_GLOBALS;
```

## src/get_boot_time.c
```c
/* Copyright 2022 The ChromiumOS Authors
 * Use of this source code is governed by a BSD-style license that can be
 * found in the LICENSE file.
 */

#include "hooks.h"
#include "host_command.h"
#include "system.h"
#include "system_boot_time.h"

#include <zephyr/device.h>
#include <zephyr/fff.h>
#include <zephyr/ztest_assert.h>
#include <zephyr/ztest_test.h>

ZTEST_SUITE(host_cmd_get_boot_time, NULL, NULL, NULL, NULL, NULL);

ZTEST(host_cmd_get_boot_time, test_get_boot_time)
{
	int ret;
	struct ec_response_get_boot_time r;
	struct host_cmd_handler_args args =
		BUILD_HOST_COMMAND_RESPONSE(EC_CMD_GET_BOOT_TIME, 0, r);

	update_ap_boot_time(ARAIL);
	update_ap_boot_time(RSMRST);
	update_ap_boot_time(ESPIRST);
	update_ap_boot_time(PLTRST_LOW);
	update_ap_boot_time(PLTRST_HIGH);
	update_ap_boot_time(EC_CUR_TIME);
	/* trigger update_ap_boot_time(RESET_CNT) */
	hook_notify(HOOK_CHIPSET_SHUTDOWN_COMPLETE);

	ret = host_command_process(&args);

	zassert_equal(ret, EC_SUCCESS, "Unexpected return value: %d", ret);
	zassert_equal(args.response_size, sizeof(r));

	ccprintf("arail: %" PRIu64 "\n", r.timestamp[ARAIL]);
	ccprintf("rsmrst: %" PRIu64 "\n", r.timestamp[RSMRST]);
	ccprintf("espirst: %" PRIu64 "\n", r.timestamp[ESPIRST]);
	ccprintf("pltrst_low: %" PRIu64 "\n", r.timestamp[PLTRST_LOW]);
	ccprintf("pltrst_high: %" PRIu64 "\n", r.timestamp[PLTRST_HIGH]);
	ccprintf("cnt: %" PRIu16 "\n", r.cnt);
	ccprintf("ec_cur_time: %" PRIu64 "\n", r.timestamp[EC_CUR_TIME]);
}
```

## src/get_version.c
```c
/* Copyright 2022 The ChromiumOS Authors
 * Use of this source code is governed by a BSD-style license that can be
 * found in the LICENSE file.
 */

#include "host_command.h"
#include "system.h"

#include <zephyr/device.h>
#include <zephyr/fff.h>
#include <zephyr/ztest_assert.h>
#include <zephyr/ztest_test.h>

ZTEST_SUITE(host_cmd_get_version, NULL, NULL, NULL, NULL, NULL);

__override const char *system_get_version(enum ec_image copy)
{
	switch (copy) {
	case EC_IMAGE_RO:
		return "version-ro";
	case EC_IMAGE_RW:
		return "version-rw";
	default:
		return "unknown";
	}
}

ZTEST(host_cmd_get_version, test_get_version_v1)
{
	int ret;
	struct ec_response_get_version_v1 r;
	struct host_cmd_handler_args args;

	ret = ec_cmd_get_version_v1(&args, &r);

	zassert_equal(ret, EC_SUCCESS, "Unexpected return value: %d", ret);

	zassert_equal(strcmp(r.version_string_ro, "version-ro"), 0,
		      "version_string_ro: %s", r.version_string_ro);
	zassert_equal(args.response_size, sizeof(r), "response_size: %d",
		      args.response_size);
	zassert_equal(strcmp(r.version_string_rw, "version-rw"), 0,
		      "version_string_rw: %s", r.version_string_rw);
	zassert_equal(strcmp(r.cros_fwid_ro, ""), 0, "cros_fwid_ro: %s",
		      r.cros_fwid_ro);
	zassert_equal(strcmp(r.cros_fwid_rw, ""), 0, "cros_fwid_ro: %s",
		      r.cros_fwid_rw);
	zassert_equal(r.current_image, EC_IMAGE_UNKNOWN, "current_image: %s",
		      r.current_image);
}

ZTEST(host_cmd_get_version, test_get_version_v0)
{
	int ret;
	struct ec_response_get_version r;
	struct host_cmd_handler_args args;

	ret = ec_cmd_get_version(&args, &r);

	zassert_equal(ret, EC_SUCCESS, "Unexpected return value: %d", ret);

	zassert_equal(strcmp(r.version_string_ro, "version-ro"), 0,
		      "version_string_ro: %s", r.version_string_ro);
	zassert_equal(args.response_size, sizeof(r), "response_size: %d",
		      args.response_size);
	zassert_equal(strcmp(r.version_string_rw, "version-rw"), 0,
		      "version_string_rw: %s", r.version_string_rw);
	zassert_equal(r.current_image, EC_IMAGE_UNKNOWN, "current_image: %s",
		      r.current_image);
}
```

## src/reboot.c
```c
/* Copyright 2022 The ChromiumOS Authors
 * Use of this source code is governed by a BSD-style license that can be
 * found in the LICENSE file.
 */

#include "host_command.h"
#include "system.h"

#include <zephyr/device.h>
#include <zephyr/fff.h>
#include <zephyr/ztest_assert.h>
#include <zephyr/ztest_test.h>

FAKE_VOID_FUNC(system_reset, int);
FAKE_VOID_FUNC(system_hibernate, uint32_t, uint32_t);

ZTEST_SUITE(console_cmd_reboot, NULL, NULL, NULL, NULL, NULL);

ZTEST(console_cmd_reboot, test_reboot_valid)
{
	int ret;
	int i;

	struct {
		char *cmd;
		int expect_called;
		int expect_flags;
	} tests[] = {
		{
			.cmd = "reboot hard",
			.expect_called = 1,
			.expect_flags = SYSTEM_RESET_MANUALLY_TRIGGERED |
					SYSTEM_RESET_HARD,
		},
		{
			.cmd = "reboot cold",
			.expect_called = 1,
			.expect_flags = SYSTEM_RESET_MANUALLY_TRIGGERED |
					SYSTEM_RESET_HARD,
		},
		{
			.cmd = "reboot soft",
			.expect_called = 1,
			.expect_flags = SYSTEM_RESET_MANUALLY_TRIGGERED,
		},
		{
			.cmd = "reboot ap-off",
			.expect_called = 1,
			.expect_flags = SYSTEM_RESET_MANUALLY_TRIGGERED |
					SYSTEM_RESET_LEAVE_AP_OFF,
		},
		{
			.cmd = "reboot ap-off-in-ro",
			.expect_called = 1,
			.expect_flags = SYSTEM_RESET_MANUALLY_TRIGGERED |
					SYSTEM_RESET_LEAVE_AP_OFF |
					SYSTEM_RESET_STAY_IN_RO,
		},
		{
			.cmd = "reboot ro",
			.expect_called = 1,
			.expect_flags = SYSTEM_RESET_MANUALLY_TRIGGERED |
					SYSTEM_RESET_STAY_IN_RO,
		},
		{
			.cmd = "reboot cancel",
			.expect_called = 0,
			.expect_flags = 0,
		},
		{
			.cmd = "reboot preserve",
			.expect_called = 1,
			.expect_flags = SYSTEM_RESET_MANUALLY_TRIGGERED |
					SYSTEM_RESET_PRESERVE_FLAGS,
		},
		{
			.cmd = "reboot wait-ext",
			.expect_called = 1,
			.expect_flags = SYSTEM_RESET_MANUALLY_TRIGGERED |
					SYSTEM_RESET_WAIT_EXT,
		},
	};

	for (i = 0; i < ARRAY_SIZE(tests); i++) {
		char *cmd = tests[i].cmd;

		RESET_FAKE(system_reset);
		RESET_FAKE(system_hibernate);

		ret = shell_execute_cmd(get_ec_shell(), cmd);

		zassert_equal(ret, EC_SUCCESS,
			      "Unexpected return value for '%s': %d", cmd, ret);
		zassert_equal(system_reset_fake.call_count,
			      tests[i].expect_called,
			      "Unexpected call count for '%s': %d", cmd,
			      system_reset_fake.call_count);
		zassert_equal(system_reset_fake.arg0_history[0],
			      tests[i].expect_flags,
			      "Unexpected flags for '%s': %x", cmd,
			      system_reset_fake.arg0_history[0]);
	}
}

ZTEST(console_cmd_reboot, test_reboot_invalid)
{
	int ret;

	ret = shell_execute_cmd(get_ec_shell(), "reboot i-am-not-an-argument");

	zassert_equal(ret, EC_ERROR_PARAM1, "invalid return value: %d", ret);
	zassert_equal(system_reset_fake.call_count, 0,
		      "Unexpected call count: %d",
		      system_reset_fake.call_count);
}

ZTEST_SUITE(host_cmd_reboot, NULL, NULL, NULL, NULL, NULL);

ZTEST(host_cmd_reboot, test_reboot)
{
	int ret;
	int i;
	struct ec_params_reboot_ec p;
	int reboot_at_shutdown;

	struct {
		uint8_t cmd;
		uint8_t flags;
		int expect_return;
		int expect_reboot_at_shutdown;
		int expect_reset_called;
		int expect_reset_flags;
		int expect_hibernate_called;
	} tests[] = {
		{
			.cmd = EC_REBOOT_CANCEL,
			.flags = 0,
			.expect_return = EC_RES_SUCCESS,
			.expect_reboot_at_shutdown = EC_REBOOT_CANCEL,
			.expect_reset_called = 0,
			.expect_reset_flags = 0,
			.expect_hibernate_called = 0,
		},
		{
			.cmd = EC_REBOOT_COLD,
			.flags = EC_REBOOT_FLAG_SWITCH_RW_SLOT,
			.expect_return = EC_RES_INVALID_PARAM,
			.expect_reboot_at_shutdown = 0,
			.expect_reset_called = 0,
			.expect_reset_flags = 0,
			.expect_hibernate_called = 0,
		},
		{
			.cmd = 0xaa, /* cmd passed unmodified */
			.flags = EC_REBOOT_FLAG_ON_AP_SHUTDOWN,
			.expect_return = EC_RES_SUCCESS,
			.expect_reboot_at_shutdown = 0xaa,
			.expect_reset_called = 0,
			.expect_reset_flags = 0,
			.expect_hibernate_called = 0,
		},
		{
			.cmd = 0x55, /* cmd passed unmodified */
			.flags = EC_REBOOT_FLAG_ON_AP_SHUTDOWN,
			.expect_return = EC_RES_SUCCESS,
			.expect_reboot_at_shutdown = 0x55,
			.expect_reset_called = 0,
			.expect_reset_flags = 0,
			.expect_hibernate_called = 0,
		},
		{
			.cmd = EC_REBOOT_COLD,
			.flags = 0,
			.expect_return = EC_RES_ERROR,
			.expect_reboot_at_shutdown = EC_REBOOT_CANCEL,
			.expect_reset_called = 1,
			.expect_reset_flags = SYSTEM_RESET_HARD,
			.expect_hibernate_called = 0,
		},
		{
			.cmd = EC_REBOOT_HIBERNATE,
			.flags = 0,
			.expect_return = EC_RES_ERROR,
			.expect_reboot_at_shutdown = EC_REBOOT_CANCEL,
			.expect_reset_called = 0,
			.expect_reset_flags = 0,
			.expect_hibernate_called = 1,
		},
		{
			.cmd = EC_REBOOT_COLD_AP_OFF,
			.flags = 0,
			.expect_return = EC_RES_ERROR,
			.expect_reboot_at_shutdown = EC_REBOOT_CANCEL,
			.expect_reset_called = 1,
			.expect_reset_flags = SYSTEM_RESET_HARD |
					      SYSTEM_RESET_LEAVE_AP_OFF,
			.expect_hibernate_called = 0,
		},
		{
			.cmd = 0xff,
			.flags = 0,
			.expect_return = EC_RES_INVALID_PARAM,
			.expect_reboot_at_shutdown = EC_REBOOT_CANCEL,
			.expect_reset_called = 0,
			.expect_reset_flags = 0,
			.expect_hibernate_called = 0,
		},
	};

	for (i = 0; i < ARRAY_SIZE(tests); i++) {
		p.cmd = tests[i].cmd;
		p.flags = tests[i].flags;

		RESET_FAKE(system_reset);
		RESET_FAKE(system_hibernate);

		ret = ec_cmd_reboot_ec(NULL, &p);

		zassert_equal(ret, tests[i].expect_return,
			      "Unexpected return value (%d): %d", i, ret);
		reboot_at_shutdown =
			system_common_get_reset_reboot_at_shutdown();
		zassert_equal(
			reboot_at_shutdown, tests[i].expect_reboot_at_shutdown,
			"Unexpected value for reboot_at_shutdown (%d): %d", i,
			reboot_at_shutdown);
		zassert_equal(system_reset_fake.call_count,
			      tests[i].expect_reset_called,
			      "Unexpected reset call count (%d): %d", i,
			      system_reset_fake.call_count);
		zassert_equal(system_reset_fake.arg0_history[0],
			      tests[i].expect_reset_flags,
			      "Unexpected flags (%d): %x", i,
			      system_reset_fake.arg0_history[0]);
		zassert_equal(system_hibernate_fake.call_count,
			      tests[i].expect_hibernate_called,
			      "Unexpected hibernate call count (%d): %d", i,
			      system_hibernate_fake.call_count);
	}
}

ZTEST_SUITE(console_cmd_hibernate, NULL, NULL, NULL, NULL, NULL);

int chipset_in_state(int state_mask)
{
	return 0;
}

ZTEST(console_cmd_hibernate, test_hibernate_default)
{
	int ret;

	RESET_FAKE(system_hibernate);

	ret = shell_execute_cmd(get_ec_shell(), "hibernate");

	zassert_equal(ret, EC_SUCCESS, "Unexpected return value: %d", ret);
	zassert_equal(system_hibernate_fake.call_count, 1,
		      "Unexpected hibernate call count: %d",
		      system_hibernate_fake.call_count);
	zassert_equal(system_hibernate_fake.arg0_history[0], 0,
		      "Unexpected hibernate_secondst: %d",
		      system_hibernate_fake.arg0_history[0]);
	zassert_equal(system_hibernate_fake.arg1_history[0], 0,
		      "Unexpected hibernate_secondst: %d",
		      system_hibernate_fake.arg1_history[0]);
}

ZTEST(console_cmd_hibernate, test_hibernate_args)
{
	int ret;

	RESET_FAKE(system_hibernate);

	ret = shell_execute_cmd(get_ec_shell(), "hibernate 123 456");

	zassert_equal(ret, EC_SUCCESS, "Unexpected return value: %d", ret);
	zassert_equal(system_hibernate_fake.call_count, 1,
		      "Unexpected hibernate call count: %d",
		      system_hibernate_fake.call_count);
	zassert_equal(system_hibernate_fake.arg0_history[0], 123,
		      "Unexpected hibernate_secondst: %d",
		      system_hibernate_fake.arg0_history[0]);
	zassert_equal(system_hibernate_fake.arg1_history[0], 456,
		      "Unexpected hibernate_secondst: %d",
		      system_hibernate_fake.arg1_history[0]);
}
```

## src/system_is_locked.c
```c
/* Copyright 2022 The ChromiumOS Authors
 * Use of this source code is governed by a BSD-style license that can be
 * found in the LICENSE file.
 */

#include "system.h"

#include <zephyr/shell/shell_dummy.h>
#include <zephyr/ztest_assert.h>
#include <zephyr/ztest_test.h>

ZTEST_USER(system_is_locked, test_syslock_console_cmd)
{
	/*
	 * Integration test that validates the syslock console command forces
	 * the system_is_locked command to return true
	 */

	const struct shell *shell_zephyr = get_ec_shell();

	shell_backend_dummy_clear_output(shell_zephyr);

	zassert_false(system_is_locked());
	/*
	 * TODO(b/249373175): Use CHECK_CONSOLE_CMD() macro
	 */
	zassert_ok(shell_execute_cmd(shell_zephyr, "syslock"), NULL);
	zassert_true(system_is_locked());
}

ZTEST_SUITE(system_is_locked, NULL, NULL, NULL, NULL, NULL);
```
